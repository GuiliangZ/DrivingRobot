VERSION ""

NS_ :

BS_:

BU_: APP APS BMS CMP CMPD DAS DBG DI DIF DIR EPBL EPBR GTW GTWU ICR PLG PM PMF PMR PTC SCCM SDCR SIL VCFRONT VCLEFT VCRIGHT VCSEC APP APS BMS CMP CMPD CMPT DAS DBG DI DIF DIR EPBL EPBR GTW GTWU ICR PLG PM PMF PMR PTC SCCM SDCR SIL VCFRONT VCLEFT VCRIGHT VCSEC

VAL_TABLE_ AD_state 3 "AD_STATE_FAULTED" 2 "AD_STATE_BACKUP" 1 "AD_STATE_NORMAL" 0 "AD_STATE_STARTUP" ;
VAL_TABLE_ APP_clipRecordingStatus 4 "APP_CLIP_FAULTED" 3 "APP_CLIP_TRIGGERED" 2 "APP_CLIP_RECORDING" 1 "APP_CLIP_IDLE" 0 "APP_CLIP_NO_DRIVE" ;
VAL_TABLE_ APP_factorySummonStatus 8 "FACTORY_SUMMON_END_OF_ROUTE" 7 "FACTORY_SUMMON_UNAVAILABLE_HEADING_NOT_INITIALIZED" 6 "FACTORY_SUMMON_UNAVAILABLE_VEHICLE_SPEED_INVALID" 5 "FACTORY_SUMMON_UNAVAILABLE_NO_GPS" 4 "FACTORY_SUMMON_UNAVAILABLE_GOAL_TOO_FAR" 3 "FACTORY_SUMMON_UNAVAILABLE_NO_QR_INSTRUCTION" 2 "FACTORY_SUMMON_AVAILABLE" 1 "FACTORY_SUMMON_ACTIVE" 0 "FACTORY_SUMMON_SNA" ;
VAL_TABLE_ APP_fsdSuspendState 3 "SNA" 1 "SUSPENDED" 0 "NOT_SUSPENDED" ;
VAL_TABLE_ APP_fusedState 3 "APP_FUSE_SNA" 2 "APP_FUSE_FUSED" 1 "APP_FUSE_UNFUSED" 0 "APP_FUSE_UNKNOWN" ;
VAL_TABLE_ APP_pedestrianDist -32 "SNA" ;
VAL_TABLE_ APP_summonUnavailableReason 20 "SMART_SUMMON_UNAVAILABLE_NO_CONTEXT" 19 "SMART_SUMMON_UNAVAILABLE_PUBLIC_ROAD_BOUNDARIES_NOT_VALID" 18 "SMART_SUMMON_UNAVAILABLE_ALL_SENSORS_OCCLUDED" 17 "SMART_SUMMON_UNAVAILABLE_ULTRASONIC_STALE" 16 "SMART_SUMMON_UNAVAILABLE_VISION_HEALTH_CRITICAL" 15 "SMART_SUMMON_UNAVAILABLE_CAMERA_NOT_CALIBRATED" 14 "SMART_SUMMON_UNAVAILABLE_END_OF_LEASH" 13 "SMART_SUMMON_UNAVAILABLE_PHONE_IS_TOO_FAR" 12 "SMART_SUMMON_UNAVAILABLE_EGO_GPS_UNAVAILABLE" 11 "SMART_SUMMON_UNAVAILABLE_PHONE_GPS_UNAVAILABLE" 10 "SMART_SUMMON_UNAVAILABLE_POOR_CONNECTION" 9 "SMART_SUMMON_UNAVAILABLE_PUBLIC_ROAD" 8 "SMART_SUMMON_UNAVAILABLE_EAC_UNAVAILABLE" 7 "SMART_SUMMON_UNAVAILABLE_CRUISE_UNAVAILABLE" 6 "SMART_SUMMON_UNAVAILABLE_ULTRASONIC_FAULT" 5 "SMART_SUMMON_UNAVAILABLE_ULTRASONIC_BLOCKED" 4 "SMART_SUMMON_UNAVAILABLE_CAMERA_BLOCKED" 3 "SMART_SUMMON_UNAVAILABLE_CAMERA_STREAM" 2 "SMART_SUMMON_UNAVAILABLE_NOT_IN_PARK" 1 "SMART_SUMMON_UNAVAILABLE_NONE" 0 "SMART_SUMMON_UNAVAILABLE_UNKNOWN" ;
VAL_TABLE_ APS_NM_keepAwakeReason 2 "APS_KEEPAWAKE_REASON_APP_SUSPENDED" 1 "APS_KEEPAWAKE_REASON_APP_INITIALIZING" 0 "APS_KEEPAWAKE_REASON_NONE_SNA" ;
VAL_TABLE_ APS_turbo 2 "TURBO_UNKNOWN" 1 "TURBO_B" 0 "TURBO_A" ;
VAL_TABLE_ APS_turboArbState 7 "ARB_STATE_COUNT" 6 "ARB_STATE_UNKNOWN" 5 "ARB_STATE_MIA" 4 "ARB_STATE_FAULT" 3 "ARB_STATE_SECONDARY" 2 "ARB_STATE_PRIMARY" 1 "ARB_STATE_IDLE" 0 "ARB_STATE_INIT" ;
VAL_TABLE_ APS_turboFaultState 27 "FAULT_STATE_COUNT" 26 "FAULT_STATE_UNKNOWN" 25 "FAULT_STATE_MIA" 24 "FAULT_STATE_UNEXPECTED" 23 "FAULT_STATE_SCS" 22 "FAULT_STATE_SOFTWARE_FAULT" 21 "FAULT_STATE_TRIP1_FAULT" 20 "FAULT_STATE_TRIP0_FAULT" 19 "FAULT_STATE_WDT" 18 "FAULT_STATE_CPU_FAULT" 17 "FAULT_STATE_DROOP_TRIP" 16 "FAULT_STATE_DROOP_GPU" 15 "FAULT_STATE_DROOP_CPUCL2" 14 "FAULT_STATE_DROOP_CPUCL1" 13 "FAULT_STATE_DROOP_CPUCL0" 12 "FAULT_STATE_MIF_ECC_AP" 11 "FAULT_STATE_MIF7_DFI_ALERT" 10 "FAULT_STATE_MIF6_DFI_ALERT" 9 "FAULT_STATE_MIF5_DFI_ALERT" 8 "FAULT_STATE_MIF4_DFI_ALERT" 7 "FAULT_STATE_MIF3_DFI_ALERT" 6 "FAULT_STATE_MIF2_DFI_ALERT" 5 "FAULT_STATE_MIF1_DFI_ALERT" 4 "FAULT_STATE_MIF0_DFI_ALERT" 3 "FAULT_STATE_MIF_ECC_UNCORRECTED" 2 "FAULT_STATE_MIF_ECC_CORRECTED" 1 "FAULT_STATE_GIC" 0 "FAULT_STATE_NONE" ;
VAL_TABLE_ APS_turboPowerState 24 "POWER_STATE_COUNT" 23 "POWER_STATE_UNKNOWN" 22 "POWER_STATE_MIA" 21 "POWER_STATE_FAULT" 20 "POWER_STATE_SOC_OFF_ABORT" 19 "POWER_STATE_SOC_OFF" 18 "POWER_STATE_SOC_OFF_READY" 17 "POWER_STATE_AP_SUSPENDED" 16 "POWER_STATE_AP_OFF_ABORT_WAIT_FOR_ACK" 15 "POWER_STATE_AP_OFF_ABORT" 14 "POWER_STATE_AP_OFF_READY_WAIT_FOR_RESPONSE" 13 "POWER_STATE_AP_OFF_READY_WAIT_FOR_ACK" 12 "POWER_STATE_AP_OFF_READY" 11 "POWER_STATE_AP_OFF_PREPARE" 10 "POWER_STATE_AP_WAIT_FOR_SHUTDOWN" 9 "POWER_STATE_AP_ON" 8 "POWER_STATE_AP_IN_COREBOOT" 7 "POWER_STATE_AP_BOOTING" 6 "POWER_STATE_AP_ON_READY_WAIT_FOR_RESPONSE" 5 "POWER_STATE_AP_ON_READY_WAIT_FOR_ACK" 4 "POWER_STATE_AP_ON_READY" 3 "POWER_STATE_AP_ON_PREPARE_WAIT_FOR_RESPONSE" 2 "POWER_STATE_AP_ON_PREPARE_WAIT_FOR_ACK" 1 "POWER_STATE_AP_ON_PREPARE" 0 "POWER_STATE_IDLE" ;
VAL_TABLE_ APS_turboResetState 5 "RESET_STATE_COUNT" 4 "RESET_STATE_UNKNOWN" 3 "RESET_STATE_MIA" 2 "RESET_STATE_FAULT" 1 "RESET_STATE_RESETTING" 0 "RESET_STATE_NOT_RESETTING" ;
VAL_TABLE_ APS_turboSleepState 9 "SLEEP_STATE_COUNT" 8 "SLEEP_STATE_UNKNOWN" 7 "SLEEP_STATE_MIA" 6 "SLEEP_STATE_FAULT" 5 "SLEEP_STATE_ABORT" 4 "SLEEP_STATE_SLEEPING" 3 "SLEEP_STATE_GOING_TO_SLEEP" 2 "SLEEP_STATE_READY" 1 "SLEEP_STATE_WAIT_FOR_BUS_SILENCE" 0 "SLEEP_STATE_IDLE" ;
VAL_TABLE_ AP_watchdogState 7 "AP_WDOG_STATE_SNA" 3 "AP_WDOG_STATE_HEALTHY" 2 "AP_WDOG_STATE_CRITICAL" 1 "AP_WDOG_STATE_DEGRADED" 0 "AP_WDOG_STATE_UNKNOWN" ;
VAL_TABLE_ AcChargeState 6 "AC_CHARGE_FAULT" 5 "AC_CHARGE_VEH_SHUTDOWN" 4 "AC_CHARGE_ONBOARD_CHARGER_SHUTDOWN" 3 "AC_CHARGE_ENABLED" 2 "AC_CHARGE_STANDBY" 1 "AC_CHARGE_CONNECTED_CHARGE_BLOCKED" 0 "AC_CHARGE_INACTIVE" ;
VAL_TABLE_ BLE_connectionMonitorConnectionState 2 "CONNECTED" 1 "SEARCHING" 0 "DISCONNECTED" ;
VAL_TABLE_ BMBSensorStatus 3 "SENSOR_BYPASSED" 2 "SENSOR_NOMINAL" 1 "SENSOR_BAD" 0 "SENSOR_MISSING" ;
VAL_TABLE_ BMBStatusRegErrorType 22 "BMB_REG_VBG2_PLAUS" 21 "BMB_REG_REFL_PLAUS" 20 "BMB_REG_TSREF_PLAUS" 19 "BMB_REG_VCM1_PLAUS" 18 "BMB_REG_THERM_PLAUS" 17 "BMB_REG_DIETEMP_PLAUS" 16 "BMB_REG_STACKV_PLAUS" 15 "BMB_REG_BRICKV_PLAUS" 14 "BMB_REG_ADC_COMP_ABORT" 13 "BMB_REG_LPF_FAULT_DET" 12 "BMB_REG_AUX_MISC_DRDY" 11 "BMB_REG_AUX_GPIO_DRDY" 10 "BMB_REG_AUX_VCELL_DRDY" 9 "BMB_REG_MAIN_ADC_DRDY" 8 "BMB_REG_MAIN_ADC_LPF" 7 "BMB_REG_COMM_FAULT" 6 "BMB_REG_SYSTEM_FAULT" 5 "BMB_REG_ADC_COMP_FAULT" 4 "BMB_REG_ERROR_OTP_FAULT" 3 "BMB_REG_ERROR_OTP_WARNING" 2 "BMB_REG_ERROR_ADC_SEQUENCE" 1 "BMB_REG_ERROR_POWER_RESET" 0 "BMB_REG_ERROR_NONE" 40 "BMB_SEQ_ERROR_FAULT_CLEAR" 39 "BMB_SEQ_ERROR_FAULT_INJECT" 38 "BMB_SEQ_ERROR_CELL_RESUME" 37 "BMB_SEQ_ERROR_CELL_FREEZE" 36 "BMB_SEQ_ERROR_AUX_RESET" 35 "BMB_SEQ_ERROR_AUX_CLEAR" 34 "BMB_REG_TEST_MODE" 33 "BMB_REG_SUPPLY_RAIL" 32 "BMB_REG_CLK_CHECK" 31 "BMB_REG_DIGITAL_REF_OV" 30 "BMB_REG_DIGITAL_REF_UV" 29 "BMB_REG_ANALOG_REF_OV" 28 "BMB_REG_ANALOG_REF_UV" 27 "BMB_REG_POWER_BIST" 26 "BMB_REG_GPIO_COMP" 25 "BMB_REG_CBOW_COMP" 24 "BMB_REG_VCOW_COMP" 23 "BMB_REG_VCCB_COMP" ;
VAL_TABLE_ BMS_1Hz_Debug_ID 11 "BMS_1HZ_DBG_END" 10 "BMS_1HZ_DBG_MODULE_BIRTH_DATE_5" 9 "BMS_1HZ_DBG_MODULE_BIRTH_DATE_4" 8 "BMS_1HZ_DBG_MODULE_BIRTH_DATE_3" 7 "BMS_1HZ_DBG_MODULE_BIRTH_DATE_2" 6 "BMS_1HZ_DBG_MODULE_BIRTH_DATE_1" 5 "BMS_1HZ_DBG_PACK_BIRTH_DATE" 4 "BMS_1HZ_DBG_STACK_USAGE" 3 "BMS_1HZ_DBG_ENERGY_PACK_INPUTS_2" 2 "BMS_1HZ_DBG_ENERGY_PACK_INPUTS_1" 1 "BMS_1HZ_DBG_BALANCE2" 0 "BMS_1HZ_DBG_BALANCE1" ;
VAL_TABLE_ BMS_AlertMatrixIndex 2 "BMS_AlertMatrix2" 1 "BMS_AlertMatrix1" 0 "BMS_AlertMatrix0" ;
VAL_TABLE_ BMS_DI_Limp_Request 1 "LIMP_REQUEST_WELDED" 0 "LIMP_REQUEST_NONE" ;
VAL_TABLE_ BMS_Hv_State 6 "HV_UP" 5 "HV_UP_FOR_DC_CHARGE" 4 "HV_UP_FOR_CHARGE" 3 "HV_UP_FOR_DRIVE" 2 "HV_GOING_DOWN" 1 "HV_COMING_UP" 0 "HV_DOWN" ;
VAL_TABLE_ BMS_NM_keepAwakeReason 6 "BMS_KEEPAWAKE_REASON_CP_ACTIVE" 5 "BMS_KEEPAWAKE_REASON_BMS_ACTIVE" 4 "BMS_KEEPAWAKE_REASON_HVP_ACTIVE" 3 "BMS_KEEPAWAKE_REASON_FC_CTR_CLEANING" 2 "BMS_KEEPAWAKE_REASON_CRITICAL_ALERT" 1 "BMS_KEEPAWAKE_REASON_CTRS_CLOSED" 0 "BMS_KEEPAWAKE_REASON_NONE_SNA" ;
VAL_TABLE_ BMS_NM_wakeUpReason 5 "BMS_WAKEUP_REASON_WANTTOWARM" 4 "BMS_WAKEUP_REASON_CRITICALALERT" 3 "BMS_WAKEUP_REASON_WANTTOCHARGE" 2 "BMS_WAKEUP_REASON_CAN_HVS" 1 "BMS_WAKEUP_REASON_CAN_VEH" 0 "BMS_WAKEUP_REASON_NONE" ;
VAL_TABLE_ BMS_Power_Calculation_State 1 "POWER_CALCULATED_FOR_DRIVE" 0 "POWER_NOT_CALCULATED_FOR_DRIVE" ;
VAL_TABLE_ BMS_Resource_Request 3 "SHUT_DOWN" 2 "WAKE_UP" 1 "KEEP_ON" 0 "NONE" ;
VAL_TABLE_ BMS_Resource_State 5 "ON" 4 "MIA" 3 "SILENT" 2 "POWERING_UP" 1 "POWERING_DOWN" 0 "OFF" ;
VAL_TABLE_ BMS_Sleep_State 6 "ALL_ON" 5 "HVS_POWERING_UP" 4 "HVS_POWERING_DOWN" 3 "SOLO_WAKE" 2 "STOPPING" 1 "STOP" 0 "INIT" ;
VAL_TABLE_ BMS_a041_resetType 8 "BMS_A041_SWT1_RES" 7 "BMS_A041_SWT0_RES" 6 "BMS_A041_SUF" 5 "BMS_A041_FUNC_ESC" 4 "BMS_A041_SSCM_SEC" 3 "BMS_A041_SOFT_DEST" 2 "BMS_A041_HSM_DEST" 1 "BMS_A041_POR" 0 "BMS_A041_NONE" ;
VAL_TABLE_ BMS_a043_watchdogVector 3 "BMS_A043_HARDWARE_VECTOR" 2 "BMS_A043_SOFTWARE_VECTOR" 1 "BMS_A043_STACKCHECK_VECTOR" 0 "BMS_A043_INVALID_VECTOR" ;
VAL_TABLE_ BMS_a045_exceptionRegisterType 6 "BMS_A045_CALLTRACE" 5 "BMS_A045_MCAR" 4 "BMS_A045_MCSR" 3 "BMS_A045_DEAR" 2 "BMS_A045_ESR" 1 "BMS_A045_SRR1" 0 "BMS_A045_SRR0" ;
VAL_TABLE_ BMS_a077_errorType 1 "BMS_A077_CHG_REG_OVERCHARGE" 0 "BMS_A077_CHG_REG_CURRENT_HIGH" ;
VAL_TABLE_ BMS_a078_peakDchInChg -32768 "SNA" ;
VAL_TABLE_ BMS_a080_ctrResistance 8191 "SNA" ;
VAL_TABLE_ BMS_a080_ctrResistanceConfidence 16383 "SNA" ;
VAL_TABLE_ BMS_a083_ctrRequest 5 "BMS_A083_CTR_REQUEST_FAULT_OPEN" 4 "BMS_A083_CTR_REQUEST_OPEN" 3 "BMS_A083_CTR_REQUEST_CLOSED" 2 "BMS_A083_CTR_REQUEST_POS_CLOSED_NEG_OPEN" 1 "BMS_A083_CTR_REQUEST_NEG_CLOSED_POS_OPEN" 0 "BMS_A083_CTR_REQUEST_SNA" ;
VAL_TABLE_ BMS_a090_GTWmessageTout 9 "BMS_A090_UI_TRIPPLANNING" 8 "BMS_A090_MCU_DRIVERLIMITS" 7 "BMS_A090_GTW_CARCONFIG2" 6 "BMS_A090_GTW_12VSTATUS" 5 "BMS_A090_MCU_ODOMETER" 4 "BMS_A090_GTW_CARCONFIG" 3 "BMS_A090_GTW_PTNM" 2 "BMS_A090_GTW_BODYSTATUS" 1 "BMS_A090_MCU_POWER" 0 "BMS_A090_GTW_COMMANDS" ;
VAL_TABLE_ BMS_a099_bmbChainBreakType 5 "BMS_A099_TAIL_BREAK" 4 "BMS_A099_HEAD_BREAK" 3 "BMS_A099_INVALID_BREAK" 2 "BMS_A099_DOUBLE_BREAK" 1 "BMS_A099_SINGLE_BREAK" 0 "BMS_A099_NONE" ;
VAL_TABLE_ BMS_a126_thermistorFailureType 2 "BMS_A126_THERMISTOR_UNUSED" 1 "BMS_A126_THERMISTOR_FAILED_OPEN" 0 "BMS_A126_THERMISTOR_UNKNOWN" ;
VAL_TABLE_ BMS_a130_canBus 3 "BMS_A130_HVI_CAN" 2 "BMS_A130_HVS_CAN" 1 "BMS_A130_VEH_CAN" 0 "BMS_A130_NONE" ;
VAL_TABLE_ BMS_a130_errorType 16 "BMS_A130_CAN_ERROR" 15 "BMS_A130_CAN_ERROR_NOTIFY_FAILURE" 14 "BMS_A130_CAN_ERROR_NAK" 13 "BMS_A130_CAN_ERROR_QUEUE_FULL" 12 "BMS_A130_CAN_ERROR_UNUSED_CAN_BUS" 11 "BMS_A130_CAN_ERROR_MBOX" 10 "BMS_A130_CAN_ERROR_OVERRUN" 9 "BMS_A130_CAN_ERROR_CHECKSUM" 8 "BMS_A130_CAN_ERROR_DATA" 7 "BMS_A130_CAN_ERROR_LENGTH" 6 "BMS_A130_CAN_ERROR_RX" 5 "BMS_A130_CAN_ERROR_TX_FAILURE" 4 "BMS_A130_CAN_ERROR_INVALID_MBOX" 3 "BMS_A130_CAN_ERROR_INVALID_BUS" 2 "BMS_A130_CAN_ERROR_INIT_BUS_FAILURE" 1 "BMS_A130_CAN_ERROR_INIT_FAILURE" 0 "BMS_A130_CAN_SUCCESS" ;
VAL_TABLE_ BMS_a135_bmbDiagnosticsType 3 "BMS_A135_UNUSED" 2 "BMS_A135_BMB_DIAG_TEST5" 1 "BMS_A135_BMB_DIAG_TESTA" 0 "BMS_A135_BMB_DIAG_NONE" ;
VAL_TABLE_ BMS_alerts 180 "BMS_a180_SW_ECU_reset_blocked" 179 "BMS_a179_HvpGpoRequestActive" 178 "BMS_a178_SW_Uncontrolled_Regen_PwrB" 177 "BMS_a177_SW_Energy_Buffer_Size" 176 "BMS_a176_SW_GracefulPowerOff" 175 "BMS_a175_Charge_Failure_External" 174 "BMS_a174_SW_Charge_Failure" 172 "BMS_a172_SW_Isolation_Failure_In_Drive_Warning" 171 "BMS_a171_SW_Stack_Voltage_Sense" 170 "BMS_a170_SW_Limp_Mode" 169 "BMS_a169_SW_FC_Pack_Weld" 168 "BMS_a168_SW_FC_Full_Weld" 167 "BMS_a167_SW_FC_Partial_Weld" 166 "BMS_a166_SW_Pack_Full_Weld" 165 "BMS_a165_SW_Pack_Partial_Weld" 164 "BMS_a164_SW_Uncontrolled_Regen" 162 "BMS_a162_SW_No_Power_For_Support" 161 "BMS_a161_SW_BMB_Vref_warning" 160 "BMS_a160_SW_FC_Ctr_Clean_Failed" 159 "BMS_a159_SW_HVP_ECU_Error" 158 "BMS_a158_SW_HVP_HVI_Comms" 157 "BMS_a157_SW_Hist_Update_Missed" 156 "BMS_a156_SW_BMB_Vref_bad" 155 "BMS_a155_SW_Weak_short_impedence" 152 "BMS_a152_Isolation_In_Dc_Charge" 151 "BMS_a151_SW_external_isolation" 150 "BMS_a150_SW_Missing_Part_Number" 149 "BMS_a149_SW_Missing_Config_Block" 147 "BMS_a147_SW_SOC_High_Ah_Error" 146 "BMS_a146_SW_Brick_Overdischarged" 145 "BMS_a145_SW_SOC_Change" 144 "BMS_a144_Hvp_Config_Mismatch" 143 "BMS_a143_SW_CAC_Change" 142 "BMS_a142_SW_Isolation_Degradation" 141 "BMS_a141_SW_BMB_Status_Warning" 140 "BMS_a140_HW_BMB_Status_Fault" 139 "BMS_a139_SW_DC_Link_V_Irrational" 138 "BMS_a138_SW_Brick_OV_Warning" 137 "BMS_a137_SW_Brick_UV_Warning" 136 "BMS_a136_SW_Module_OT_Warning" 135 "BMS_a135_HW_BMB_Diagnostics_Failure" 134 "BMS_a134_SW_Delayed_Ctr_Off" 133 "BMS_a133_IO_CAN_Bus_Off" 132 "BMS_a132_HW_BMB_OTP_Uncorrctbl" 131 "BMS_a131_Bleed_FET_Failure" 130 "BMS_a130_IO_CAN_Error" 129 "BMS_a129_SW_VSH_Failure" 128 "BMS_a128_SW_shunt_MIA" 127 "BMS_a127_SW_shunt_SNA" 126 "BMS_a126_SW_Thermistor_Failure" 123 "BMS_a123_SW_Internal_Isolation" 122 "BMS_a122_SW_BMS_Therm_Irrational" 121 "BMS_a121_SW_NVRAM_Config_Error" 118 "BMS_a118_SW_SOC_Balance_Required" 117 "BMS_a117_SW_Delta_SOC_Weak_Short" 109 "BMS_a109_HW_BMB_Mute_Status_Mismatch" 108 "BMS_a108_SW_BMB_Device_OT" 107 "BMS_a107_SW_Stack_Voltage_MIA" 106 "BMS_a106_SW_All_Module_Tsense" 105 "BMS_a105_SW_One_Module_Tsense" 99 "BMS_a099_SW_BMB_Communication" 98 "BMS_a098_SW_BMB_Data_Integrity_Loss" 95 "BMS_a095_SW_UI_MIA" 94 "BMS_a094_SW_Drive_Inverter_MIA" 92 "BMS_a092_SW_ChargePort_Mia_On_Hvs" 91 "BMS_a091_SW_ChargePort_MIA" 90 "BMS_a090_SW_Gateway_MIA" 89 "BMS_a089_SW_VcFront_MIA" 88 "BMS_a088_SW_VcFront_MIA_InDrive" 87 "BMS_a087_SW_Feim_Test_Blocked" 86 "BMS_a086_SW_FC_Contactor_Mismatch" 85 "BMS_a085_SW_Pack_Contactor_Mismatch" 84 "BMS_a084_SW_Sleep_Wake_Aborted" 83 "BMS_a083_SW_Ctr_Close_Failure" 82 "BMS_a082_SW_Ctr_Force_Open" 81 "BMS_a081_SW_Ctr_Close_Blocked" 80 "BMS_a080_SW_Pack_Ctr_Impedance" 78 "BMS_a078_Rapid_Dch_While_Charging" 77 "BMS_a077_SW_Charger_Regulation" 76 "BMS_a076_SW_Dch_While_Charging" 75 "BMS_a075_SW_Chg_Disable_Failure" 74 "BMS_a074_Max_Charge_Level_Limited" 71 "BMS_a071_SW_SM_TransCon_Not_Met" 70 "BMS_a070_BrickV_Imbalance_Limiting" 69 "BMS_a069_SW_Low_Power" 68 "BMS_a068_CAC_Imbalance_Limp" 67 "BMS_a067_CAC_Imbalance_Limiting" 66 "BMS_a066_SOC_Imbalance_Warning" 65 "BMS_a065_SW_CAC_Imbalance" 64 "BMS_a064_SW_SOC_Imbalance" 63 "BMS_a063_SW_ChargePort_Fault" 62 "BMS_a062_SW_BrickV_Imbalance" 61 "BMS_a061_SW_BrickV_Change" 60 "BMS_a060_SW_Leakage_Test_Failure" 59 "BMS_a059_SW_Pack_Voltage_Sensing" 58 "BMS_a058_SW_Bandolier_Model_Reset" 57 "BMS_a057_SW_Bandolier_Model_Warning" 56 "BMS_a056_SW_Standby_Supply_Fault" 55 "BMS_a055_SW_HvChain_Model_Fault" 54 "BMS_a054_SW_Ver_Supply_Fault" 52 "BMS_a052_SW_PCS_MIA" 51 "BMS_a051_SW_HVC_Vref_Bad" 50 "BMS_a050_SW_Brick_Voltage_MIA" 49 "BMS_a049_SW_Thermal_Event" 47 "BMS_a047_SW_Task_Stack_Overflow" 46 "BMS_a046_SW_Task_Stack_Usage" 45 "BMS_a045_SW_Exception" 44 "BMS_a044_SW_Assertion" 43 "BMS_a043_SW_Watch_Dog_Reset" 42 "BMS_a042_SW_MPU_Error" 41 "BMS_a041_SW_Destructive_Reset_Source" 40 "BMS_a040_SW_Watch_Dog_HW_Triggered" 39 "BMS_a039_SW_DC_Link_Over_Voltage" 37 "BMS_a037_SW_Flood_Port_Open" 36 "BMS_a036_SW_HvpHvilFault" 35 "BMS_a035_SW_Isolation" 34 "BMS_a034_SW_Passive_Isolation" 30 "BMS_a030_Impedance_Deviation" 29 "BMS_a029_dSoc_Limiting" 27 "BMS_a027_SW_Repeated_Isolation_Failure_In_Drive" 26 "BMS_a026_SW_HFCurrent_Anomaly" 25 "BMS_a025_SW_PwrBalance_Anomaly" 24 "BMS_a024_SW_Islanded_Brick" 23 "BMS_a023_SW_Stack_OV" 22 "BMS_a022_SW_Over_Current" 21 "BMS_a021_SW_Dr_Limits_Regulation" 20 "BMS_a020_SW_Brick_Instability" 19 "BMS_a019_SW_Module_OT" 18 "BMS_a018_SW_Brick_UV" 17 "BMS_a017_SW_Brick_OV" 16 "BMS_a016_Pack_Module_Id_Mismatch" 7 "BMS_a007_SW_Slowed_Chg_Batt_Cold" 4 "BMS_a004_SW_Incomplete_Hot_Seal_Test" 3 "BMS_a003_SW_Pack_Birth_Date_Missing" 2 "BMS_a002_Pack_Performance_Config_Mismatch" 1 "BMS_a001_Pack_Config_Mismatch" 0 "BMS_ALERT_DO_NOT_USE_ZERO" 97 "BMS_a097_SW_BMB_Over_CAN_Communication" 72 "BMS_a072_CAC_Imbalance_On_Edge_Brick" ;
VAL_TABLE_ BMS_alphaState 6 "ALPHA_STATE_POST_SNAPSHOT" 5 "ALPHA_STATE_FILTERING" 4 "ALPHA_STATE_WAIT" 3 "ALPHA_STATE_RESTED" 2 "ALPHA_STATE_RESTING" 1 "ALPHA_STATE_OFF" 0 "ALPHA_STATE_SNA" ;
VAL_TABLE_ BMS_assertFile 5 "BMS_BALANCE_MODULE" 4 "BMS_ACCUMULATOR_MODULE" 3 "BMS_CHARGE_REGULATION_MODULE" 2 "BMS_CAC_COMPONENT" 1 "BMS_BRICK_MODULE" 0 "BMS_ENERGY_MODULE" ;
VAL_TABLE_ BMS_balanceState 12 "BALANCE_STATE_VSH_TEST" 11 "BALANCE_STATE_VSH_2" 10 "BALANCE_STATE_VSH_1" 9 "BALANCE_STATE_VSH_0" 8 "BALANCE_STATE_VSH_OFF" 7 "BALANCE_STATE_BALANCE_INIT" 6 "BALANCE_STATE_VSH_TEST_COMPLETE" 5 "BALANCE_STATE_VSH_ODD_WAIT" 4 "BALANCE_STATE_VSH_ODD_ON" 3 "BALANCE_STATE_VSH_EVEN_WAIT" 2 "BALANCE_STATE_VSH_EVEN_ON" 1 "BALANCE_STATE_BALANCE_ACTIVE" 0 "BALANCE_STATE_STANDBY" ;
VAL_TABLE_ BMS_bandoThmModelState 7 "BANDO_MODEL_STATE_REINIT" 6 "BANDO_MODEL_STATE_FAULT" 5 "BANDO_MODEL_STATE_ACTIVE" 4 "BANDO_MODEL_STATE_FIRST_CHECK" 3 "BANDO_MODEL_STATE_PREPARING" 2 "BANDO_MODEL_STATE_INIT" 1 "BANDO_MODEL_STATE_OFF" 0 "BANDO_MODEL_STATE_SNA" ;
VAL_TABLE_ BMS_battTempPct 255 "SNA" ;
VAL_TABLE_ BMS_beginningOfLifePackEnergy 1023 "SNA" ;
VAL_TABLE_ BMS_bmbDieTemperatureMeasurementsMux 2 "Mux2" 1 "Mux1" 0 "Mux0" ;
VAL_TABLE_ BMS_bmbMinMax_ID 2 "BMB_END" 1 "BMB_VOLT_MUX1" 0 "BMB_THERM_MUX0" ;
VAL_TABLE_ BMS_brickMeasurementsMux 35 "Mux35" 34 "Mux34" 33 "Mux33" 32 "Mux32" 31 "Mux31" 30 "Mux30" 29 "Mux29" 28 "Mux28" 27 "Mux27" 26 "Mux26" 25 "Mux25" 24 "Mux24" 23 "Mux23" 22 "Mux22" 21 "Mux21" 20 "Mux20" 19 "Mux19" 18 "Mux18" 17 "Mux17" 16 "Mux16" 15 "Mux15" 14 "Mux14" 13 "Mux13" 12 "Mux12" 11 "Mux11" 10 "Mux10" 9 "Mux9" 8 "Mux8" 7 "Mux7" 6 "Mux6" 5 "Mux5" 4 "Mux4" 3 "Mux3" 2 "Mux2" 1 "Mux1" 0 "Mux0" ;
VAL_TABLE_ BMS_cacBrick1 8191 "SNA" ;
VAL_TABLE_ BMS_cacBrick10 8191 "SNA" ;
VAL_TABLE_ BMS_cacBrick100 8191 "SNA" ;
VAL_TABLE_ BMS_cacBrick101 8191 "SNA" ;
VAL_TABLE_ BMS_cacBrick102 8191 "SNA" ;
VAL_TABLE_ BMS_cacBrick103 8191 "SNA" ;
VAL_TABLE_ BMS_cacBrick104 8191 "SNA" ;
VAL_TABLE_ BMS_cacBrick105 8191 "SNA" ;
VAL_TABLE_ BMS_cacBrick106 8191 "SNA" ;
VAL_TABLE_ BMS_cacBrick107 8191 "SNA" ;
VAL_TABLE_ BMS_cacBrick108 8191 "SNA" ;
VAL_TABLE_ BMS_cacBrick11 8191 "SNA" ;
VAL_TABLE_ BMS_cacBrick12 8191 "SNA" ;
VAL_TABLE_ BMS_cacBrick13 8191 "SNA" ;
VAL_TABLE_ BMS_cacBrick14 8191 "SNA" ;
VAL_TABLE_ BMS_cacBrick15 8191 "SNA" ;
VAL_TABLE_ BMS_cacBrick16 8191 "SNA" ;
VAL_TABLE_ BMS_cacBrick17 8191 "SNA" ;
VAL_TABLE_ BMS_cacBrick18 8191 "SNA" ;
VAL_TABLE_ BMS_cacBrick19 8191 "SNA" ;
VAL_TABLE_ BMS_cacBrick2 8191 "SNA" ;
VAL_TABLE_ BMS_cacBrick20 8191 "SNA" ;
VAL_TABLE_ BMS_cacBrick21 8191 "SNA" ;
VAL_TABLE_ BMS_cacBrick22 8191 "SNA" ;
VAL_TABLE_ BMS_cacBrick23 8191 "SNA" ;
VAL_TABLE_ BMS_cacBrick24 8191 "SNA" ;
VAL_TABLE_ BMS_cacBrick25 8191 "SNA" ;
VAL_TABLE_ BMS_cacBrick26 8191 "SNA" ;
VAL_TABLE_ BMS_cacBrick27 8191 "SNA" ;
VAL_TABLE_ BMS_cacBrick28 8191 "SNA" ;
VAL_TABLE_ BMS_cacBrick29 8191 "SNA" ;
VAL_TABLE_ BMS_cacBrick3 8191 "SNA" ;
VAL_TABLE_ BMS_cacBrick30 8191 "SNA" ;
VAL_TABLE_ BMS_cacBrick31 8191 "SNA" ;
VAL_TABLE_ BMS_cacBrick32 8191 "SNA" ;
VAL_TABLE_ BMS_cacBrick33 8191 "SNA" ;
VAL_TABLE_ BMS_cacBrick34 8191 "SNA" ;
VAL_TABLE_ BMS_cacBrick35 8191 "SNA" ;
VAL_TABLE_ BMS_cacBrick36 8191 "SNA" ;
VAL_TABLE_ BMS_cacBrick37 8191 "SNA" ;
VAL_TABLE_ BMS_cacBrick38 8191 "SNA" ;
VAL_TABLE_ BMS_cacBrick39 8191 "SNA" ;
VAL_TABLE_ BMS_cacBrick4 8191 "SNA" ;
VAL_TABLE_ BMS_cacBrick40 8191 "SNA" ;
VAL_TABLE_ BMS_cacBrick41 8191 "SNA" ;
VAL_TABLE_ BMS_cacBrick42 8191 "SNA" ;
VAL_TABLE_ BMS_cacBrick43 8191 "SNA" ;
VAL_TABLE_ BMS_cacBrick44 8191 "SNA" ;
VAL_TABLE_ BMS_cacBrick45 8191 "SNA" ;
VAL_TABLE_ BMS_cacBrick46 8191 "SNA" ;
VAL_TABLE_ BMS_cacBrick47 8191 "SNA" ;
VAL_TABLE_ BMS_cacBrick48 8191 "SNA" ;
VAL_TABLE_ BMS_cacBrick49 8191 "SNA" ;
VAL_TABLE_ BMS_cacBrick5 8191 "SNA" ;
VAL_TABLE_ BMS_cacBrick50 8191 "SNA" ;
VAL_TABLE_ BMS_cacBrick51 8191 "SNA" ;
VAL_TABLE_ BMS_cacBrick52 8191 "SNA" ;
VAL_TABLE_ BMS_cacBrick53 8191 "SNA" ;
VAL_TABLE_ BMS_cacBrick54 8191 "SNA" ;
VAL_TABLE_ BMS_cacBrick55 8191 "SNA" ;
VAL_TABLE_ BMS_cacBrick56 8191 "SNA" ;
VAL_TABLE_ BMS_cacBrick57 8191 "SNA" ;
VAL_TABLE_ BMS_cacBrick58 8191 "SNA" ;
VAL_TABLE_ BMS_cacBrick59 8191 "SNA" ;
VAL_TABLE_ BMS_cacBrick6 8191 "SNA" ;
VAL_TABLE_ BMS_cacBrick60 8191 "SNA" ;
VAL_TABLE_ BMS_cacBrick61 8191 "SNA" ;
VAL_TABLE_ BMS_cacBrick62 8191 "SNA" ;
VAL_TABLE_ BMS_cacBrick63 8191 "SNA" ;
VAL_TABLE_ BMS_cacBrick64 8191 "SNA" ;
VAL_TABLE_ BMS_cacBrick65 8191 "SNA" ;
VAL_TABLE_ BMS_cacBrick66 8191 "SNA" ;
VAL_TABLE_ BMS_cacBrick67 8191 "SNA" ;
VAL_TABLE_ BMS_cacBrick68 8191 "SNA" ;
VAL_TABLE_ BMS_cacBrick69 8191 "SNA" ;
VAL_TABLE_ BMS_cacBrick7 8191 "SNA" ;
VAL_TABLE_ BMS_cacBrick70 8191 "SNA" ;
VAL_TABLE_ BMS_cacBrick71 8191 "SNA" ;
VAL_TABLE_ BMS_cacBrick72 8191 "SNA" ;
VAL_TABLE_ BMS_cacBrick73 8191 "SNA" ;
VAL_TABLE_ BMS_cacBrick74 8191 "SNA" ;
VAL_TABLE_ BMS_cacBrick75 8191 "SNA" ;
VAL_TABLE_ BMS_cacBrick76 8191 "SNA" ;
VAL_TABLE_ BMS_cacBrick77 8191 "SNA" ;
VAL_TABLE_ BMS_cacBrick78 8191 "SNA" ;
VAL_TABLE_ BMS_cacBrick79 8191 "SNA" ;
VAL_TABLE_ BMS_cacBrick8 8191 "SNA" ;
VAL_TABLE_ BMS_cacBrick80 8191 "SNA" ;
VAL_TABLE_ BMS_cacBrick81 8191 "SNA" ;
VAL_TABLE_ BMS_cacBrick82 8191 "SNA" ;
VAL_TABLE_ BMS_cacBrick83 8191 "SNA" ;
VAL_TABLE_ BMS_cacBrick84 8191 "SNA" ;
VAL_TABLE_ BMS_cacBrick85 8191 "SNA" ;
VAL_TABLE_ BMS_cacBrick86 8191 "SNA" ;
VAL_TABLE_ BMS_cacBrick87 8191 "SNA" ;
VAL_TABLE_ BMS_cacBrick88 8191 "SNA" ;
VAL_TABLE_ BMS_cacBrick89 8191 "SNA" ;
VAL_TABLE_ BMS_cacBrick9 8191 "SNA" ;
VAL_TABLE_ BMS_cacBrick90 8191 "SNA" ;
VAL_TABLE_ BMS_cacBrick91 8191 "SNA" ;
VAL_TABLE_ BMS_cacBrick92 8191 "SNA" ;
VAL_TABLE_ BMS_cacBrick93 8191 "SNA" ;
VAL_TABLE_ BMS_cacBrick94 8191 "SNA" ;
VAL_TABLE_ BMS_cacBrick95 8191 "SNA" ;
VAL_TABLE_ BMS_cacBrick96 8191 "SNA" ;
VAL_TABLE_ BMS_cacBrick97 8191 "SNA" ;
VAL_TABLE_ BMS_cacBrick98 8191 "SNA" ;
VAL_TABLE_ BMS_cacBrick99 8191 "SNA" ;
VAL_TABLE_ BMS_cacReferencePtId 3 "BMS_CAC_INVALID_POINT" 2 "BMS_CAC_CANDIDATE_POINT_2" 1 "BMS_CAC_CANDIDATE_POINT_1" 0 "BMS_CAC_INITIAL_POINT" ;
VAL_TABLE_ BMS_chargeNeededReason 6 "BMS_BRICKV_LESS_THAN_FULL_CHARGE" 4 "BMS_CABLE_CYCLE_TOP_OFF" 3 "BMS_CHARGE_TARGET_INCREASED" 2 "BMS_DCH_KWH_THRESHOLD" 1 "BMS_SOC_LESS_THAN_UI_THRESHOLD" 0 "BMS_NO_CHARGE_REASON" ;
VAL_TABLE_ BMS_chargeState 7 "CHARGE_STATE_AC_DISABLE_PCS" 6 "CHARGE_STATE_DC_DISABLING_CHARGER" 5 "CHARGE_STATE_CHARGING_ACTIVE" 4 "CHARGE_STATE_AC_ENABLE_PCS" 3 "CHARGE_STATE_DC_ENABLE_FCLINK" 2 "CHARGE_STATE_DC_EXT_ISO_CHECK" 1 "CHARGE_STATE_ENABLE_DCLINK" 0 "CHARGE_STATE_INACTIVE" ;
VAL_TABLE_ BMS_chargeType 1 "BMS_AC_CHARGE_SESSION" 0 "BMS_DC_CHARGE_SESSION" ;
VAL_TABLE_ BMS_chgCurrentLimitMode 18 "CHG_LIMIT_LIMP_MODE" 17 "CHG_LIMIT_MISSING_CELL" 16 "CHG_LIMIT_CAC_IMBALANCE" 15 "CHG_LIMIT_PCS_IMPLICIT" 14 "CHG_LIMIT_EVSE_IMPLICIT" 13 "CHG_LIMIT_RAMP_UP_PHASE" 12 "CHG_LIMIT_HVAC_COOLING" 11 "CHG_LIMIT_HV_CHAIN" 10 "CHG_LIMIT_CONFIG" 9 "CHG_LIMIT_TETHERING" 8 "CHG_LIMIT_LEAKY_BUCKET" 7 "CHG_LIMIT_BRICK_VOLTAGE_REG" 6 "CHG_LIMIT_BRICK_TEMP_TOO_COLD" 5 "CHG_LIMIT_BRICK_TEMP_TOO_HOT" 4 "CHG_LIMIT_BRICK_TEMP_OPTIMAL_CELL_PROFILE" 3 "CHG_LIMIT_CP" 2 "CHG_LIMIT_PCS" 1 "CHG_LIMIT_EVSE" 0 "CHG_LIMIT_NONE" ;
VAL_TABLE_ BMS_chgPhase 2 "BMS_CHG_PHASE_HIGH_SOC_MAX_I" 1 "BMS_CHG_PHASE_BULK_CONSTANT_CURRENT" 0 "BMS_CHG_PHASE_IDLE" ;
VAL_TABLE_ BMS_chgPowerAvailable 2047 "SNA" ;
VAL_TABLE_ BMS_chgTerminationVMode 1 "BMS_CHG_TERM_V_MODE_TEMP_LOOKUP" 0 "BMS_CHG_TERM_V_MODE_STANDARD" ;
VAL_TABLE_ BMS_chgTimeToFull 4095 "SNA" ;
VAL_TABLE_ BMS_contactorState 6 "BMS_CTRSET_BLOCKED" 5 "BMS_CTRSET_WELDED" 4 "BMS_CTRSET_CLOSED" 3 "BMS_CTRSET_CLOSING" 2 "BMS_CTRSET_OPENING" 1 "BMS_CTRSET_OPEN" 0 "BMS_CTRSET_SNA" ;
VAL_TABLE_ BMS_cpChargeStatus 5 "BMS_CHARGING_UPDATE_IN_PROGRESS" 4 "BMS_CHARGING_ENABLING" 3 "BMS_CHARGING_FAULT" 2 "BMS_CHARGING_COMPLETE" 1 "BMS_CHARGING_ACTIVE" 0 "BMS_CHARGING_INACTIVE" ;
VAL_TABLE_ BMS_currentUnfiltered -32768 "SNA" ;
VAL_TABLE_ BMS_dbgHvilCoverVSense 65535 "SNA" ;
VAL_TABLE_ BMS_dbgStandbySupplyOutV 65535 "SNA" ;
VAL_TABLE_ BMS_debugInfo_100HzMux 9 "BMS_100HZ_DBG_BRICK_OCV_AND_DISSIPATION_STATS" 8 "BMS_100HZ_DBG_VOLTAGE_INSTABILITY" 7 "BMS_100HZ_DBG_SOC_BY_DV" 6 "BMS_100HZ_DBG_CAN_BUS_STATUS" 5 "BMS_100HZ_DBG_BMS_ENERGY_1" 4 "BMS_100HZ_DBG_BMS_ENERGY_0" 3 "BMS_100HZ_DBG_BMS_STATE_FLAGS" 2 "BMS_100HZ_DBG_CHARGING" 1 "BMS_100HZ_DBG_CHARGE_IREG_0" 0 "BMS_100HZ_DBG_CHARGE_VREG_0" ;
VAL_TABLE_ BMS_debugInfo_10HzMux 33 "BMS_10HZ_DBG_THM_TARGETS" 32 "BMS_10HZ_DBG_SOC_BY_AH" 31 "BMS_10HZ_DBG_DRIVE_LIMITS" 30 "BMS_10HZ_DBG_STANDBY_SUPPLY" 29 "BMS_10HZ_DBG_SLEEP_WAKE" 28 "BMS_10HZ_DBG_POWER_PREDICTION_3" 27 "BMS_10HZ_DBG_POWER_PREDICTION_2" 26 "BMS_10HZ_DBG_POWER_PREDICTION_1" 25 "BMS_10HZ_DBG_ADC_FLOOD" 24 "BMS_10HZ_DBG_ADC_MISC" 23 "BMS_10HZ_DBG_ADC_DCLINK" 22 "BMS_10HZ_DBG_ADC_CP" 21 "BMS_10HZ_DBG_ADC_VREF" 20 "BMS_10HZ_DBG_WAKE_TIMERS" 19 "BMS_10HZ_DBG_CAC_3" 18 "BMS_10HZ_DBG_CAC_2" 17 "BMS_10HZ_DBG_CAC_1" 16 "BMS_10HZ_DBG_HYST" 15 "BMS_10HZ_DBG_PACK_VOLTAGES" 14 "BMS_10HZ_DBG_THM_MODEL_DATA_11" 13 "BMS_10HZ_DBG_THM_MODEL_DATA_10" 12 "BMS_10HZ_DBG_THM_MODEL_DATA_9" 3 "BMS_10HZ_DBG_SOC_RESTING" 2 "BMS_10HZ_DBG_ISOLATION" 1 "BMS_10HZ_DBG_AHR_COUNTER" 0 "BMS_10HZ_DBG_STATE" ;
VAL_TABLE_ BMS_driveGainKi 2047 "SNA" ;
VAL_TABLE_ BMS_driveGainKp 1023 "SNA" ;
VAL_TABLE_ BMS_dynamicEnergyBuffer 1023 "SNA" ;
VAL_TABLE_ BMS_energyBuffer 255 "SNA" ;
VAL_TABLE_ BMS_energyToChargeComplete 2047 "SNA" ;
VAL_TABLE_ BMS_energyWalkId 5 "BMS_ENERGY_WALK_INVALID" 4 "BMS_ENERGY_WALK_DISCHARGE_FLOOR" 3 "BMS_ENERGY_WALK_DISCHARGE_IDEAL" 2 "BMS_ENERGY_WALK_DISCHARGE_CHARGE_TARGET" 1 "BMS_ENERGY_WALK_DISCHARGE_FULL_PACK" 0 "BMS_ENERGY_WALK_DISCHARGE_NOMINAL" ;
VAL_TABLE_ BMS_expectedEnergyRemaining 2047 "SNA" ;
VAL_TABLE_ BMS_fcLinkTestDecayTime 1023 "SNA" ;
VAL_TABLE_ BMS_fcLinkTestStatus 4 "FC_LINK_TEST_RETRY" 3 "FC_LINK_TEST_FAILED" 2 "FC_LINK_TEST_PASSED" 1 "FC_LINK_TEST_IN_PROGRESS" 0 "FC_LINK_TEST_NOT_RUN" ;
VAL_TABLE_ BMS_floodPortState 4 "FLOOD_PORT_STATE_ERROR_HIGH" 3 "FLOOD_PORT_STATE_OPEN" 2 "FLOOD_PORT_STATE_CLOSED" 1 "FLOOD_PORT_STATE_ERROR_LOW" 0 "FLOOD_PORT_STATE_SNA" ;
VAL_TABLE_ BMS_histogramId 8 "HIST_ID_SNA" 7 "SOC_TOP_VS_SOC_BTM_ACCUM_ENERGY_DCH" 6 "ENERGY_DC_CHG_WH_PER_DAY_ACCUM_TIME" 5 "ENERGY_CHG_WH_PER_DAY_ACCUM_TIME" 4 "TEMP_VS_VOLTAGE_ACCUM_ENERGY_DC_CHG" 3 "PWR_VS_VOLTAGE_ACCUM_ENERGY_CHG" 2 "TEMP_VS_SOC_ACCUM_ENERGY_CHG" 1 "TEMP_VS_SOC_ACCUM_ENERGY_DCH" 0 "TEMP_VS_SOC_ACCUM_TIME" ;
VAL_TABLE_ BMS_hvChain_iLimit 16383 "SNA" ;
VAL_TABLE_ BMS_hvChain_limitingState 64 "PACK_AIR_FRONT" 63 "PACK_AIR_REAR" 62 "PACK_TRAY_FRONT" 61 "PACK_TRAY_REAR" 60 "FC_CON_BUS_NEG" 59 "FC_BUS_NEG" 58 "FC_CONT_JMP_NEG_T1" 57 "FC_CONT_NEG_MOV" 56 "FC_CONT_JMP_NEG_T2" 55 "FC_REAR_BUS_NEG" 54 "RDUL_CON_BUS_NEG_1" 53 "REAR_BUS_NEG_2" 52 "RDUR_CON_BUS_NEG_1" 51 "SPINE_NEG_1" 50 "SPINE_NEG_FLEX" 49 "FDU_BUS_NEG" 48 "FDU_CON_NEG" 47 "CONT_BUS_NEG" 46 "CONT_PYRO_BUS" 45 "PYRO_SHUNT_BUS_1" 44 "PYRO_SHUNT_BUS_2" 43 "PYRO_BUS" 42 "MOD_TMNL_BULK_NEG" 40 "MOD_TMNL_BAR_NEG" 39 "MOD_CC_NEG" 38 "MOD_CC_POS" 37 "MOD_TMNL_BAR_POS" 36 "MOD_TMNL_ARM_POS" 35 "MOD_TMNL_BULK_POS" 34 "BOLT_21" 33 "CONT_BUS_POS" 32 "REAR_BUS_POS" 31 "RDUR_BUS_CON_POS" 30 "RDUL_CON_POS" 29 "SPINE_POS_1" 28 "SPINE_POS_FLEX" 27 "FDU_BUS_POS" 26 "FDU_CON_BUS_POS" 25 "FC_REAR_BUS_POS" 24 "FC_CONT_JMP_POS_T2" 23 "FC_CONT_POS_MOV" 22 "FC_CONT_JMP_POS_T1" 21 "FC_BUS_POS" 20 "FC_CON_BUS_POS" 19 "FC_CONT_BODY_NEG" 18 "FC_CONT_BODY_POS" 17 "CONT_BODY_NEG" 16 "CONT_BODY_POS" 15 "HP_CONT_NEG_PYRO" 14 "HP_SHUNT" 13 "HP_CONT_POS" 12 "CURRENT_COLLECTOR_LIMITING" 11 "CHG_CABLE_LIMITING" 10 "PENTHOUSE_AMB_LIMITING" 9 "RDU_CABLE_LIMITING" 8 "FDU_CABLE_LIMITING" 7 "NEG_CHG_CTR_LIMITING" 6 "NEG_SWITCH_LIMITING" 5 "BUSBAR_RDU_LIMITING" 4 "THREE_WAY_BUSBAR_LIMITING" 3 "SHUNT_LIMITING" 2 "BUSBAR_1_2_LIMITING" 1 "HV_CHAIN_LIMITING_NONE" 0 "HV_CHAIN_LIMITING_UNKNOWN" ;
VAL_TABLE_ BMS_hvChain_limitingStateTemperature -4096 "SNA" ;
VAL_TABLE_ BMS_hvChargeStatus 7 "BMS_CHARGE_FAULTED" 6 "BMS_EMERGENCY_SHUTDOWN" 5 "BMS_GRACEFUL_SHUTDOWN" 4 "BMS_CHARGE_ENABLED" 3 "BMS_CHARGE_ENABLING" 2 "BMS_EXT_PRECHARGE_ALLOWED" 1 "BMS_EXT_EVSE_TEST_ALLOWED" 0 "BMS_CHARGE_STANDBY" ;
VAL_TABLE_ BMS_hvilCoverVSense 65535 "SNA" ;
VAL_TABLE_ BMS_idealEnergyFloor 1023 "SNA" ;
VAL_TABLE_ BMS_idealEnergyRemaining 2047 "SNA" ;
VAL_TABLE_ BMS_impedanceDevDeltaCurrent 4095 "SNA" ;
VAL_TABLE_ BMS_impedanceDeviationState 1 "SNAPSHOT_1_VALID" 0 "INIT" ;
VAL_TABLE_ BMS_internalHvilSenseV 65535 "SNA" ;
VAL_TABLE_ BMS_isoSensorState 1 "SENSOR_ENABLED" 0 "SENSOR_DISABLED" ;
VAL_TABLE_ BMS_isolationMode 5 "ISO_FEIM_POSITIVE_MODE" 4 "ISO_FEIM_NEGATIVE_MODE" 3 "ISO_VEHICLE_ISOLATION_MODE" 2 "ISO_POSITIVE_ISOLATION_MODE" 1 "ISO_NEGATIVE_ISOLATION_MODE" 0 "ISO_MODE_RESET" 6 "ISO_VOLTAGE_SETTLING_MODE" ;
VAL_TABLE_ BMS_isolationResistance 1023 "SNA" ;
VAL_TABLE_ BMS_isolationSensorState 4 "ISO_TEST_COMPLETE" 3 "ISO_SAMPLE_POST_ISO_VOLTAGES" 2 "ISO_ACTIVATE_ISOLATION_RESISTOR" 1 "ISO_SAMPLE_PRE_ISO_VOLTAGES" 0 "ISO_INITIALIZE_ISO_TEST" ;
VAL_TABLE_ BMS_kwh_Counter_ID 14 "BMS_KWH_COUNTER_END" 13 "BMS_KWH_COUNTER_MUX13" 12 "BMS_KWH_COUNTER_MUX12" 11 "BMS_KWH_COUNTER_MUX11" 10 "BMS_KWH_COUNTER_MUX10" 9 "BMS_KWH_COUNTER_MUX9" 8 "BMS_KWH_COUNTER_MUX8" 7 "BMS_KWH_COUNTER_MUX7" 6 "BMS_KWH_COUNTER_MUX6" 5 "BMS_KWH_COUNTER_MUX5" 4 "BMS_KWH_COUNTER_MUX4" 3 "BMS_KWH_COUNTER_MUX3" 2 "BMS_KWH_COUNTER_MUX2" 1 "BMS_KWH_COUNTER_MUX1" 0 "BMS_KWH_COUNTER_MUX0" ;
VAL_TABLE_ BMS_log1Mux 18 "BMS_LOG1_PACK_DATA" 17 "BMS_LOG1_IMPEDANCE_DEVIATION_2" 16 "BMS_LOG1_IMPEDANCE_DEVIATION_1" 15 "BMS_LOG1_SOC_BY_DELTA_V_2" 14 "BMS_LOG1_SOC_BY_DELTA_V_1" 13 "BMS_LOG1_CHARGE_REGULATION" 12 "BMS_LOG1_CHARGE_TERMINATION" 11 "BMS_LOG1_BANDOLIER_MODEL_THERMISTOR_TEMPS" 10 "BMS_LOG1_BANDOLIER_MODEL_PACK_TEMPS" 9 "BMS_LOG1_CHARGE_INTERFACE_2" 8 "BMS_LOG1_CHARGE_INTERFACE_1" 7 "BMS_LOG1_NEG_CTR_HEALTH_2" 6 "BMS_LOG1_NEG_CTR_HEALTH_1" 5 "BMS_LOG1_POS_CTR_HEALTH_2" 4 "BMS_LOG1_POS_CTR_HEALTH_1" 3 "BMS_LOG1_STATES_AND_BOOLS" 2 "BMS_LOG1_CPU_USAGE3" 1 "BMS_LOG1_CPU_USAGE2" 0 "BMS_LOG1_CPU_USAGE1" ;
VAL_TABLE_ BMS_log2Mux 41 "BMS_LOG2_BRICK_BLEED_TIMES_3" 40 "BMS_LOG2_BRICK_BLEED_TIMES_2" 39 "BMS_LOG2_BRICK_BLEED_TIMES_1" 38 "BMS_LOG2_LIFE_MODEL" 37 "BMS_LOG2_BRICK_BALANCE_4" 36 "BMS_LOG2_BRICK_BALANCE_3" 35 "BMS_LOG2_BRICK_BALANCE_2" 34 "BMS_LOG2_BRICK_BALANCE_1" 33 "BMS_LOG2_ALPHA_1" 32 "BMS_LOG2_HISTOGRAMS_4" 31 "BMS_LOG2_HISTOGRAMS_3" 30 "BMS_LOG2_HISTOGRAMS_2" 29 "BMS_LOG2_HISTOGRAMS_1" 28 "BMS_LOG2_HISTOGRAMS_0" 27 "BMS_LOG2_VSH_RES_3" 26 "BMS_LOG2_VSH_RES_2" 25 "BMS_LOG2_VSH_RES_1" 24 "BMS_LOG2_SOC_BY_OCV_CORRECTION" 23 "BMS_LOG2_BRICK_VOLTAGE_CHANGE" 22 "BMS_LOG2_CAC3" 21 "BMS_LOG2_ENERGY_AND_REST_DATA" 20 "BMS_LOG2_FC_LINK_LEAKAGE_TEST" 19 "BMS_LOG2_ENERGY_RESERVE" 18 "BMS_LOG2_HV_CHAIN_MODEL" 17 "BMS_LOG2_NEG_CTR_HEALTH_4" 16 "BMS_LOG2_NEG_CTR_HEALTH_3" 15 "BMS_LOG2_NEG_CTR_HEALTH_2" 14 "BMS_LOG2_NEG_CTR_HEALTH_1" 13 "BMS_LOG2_POS_CTR_HEALTH_4" 12 "BMS_LOG2_POS_CTR_HEALTH_3" 11 "BMS_LOG2_POS_CTR_HEALTH_2" 10 "BMS_LOG2_POS_CTR_HEALTH_1" 9 "BMS_LOG2_CTR_RESISTANCE" 8 "BMS_LOG2_100HZ_1KHZ_TASK_STATS" 7 "BMS_LOG2_10HZ_TASK_STATS" 6 "BMS_LOG2_1HZ_TASK_STATS" 5 "BMS_LOG2_AHR_COUNTER" 4 "BMS_LOG2_CHARGING" 3 "BMS_LOG2_VSH_TEST" 2 "BMS_LOG2_FLOOD_PORT" 1 "BMS_LOG2_CAC2" 0 "BMS_LOG2_CAC1" 44 "BMS_LOG2_SOH" 43 "BMS_LOG2_CAC4" 42 "BMS_LOG2_ISOLATION" ;
VAL_TABLE_ BMS_log3Mux 107 "BMS_LOG3_107" 106 "BMS_LOG3_106" 105 "BMS_LOG3_105" 104 "BMS_LOG3_104" 103 "BMS_LOG3_103" 102 "BMS_LOG3_102" 101 "BMS_LOG3_101" 100 "BMS_LOG3_100" 99 "BMS_LOG3_99" 98 "BMS_LOG3_98" 97 "BMS_LOG3_97" 96 "BMS_LOG3_96" 95 "BMS_LOG3_95" 94 "BMS_LOG3_94" 93 "BMS_LOG3_93" 92 "BMS_LOG3_92" 91 "BMS_LOG3_91" 90 "BMS_LOG3_90" 89 "BMS_LOG3_89" 88 "BMS_LOG3_88" 87 "BMS_LOG3_87" 86 "BMS_LOG3_86" 85 "BMS_LOG3_85" 84 "BMS_LOG3_84" 83 "BMS_LOG3_83" 82 "BMS_LOG3_82" 81 "BMS_LOG3_81" 80 "BMS_LOG3_80" 79 "BMS_LOG3_79" 78 "BMS_LOG3_78" 77 "BMS_LOG3_77" 76 "BMS_LOG3_76" 75 "BMS_LOG3_75" 74 "BMS_LOG3_74" 73 "BMS_LOG3_73" 72 "BMS_LOG3_72" 71 "BMS_LOG3_71" 70 "BMS_LOG3_70" 69 "BMS_LOG3_69" 68 "BMS_LOG3_68" 67 "BMS_LOG3_67" 66 "BMS_LOG3_66" 65 "BMS_LOG3_65" 64 "BMS_LOG3_64" 63 "BMS_LOG3_63" 62 "BMS_LOG3_62" 61 "BMS_LOG3_61" 60 "BMS_LOG3_60" 59 "BMS_LOG3_59" 58 "BMS_LOG3_58" 57 "BMS_LOG3_57" 56 "BMS_LOG3_56" 55 "BMS_LOG3_55" 54 "BMS_LOG3_54" 53 "BMS_LOG3_53" 52 "BMS_LOG3_52" 51 "BMS_LOG3_51" 50 "BMS_LOG3_50" 49 "BMS_LOG3_49" 48 "BMS_LOG3_48" 47 "BMS_LOG3_47" 46 "BMS_LOG3_46" 45 "BMS_LOG3_45" 44 "BMS_LOG3_44" 43 "BMS_LOG3_43" 42 "BMS_LOG3_42" 41 "BMS_LOG3_41" 40 "BMS_LOG3_40" 39 "BMS_LOG3_39" 38 "BMS_LOG3_38" 37 "BMS_LOG3_37" 36 "BMS_LOG3_36" 35 "BMS_LOG3_35" 34 "BMS_LOG3_34" 33 "BMS_LOG3_33" 32 "BMS_LOG3_32" 31 "BMS_LOG3_31" 30 "BMS_LOG3_30" 29 "BMS_LOG3_29" 28 "BMS_LOG3_28" 27 "BMS_LOG3_27" 26 "BMS_LOG3_26" 25 "BMS_LOG3_25" 24 "BMS_LOG3_24" 23 "BMS_LOG3_23" 22 "BMS_LOG3_22" 21 "BMS_LOG3_21" 20 "BMS_LOG3_20" 19 "BMS_LOG3_19" 18 "BMS_LOG3_18" 17 "BMS_LOG3_17" 16 "BMS_LOG3_16" 15 "BMS_LOG3_15" 14 "BMS_LOG3_14" 13 "BMS_LOG3_13" 12 "BMS_LOG3_12" 11 "BMS_LOG3_11" 10 "BMS_LOG3_10" 9 "BMS_LOG3_9" 8 "BMS_LOG3_8" 7 "BMS_LOG3_7" 6 "BMS_LOG3_6" 5 "BMS_LOG3_5" 4 "BMS_LOG3_4" 3 "BMS_LOG3_3" 2 "BMS_LOG3_2" 1 "BMS_LOG3_1" 0 "BMS_LOG3_0" ;
VAL_TABLE_ BMS_maxModelThermistorTempDelta -512 "SNA" ;
VAL_TABLE_ BMS_maxPossibleDcChargePower 255 "SNA" ;
VAL_TABLE_ BMS_modeledCoolantOutletTemp 2047 "SNA" ;
VAL_TABLE_ BMS_modeledMissingCellMaxTemp 2047 "SNA" ;
VAL_TABLE_ BMS_modeledThermistorTemp1 2047 "SNA" ;
VAL_TABLE_ BMS_modeledThermistorTemp2 2047 "SNA" ;
VAL_TABLE_ BMS_modeledThermistorTemp3 2047 "SNA" ;
VAL_TABLE_ BMS_modeledThermistorTemp4 2047 "SNA" ;
VAL_TABLE_ BMS_moduleType 5 "BMS_MOD_TYPE_E1_CP" 4 "BMS_MOD_TYPE_E1_CT" 3 "BMS_MOD_TYPE_E3_CT" 2 "BMS_MOD_TYPE_E1_NCT" 1 "BMS_MOD_TYPE_E3_NCT" 0 "BMS_MOD_TYPE_UNKNOWN" ;
VAL_TABLE_ BMS_negCtrCommonModeRejError -4096 "SNA" ;
VAL_TABLE_ BMS_negCtrCommonModeRejErrorConf 8191 "SNA" ;
VAL_TABLE_ BMS_negCtrDeviation -32768 "SNA" ;
VAL_TABLE_ BMS_negCtrDeviationConfidence 65535 "SNA" ;
VAL_TABLE_ BMS_negCtrDeviationConfidenceMax 8191 "SNA" ;
VAL_TABLE_ BMS_negCtrDeviationConfidenceMin 8191 "SNA" ;
VAL_TABLE_ BMS_negCtrDeviationFilt -32768 "SNA" ;
VAL_TABLE_ BMS_negCtrDeviationFiltConf 65535 "SNA" ;
VAL_TABLE_ BMS_negCtrDeviationFiltConfMax 8191 "SNA" ;
VAL_TABLE_ BMS_negCtrDeviationFiltConfMin 8191 "SNA" ;
VAL_TABLE_ BMS_negCtrDeviationFiltMax -4096 "SNA" ;
VAL_TABLE_ BMS_negCtrDeviationFiltMin -4096 "SNA" ;
VAL_TABLE_ BMS_negCtrDeviationMax -4096 "SNA" ;
VAL_TABLE_ BMS_negCtrDeviationMin -4096 "SNA" ;
VAL_TABLE_ BMS_negCtrDropCorrected -32768 "SNA" ;
VAL_TABLE_ BMS_negCtrDropCorrectedFilt -32768 "SNA" ;
VAL_TABLE_ BMS_negCtrDropCorrectedFiltMax -4096 "SNA" ;
VAL_TABLE_ BMS_negCtrDropCorrectedFiltMin -4096 "SNA" ;
VAL_TABLE_ BMS_negCtrDropCorrectedMax -4096 "SNA" ;
VAL_TABLE_ BMS_negCtrDropCorrectedMin -4096 "SNA" ;
VAL_TABLE_ BMS_negCtrOffsetError -4096 "SNA" ;
VAL_TABLE_ BMS_negCtrOffsetErrorConf 8191 "SNA" ;
VAL_TABLE_ BMS_negCtrResistance -4096 "SNA" ;
VAL_TABLE_ BMS_negCtrResistanceConfidence 8191 "SNA" ;
VAL_TABLE_ BMS_nominalEnergyRemaining 2047 "SNA" ;
VAL_TABLE_ BMS_nominalFullPackEnergy 2047 "SNA" ;
VAL_TABLE_ BMS_packConfigMux 1 "Mux1" 0 "Mux0" ;
VAL_TABLE_ BMS_packCurrent -32768 "SNA" ;
VAL_TABLE_ BMS_packCurrentOffset -16384 "SNA" ;
VAL_TABLE_ BMS_packTemperatureMeasurementsMux 5 "Mux5" 4 "Mux4" 3 "Mux3" 2 "Mux2" 1 "Mux1" 0 "Mux0" ;
VAL_TABLE_ BMS_packType 30 "BATTERY_PACK_TYPE_YSB_C2" 29 "BATTERY_PACK_TYPE_YSB_C1" 28 "BATTERY_PACK_TYPE_BLDRUNNER_B3" 27 "BATTERY_PACK_TYPE_YSB_B3_5" 26 "BATTERY_PACK_TYPE_PALLADIUM_G" 25 "BATTERY_PACK_TYPE_BLDRUNNER_B2" 24 "BATTERY_PACK_TYPE_YSB_B3" 23 "BATTERY_PACK_TYPE_PALLADIUM_C5" 22 "BATTERY_PACK_TYPE_PALLADIUM_C3" 21 "BATTERY_PACK_TYPE_YSB_B1_B2" 20 "BATTERY_PACK_TYPE_PALLADIUM_C2" 19 "BATTERY_PACK_TYPE_CATL_LFPPLUS" 18 "BATTERY_PACK_TYPE_PALLADIUM_C1" 17 "BATTERY_PACK_TYPE_PALLADIUM_B_2300A" 16 "BATTERY_PACK_TYPE_ROADRUNNER_B" 15 "BATTERY_PACK_TYPE_PALLADIUM_B" 14 "BMS_PACK_TYPE_E1_CATL_C" 13 "BMS_PACK_TYPE_E1_CATL_B" 12 "BMS_PACK_TYPE_E1_FRONTTHM" 11 "BMS_PACK_TYPE_E1D_FRONTTHM" 10 "BMS_PACK_TYPE_E3_FRONTTHM" 9 "BMS_PACK_TYPE_E2_FRONTTHM" 8 "BMS_PACK_TYPE_E2" 7 "BMS_PACK_TYPE_E3_KELVIN_43P" 6 "BMS_PACK_TYPE_E1_KELVIN" 5 "BMS_PACK_TYPE_E3_KELVIN" 4 "BMS_PACK_TYPE_SEMI_A" 3 "BMS_PACK_TYPE_C_E3" 2 "BMS_PACK_TYPE_C_E1" 1 "BMS_PACK_TYPE_B2" 0 "BMS_PACK_TYPE_UNKNOWN" ;
VAL_TABLE_ BMS_peakRegenCurrentLimitMode 8 "MISSING_CELL" 7 "CAC_IMBALANCE" 6 "MAX_BLENDABLE" 5 "BRICKT_AND_OCV" 4 "BRICKT_AND_CCV" 3 "BRICKT_AND_PREDICTED_CCV" 2 "LEAKY_BUCKET" 1 "HV_CHAIN_MODEL" 0 "NONE" ;
VAL_TABLE_ BMS_posCtrCommonModeRejError -4096 "SNA" ;
VAL_TABLE_ BMS_posCtrCommonModeRejErrorConf 8191 "SNA" ;
VAL_TABLE_ BMS_posCtrDeviation -32768 "SNA" ;
VAL_TABLE_ BMS_posCtrDeviationConfidence 65535 "SNA" ;
VAL_TABLE_ BMS_posCtrDeviationConfidenceMax 8191 "SNA" ;
VAL_TABLE_ BMS_posCtrDeviationConfidenceMin 8191 "SNA" ;
VAL_TABLE_ BMS_posCtrDeviationFilt -32768 "SNA" ;
VAL_TABLE_ BMS_posCtrDeviationFiltConf 65535 "SNA" ;
VAL_TABLE_ BMS_posCtrDeviationFiltConfMax 8191 "SNA" ;
VAL_TABLE_ BMS_posCtrDeviationFiltConfMin 8191 "SNA" ;
VAL_TABLE_ BMS_posCtrDeviationFiltMax -4096 "SNA" ;
VAL_TABLE_ BMS_posCtrDeviationFiltMin -4096 "SNA" ;
VAL_TABLE_ BMS_posCtrDeviationMax -4096 "SNA" ;
VAL_TABLE_ BMS_posCtrDeviationMin -4096 "SNA" ;
VAL_TABLE_ BMS_posCtrDropCorrected -32768 "SNA" ;
VAL_TABLE_ BMS_posCtrDropCorrectedFilt -32768 "SNA" ;
VAL_TABLE_ BMS_posCtrDropCorrectedFiltMax -4096 "SNA" ;
VAL_TABLE_ BMS_posCtrDropCorrectedFiltMin -4096 "SNA" ;
VAL_TABLE_ BMS_posCtrDropCorrectedMax -4096 "SNA" ;
VAL_TABLE_ BMS_posCtrDropCorrectedMin -4096 "SNA" ;
VAL_TABLE_ BMS_posCtrOffsetError -4096 "SNA" ;
VAL_TABLE_ BMS_posCtrOffsetErrorConf 8191 "SNA" ;
VAL_TABLE_ BMS_posCtrResistance -4096 "SNA" ;
VAL_TABLE_ BMS_posCtrResistanceConfidence 8191 "SNA" ;
VAL_TABLE_ BMS_reservedConfig_0 31 "BMS_CONFIG_31" 30 "BMS_CONFIG_30" 29 "BMS_CONFIG_29" 28 "BMS_CONFIG_28" 27 "BMS_CONFIG_27" 26 "BMS_CONFIG_26" 25 "BMS_CONFIG_25" 24 "BMS_CONFIG_24" 23 "BMS_CONFIG_23" 22 "BMS_CONFIG_22" 21 "BMS_CONFIG_21" 20 "BMS_CONFIG_20" 19 "BMS_CONFIG_19" 18 "BMS_CONFIG_18" 17 "BMS_CONFIG_17" 16 "BMS_CONFIG_16" 15 "BMS_CONFIG_15" 14 "BMS_CONFIG_14" 13 "BMS_CONFIG_13" 12 "BMS_CONFIG_12" 11 "BMS_CONFIG_11" 10 "BMS_CONFIG_10" 9 "BMS_CONFIG_9" 8 "BMS_CONFIG_8" 7 "BMS_CONFIG_7" 6 "BMS_CONFIG_6" 5 "BMS_CONFIG_5" 4 "BMS_CONFIG_4" 3 "BMS_CONFIG_3" 2 "BMS_CONFIG_2" 1 "BMS_CONFIG_1" 0 "BMS_CONFIG_0" ;
VAL_TABLE_ BMS_serialNumberMultiplexerID 2 "BMS_SERIAL_MUX2" 1 "BMS_SERIAL_MUX1" 0 "BMS_SERIAL_MUX0" ;
VAL_TABLE_ BMS_state 10 "BMS_DIAG" 9 "BMS_SNA" 8 "BMS_TEST" 7 "BMS_WELD" 6 "BMS_FAULT" 5 "BMS_CLEAR_FAULT" 4 "BMS_FEIM" 3 "BMS_CHARGE" 2 "BMS_SUPPORT" 1 "BMS_DRIVE" 0 "BMS_STANDBY" ;
VAL_TABLE_ BMS_taskID 6 "BMS_TASK_ISR" 5 "BMS_TASK_UDS" 4 "BMS_TASK_1KHZ" 3 "BMS_TASK_100HZ" 2 "BMS_TASK_10HZ" 1 "BMS_TASK_1HZ" 0 "BMS_TASK_IDLE" ;
VAL_TABLE_ BMS_uiChargeStatus 5 "BMS_CHARGE_STOPPED" 4 "BMS_CHARGE_COMPLETE" 3 "BMS_CHARGING" 2 "BMS_ABOUT_TO_CHARGE" 1 "BMS_NO_POWER" 0 "BMS_DISCONNECTED" ;
VAL_TABLE_ BMS_voltageRegState 2 "BMS_VOLTAGE_REG_BELOW_TARGET" 1 "BMS_VOLTAGE_REG_ACTIVE" 0 "BMS_VOLTAGE_REG_INACTIVE" ;
VAL_TABLE_ Boolean 1 "TRUE" 0 "FALSE" ;
VAL_TABLE_ CAN_error 9 "CAN_ERROR_TWO_SLAVES" 8 "CAN_ERROR_TWO_MASTERS" 7 "CAN_ERROR_RESET_CMD" 6 "CAN_ERROR_OVERRUN" 5 "CAN_ERROR_TX" 4 "CAN_ERROR_RX" 3 "CAN_ERROR_NODEBUG" 2 "CAN_ERROR_DATA" 1 "CAN_ERROR_CHECKSUM" 0 "CAN_ERROR_LENGTH" ;
VAL_TABLE_ CC_a001_groundResistance 4095 "GROUND_RESISTANCE_SNA" 4094 "GROUND_RESISTANCE_NO_GROUND" ;
VAL_TABLE_ CC_a003_gfciFaultReason 4 "FAULT_REASON_DC_PEAK" 3 "FAULT_REASON_DC_LPF" 2 "FAULT_REASON_AC_PEAK" 1 "FAULT_REASON_AC_LPF" 0 "FAULT_REASON_SNA" ;
VAL_TABLE_ CC_a004_gfciErrorReason 5 "ERROR_REASON_TEST_SIGNAL_ERROR" 4 "ERROR_REASON_AC_OFFSET_ERROR" 3 "ERROR_REASON_DC_OFFSET_ERROR" 2 "ERROR_REASON_ASIC_REASON" 1 "ERROR_REASON_IO_ERROR" 0 "ERROR_REASON_SNA" ;
VAL_TABLE_ CC_a014_failureCause 4 "FAILURE_CAUSE_DCGFCI_INIT_FAILED" 3 "FAILURE_CAUSE_METER_INIT_FAILED" 2 "FAILURE_CAUSE_CONFIG_NOT_RECEIVED" 1 "FAILURE_CAUSE_OTHER" ;
VAL_TABLE_ CC_alerts 44 "CC_a044_relayCoilVoltageRationality" 43 "CC_a043_configurationRequired" 42 "CC_a042_pcbaTempFoldback" 41 "CC_a041_inputWiringFoldback" 40 "CC_a040_handleTempFoldback" 39 "CC_a039_internalModuleOverTemp" 38 "CC_a038_internalModuleMia" 37 "CC_a037_intModuleWdtExpired" 36 "CC_a036_contactorStuckOpen" 33 "CC_a033_vRefOutOfRange" 32 "CC_a032_meteringFailure" 31 "CC_a031_pllLockLost" 30 "CC_a030_masterSlaveMismatch" 29 "CC_a029_PilotFFault" 28 "CC_a028_CB_rotarySelect" 27 "CC_a027_vehicleHandleTemp" 26 "CC_a026_wallPlugTemp" 25 "CC_a025_evseTemp" 24 "CC_a024_CB_masterISetTooLow" 23 "CC_a023_CB_tooManySlaves" 22 "CC_a022_CB_tooManyMasters" 21 "CC_a021_CB_noMaster" 20 "CC_a020_3vRailIncorrect" 19 "CC_a019_proxDisconnected" 18 "CC_a018_PilotDFault" 17 "CC_a017_PilotCFault" 16 "CC_a016_PilotBFault" 15 "CC_a015_PilotAFault" 14 "CC_a014_mcuSelfTestFault" 13 "CC_a013_vehConnOT" 12 "CC_a012_wallPlugOT" 11 "CC_a011_ambientOT" 10 "CC_a010_contactorWelded" 9 "CC_a009_inputMiswired" 8 "CC_a008_inputUnderVoltage" 7 "CC_a007_inputOverVoltage" 6 "CC_a006_inputOverCurrent" 5 "CC_a005_groundedNeutral" 4 "CC_a004_CCIDSelfTestFault" 3 "CC_a003_CCIDTripped" 2 "CC_a002_gndMonIntrptLoadSide" 1 "CC_a001_gndMonIntrptLineSide" 0 "CC_ALERT_DO_NOT_USE_ZERO" ;
VAL_TABLE_ CC_buttonState 1 "CC_BUTTON_PRESSED" 0 "CC_BUTTON_RELEASED" ;
VAL_TABLE_ CC_chgStatus2Mux 0 "Mux0" ;
VAL_TABLE_ CC_contactorClosed 3 "CC_CONTACTOR_SNA" 1 "CC_CONTACTOR_CLOSED" 0 "CC_CONTACTOR_OPEN" ;
VAL_TABLE_ CC_gridGrounding 2 "CC_GRID_GROUNDING_SNA" 1 "CC_GRID_GROUNDING_IT_SplitPhase" 0 "CC_GRID_GROUNDING_TN_TT" ;
VAL_TABLE_ CC_logDataMux 13 "Mux13" 12 "Mux12" 11 "Mux11" 10 "Mux10" 4 "Mux4" 3 "Mux3" 2 "Mux2" 1 "Mux1" 0 "Mux0" ;
VAL_TABLE_ CC_pilotState 3 "CC_PILOT_STATE_SNA" 2 "CC_PILOT_STATE_FAULTED" 1 "CC_PILOT_STATE_IDLE" 0 "CC_PILOT_STATE_READY" ;
VAL_TABLE_ CHADA_status_2Mux 4 "Mux4" 3 "Mux3" 2 "Mux2" 1 "Mux1" 0 "Mux0" ;
VAL_TABLE_ CHG_cableType 4 "CHG_CABLE_TYPE_SNA" 3 "CHG_CABLE_TYPE_GB_DC" 2 "CHG_CABLE_TYPE_GB_AC" 1 "CHG_CABLE_TYPE_SAE" 0 "CHG_CABLE_TYPE_IEC" ;
VAL_TABLE_ CHG_pilot 7 "CHG_PILOT_SNA" 6 "CHG_PILOT_UNUSED_6" 5 "CHG_PILOT_INVALID" 4 "CHG_PILOT_IDLE" 3 "CHG_PILOT_FAST_CHARGE" 2 "CHG_PILOT_LINE_CHARGE" 1 "CHG_PILOT_FAULTED" 0 "CHG_PILOT_NONE" ;
VAL_TABLE_ CHG_proximity 3 "CHG_PROXIMITY_LATCHED" 2 "CHG_PROXIMITY_UNLATCHED" 1 "CHG_PROXIMITY_DISCONNECTED" 0 "CHG_PROXIMITY_SNA" ;
VAL_TABLE_ CMPD_overloadStatus 3 "CMPD_OVERLOAD_STATUS_SHUTDOWN" 2 "CMPD_OVERLOAD_STATUS_WARNING_TIMER_RUNNING" 1 "CMPD_OVERLOAD_STATUS_WARNING" 0 "CMPD_OVERLOAD_STATUS_NONE" ;
VAL_TABLE_ CMPD_state 15 "CMPD_STATE_SNA" 4 "CMPD_STATE_IDLE" 3 "CMPD_STATE_FAULT" 2 "CMPD_STATE_STANDBY" 1 "CMPD_STATE_RUNNING" 0 "CMPD_STATE_INIT" ;
VAL_TABLE_ CMPD_wasteHeatRequest 3 "CMPD_WASTE_HEAT_REQUEST_FULL" 2 "CMPD_WASTE_HEAT_REQUEST_UNUSED2" 1 "CMPD_WASTE_HEAT_REQUEST_UNUSED1" 0 "CMPD_WASTE_HEAT_REQUEST_OFF" ;
VAL_TABLE_ CMPD_wasteHeatState 3 "CMPD_WASTE_HEAT_STATE_UNUSED" 2 "CMPD_WASTE_HEAT_STATE_NOT_AVAILABLE" 1 "CMPD_WASTE_HEAT_STATE_ACTIVE" 0 "CMPD_WASTE_HEAT_STATE_OFF" ;
VAL_TABLE_ CMP_state 15 "CMP_STATE_SNA" 5 "CMP_STATE_SOFT_SHUTDOWN" 4 "CMP_STATE_SOFT_START" 3 "CMP_STATE_FAULT" 2 "CMP_STATE_WAIT" 1 "CMP_STATE_NORMAL" 0 "CMP_STATE_NONE" ;
VAL_TABLE_ CP_AlertMatrixIndex 2 "CP_AlertMatrix2" 1 "CP_AlertMatrix1" 0 "CP_AlertMatrix0" ;
VAL_TABLE_ CP_ME_mode 13 "CP_ME_MODE_STANDBY" 10 "CP_ME_MODE_STOP" 8 "CP_ME_MODE_HALT" 7 "CP_ME_MODE_RUN3" 6 "CP_ME_MODE_RUN2" 5 "CP_ME_MODE_RUN1" 4 "CP_ME_MODE_RUN0" 3 "CP_ME_MODE_DRUN" 2 "CP_ME_MODE_SAFE" 1 "CP_ME_MODE_TEST" 0 "CP_ME_MODE_RESET" ;
VAL_TABLE_ CP_UHF_state 10 "CP_UHF_FAULT" 9 "CP_UHF_SLEEP" 8 "CP_UHF_HANDLE_FOUND" 7 "CP_UHF_READ_RXFIFO" 6 "CP_UHF_CHECK_RX" 5 "CP_UHF_RX" 4 "CP_UHF_PREPARE_RX" 3 "CP_UHF_CALIBRATE" 2 "CP_UHF_IDLE" 1 "CP_UHF_CONFIG" 0 "CP_UHF_INIT" ;
VAL_TABLE_ CP_alerts 152 "CP_a152_pilotEdgeDetectionFailed" 151 "CP_a151_badPilotDiodeDetected" 150 "CP_a150_railToggleTimeout" 149 "CP_a149_pilotPeriodInvalid" 148 "CP_a148_bldcTachFeedbackMia" 147 "CP_a147_inductiveRecoveredMia" 146 "CP_a146_ccsEvseMalfunction" 145 "CP_a145_modemAppLoadFailedNA" 144 "CP_a144_nvmInitFailed" 143 "CP_a143_unsupportedChargeAdapter" 142 "CP_a142_gbdcScConnFault" 141 "CP_a141_chademoAdapterFault" 140 "CP_a140_superchargerFaulted" 139 "CP_a139_pilotFaulted" 138 "CP_a138_swcanCommsAcEvseFaulted" 137 "CP_a137_plcForwardError" 136 "CP_a136_scSdpCommsFailure" 135 "CP_a135_sdpAttemptsFailed" 134 "CP_a134_plcModemNotExpected" 133 "CP_a133_proxNeverLatched" 132 "CP_a132_contractAuthTimeout" 131 "CP_a131_evseCommTimeout" 130 "CP_a130_bldcDriverCommsRecovered" 129 "CP_a129_bldcDriverCommsFailed" 128 "CP_a128_lostCommsVC" 127 "CP_a127_lostCommsHVLINK" 126 "CP_a126_wakeOnUhfFault" 125 "CP_a125_unexpectedLVJuiceState" 124 "CP_a124_ivledFault" 123 "CP_a123_latchPotIrrational" 122 "CP_a122_plcModemFailure" 121 "CP_a121_PLCRLY_lostCommsCP" 120 "CP_a120_comboAdapterFoldback" 119 "CP_a119_plcTransmitFailure" 118 "CP_a118_iecComboLockUp" 117 "CP_a117_inletHeaterUnableToRegulate" 116 "CP_a116_misconfigurationDetected" 115 "CP_a115_deprecatedAlert2" 114 "CP_a114_deprecatedAlert1" 113 "CP_a113_inletHeaterShortCircuit" 112 "CP_a112_inletHeaterIrrationalTemperature" 111 "CP_a111_inletHeaterUnableToHeat" 110 "CP_a110_thermalVelocityHigh" 109 "CP_a109_thermistorIrrational" 108 "CP_a108_chademoOvertempFault" 107 "CP_a107_chademoFoldbackActive" 106 "CP_a106_uhfReceiverReset" 105 "CP_a105_hwUnableToSleep" 104 "CP_a104_uhfResetSuccessful" 103 "CP_a103_proximityPeDisconnected" 102 "CP_a102_wcOvertempFault" 101 "CP_a101_wcFoldbackActive" 100 "CP_a100_inletHarnessIdIrrational" 99 "CP_a099_cableStateUnknown" 98 "CP_a098_proximityWake" 97 "CP_a097_modeTransitionFailure" 96 "CP_a096_pilotWake" 95 "CP_a095_thermalDcLimitActive" 94 "CP_a094_inductiveResetSuccessful" 93 "CP_a093_modemLoadedWithReset" 92 "CP_a092_modemAppLoadFailed" 91 "CP_a091_wrongSuperchargerHandle" 90 "CP_a090_ccsEvseLowIso" 89 "CP_a089_plcConfigMismatch" 88 "CP_a088_dcTempModelDeviation" 87 "CP_a087_dcTempModelFault" 86 "CP_a086_dcPinTempIrrational" 85 "CP_a085_dcPinTempFaulted" 84 "CP_a084_proxPeDisconnected_gb" 83 "CP_a083_watchdogTraceData" 82 "CP_a082_powerOnReset" 81 "CP_a081_swException" 80 "CP_a080_taskStackOverflow" 79 "CP_a079_cableNotSecuredCold" 78 "CP_a078_latchNotDisengagedCold" 77 "CP_a077_invalidMacAddress" 76 "CP_a076_LDC1612errorWatchdog" 75 "CP_a075_v2gCommsFailure" 74 "CP_a074_failedToEstablishV2gComm" 73 "CP_a073_iecComboShutdown" 72 "CP_a072_v2gEvccTimeout" 71 "CP_a071_exiDecodeFailure" 70 "CP_a070_doorInductiveSensorReset" 69 "CP_a069_doorInductiveSensorError" 68 "CP_a068_doorSensorMismatch" 67 "CP_a067_gbdcConnFault" 66 "CP_a066_proxLatchedIdlePilot" 65 "CP_a065_selfTestFailed" 64 "CP_a064_superchargingBlocked" 63 "CP_a063_scUpdateInProgress" 62 "CP_a062_scOutOfService" 61 "CP_a061_uhfReceiverMIA" 60 "CP_a060_lostCommsPCS" 59 "CP_a059_swcanError" 58 "CP_a058_acChargingBlocked" 57 "CP_a057_deprecatedAlert57" 56 "CP_a056_proxDisconnected" 55 "CP_a055_chargeStoppedNoPilot" 54 "CP_a054_cableNotSecured" 53 "CP_a053_proxLatchedNoPilot" 52 "CP_a052_evseNotSupported" 51 "CP_a051_doorInductiveSensorMIA" 50 "CP_a050_latchNotConnected" 49 "CP_a049_multipleCablesDetected" 48 "CP_a048_lostCommsUI" 47 "CP_a047_lostCommsVCFRONT" 46 "CP_a046_lostCommsEVSE" 45 "CP_a045_lostCommsVCSEC" 44 "CP_a044_lostCommsHVP" 43 "CP_a043_doorPotIrrational" 42 "CP_a042_doorAssemblyBroken" 41 "CP_a041_doorSensorUnplugged" 40 "CP_a040_doNotUse" 39 "CP_a039_latchMovement_2" 38 "CP_a038_latchNotBlocking" 37 "CP_a037_latchNotEngaged" 36 "CP_a036_latchNotDisengaged" 35 "CP_a035_latchMovement_1" 34 "CP_a034_calibrationIncomplete" 33 "CP_a033_spiOpen" 32 "CP_a032_doorOpenExpectedClosed" 31 "CP_a031_doorClosedCommandedOpen" 30 "CP_a030_busOff" 29 "CP_a029_doorClosedProxPilot" 28 "CP_a028_insertEnableMismatch" 27 "CP_a027_doorSensorOutOfSpec" 26 "CP_a026_networkManagement" 25 "CP_a025_ledsOC" 24 "CP_a024_ledsUC" 23 "CP_a023_gbdcSessionFailed" 22 "CP_a022_zeroVuv" 21 "CP_a021_zeroVov" 20 "CP_a020_threeVuv" 19 "CP_a019_threeVov" 18 "CP_a018_fiveVuv" 17 "CP_a017_fiveVov" 16 "CP_a016_apsVuv" 15 "CP_a015_apsVov" 14 "CP_a014_lostCommsCHG" 13 "CP_a013_lostCommsGTW" 12 "CP_a012_ledDriver" 11 "CP_a011_eeprom" 10 "CP_a010_pilotRationality" 9 "CP_a009_coverOpen" 8 "CP_a008_memoryError" 7 "CP_a007_watchdog" 6 "CP_a006_lostCommsBMS" 5 "CP_a005_gbdcLiveDisconnect" 4 "CP_a004_proximityRationality" 3 "CP_a003_canError" 2 "CP_a002_canTx" 1 "CP_a001_canRx" 0 "CP_ALERT_DO_NOT_USE_ZERO" 154 "CP_a154_acChargingStoppedOT" 153 "CP_a153_thermalAcLimitActive" ;
VAL_TABLE_ CP_chargeCablePresent 1 "CABLE_PRESENT" 0 "CABLE_NOT_PRESENT" ;
VAL_TABLE_ CP_chargeProtocol 6 "CHADEMO" 5 "GBDC" 4 "IEC_COMBO_AC" 3 "IEC_COMBO_DC" 2 "SUPERCHARGER" 1 "AC_CHARGE" 0 "NO_CHARGE" ;
VAL_TABLE_ CP_coldWeatherMode 1 "CP_COLD_WEATHER_LATCH_MITIGATION" 0 "CP_COLD_WEATHER_NONE" ;
VAL_TABLE_ CP_doorCloseRequest 16 "CPD_CLOSE_REQ_NUM" 15 "CPD_CLOSE_REQ_VCFRONT" 14 "CPD_CLOSE_REQ_OPEN_ON_WAKE" 13 "CPD_CLOSE_REQ_SENSOR_COMMS_RECOVERED" 12 "CPD_CLOSE_REQ_SENSOR_MISMATCH" 11 "CPD_CLOSE_REQ_INITIAL_CINCH" 10 "CPD_CLOSE_REQ_OPENED_IN_DRIVE_STATE" 9 "CPD_CLOSE_REQ_ENTER_DRIVE" 8 "CPD_CLOSE_REQ_FAULT_LINE" 7 "CPD_CLOSE_REQ_CAR_WASH" 6 "CPD_CLOSE_REQ_VEH_LOCK" 5 "CPD_CLOSE_REQ_PUSH_TO_CLOSE" 4 "CPD_CLOSE_REQ_SEC" 3 "CPD_CLOSE_REQ_UI" 2 "CPD_CLOSE_REQ_DOOR_OPEN_TIMEOUT" 1 "CPD_CLOSE_REQ_CABLE_UNPLUGGED" 0 "CPD_CLOSE_REQ_NONE" ;
VAL_TABLE_ CP_doorControlState 6 "CP_doorSenseClosed" 5 "CP_doorClosing" 4 "CP_doorSenseOpen" 3 "CP_doorOpening" 2 "CP_doorOpenRequested" 1 "CP_doorIdle" 0 "CP_doorInit" ;
VAL_TABLE_ CP_doorOpenRequest 8 "CPD_OPEN_REQ_NUM" 7 "CPD_OPEN_REQ_CABLE_RECONNECTED" 6 "CPD_OPEN_REQ_VCFRONT" 5 "CPD_OPEN_REQ_CLOSING_FAILED" 4 "CPD_OPEN_REQ_PUSH_TO_OPEN" 3 "CPD_OPEN_REQ_UHF" 2 "CPD_OPEN_REQ_SEC" 1 "CPD_OPEN_REQ_UI" 0 "CPD_OPEN_REQ_NONE" ;
VAL_TABLE_ CP_doorPresenceState 7 "CP_DOOR_PRESENCE_STATE_FAULT" 6 "CP_DOOR_PRESENCE_STATE_OFF_CHARGE" 5 "CP_DOOR_PRESENCE_STATE_OFF_DRIVE" 4 "CP_DOOR_PRESENCE_STATE_NOT_PRESENT" 3 "CP_DOOR_PRESENCE_STATE_PRESENT" 2 "CP_DOOR_PRESENCE_STATE_INIT_FROM_DRIVE" 1 "CP_DOOR_PRESENCE_STATE_INIT_FROM_CHARGE" 0 "CP_DOOR_PRESENCE_STATE_INIT" ;
VAL_TABLE_ CP_doorStopDriveReason 6 "CPD_STOP_DRIVE_REASON_CLOSE_REQ_OVERRIDE" 5 "CPD_STOP_DRIVE_REASON_ABSOLUTE_TIMEOUT" 4 "CPD_STOP_DRIVE_REASON_MAX_TARGET_V" 3 "CPD_STOP_DRIVE_REASON_REACHED_STOP" 2 "CPD_STOP_DRIVE_REASON_STOPPED_MOVING_TIMEOUT" 1 "CPD_STOP_DRIVE_REASON_LOW_SPEED" 0 "CPD_STOP_DRIVE_REASON_NONE" ;
VAL_TABLE_ CP_door_BLDC_state 3 "CP_BLDC_STATE_READY" 2 "CP_BLDC_STATE_I2C_ERROR" 1 "CP_BLDC_STATE_INIT" 0 "CP_BLDC_STATE_UNPOWERED" ;
VAL_TABLE_ CP_exceptionRegisterType 6 "CP_CALLTRACE" 5 "CP_MCAR" 4 "CP_MCSR" 3 "CP_DEAR" 2 "CP_ESR" 1 "CP_SRR1" 0 "CP_SRR0" ;
VAL_TABLE_ CP_harnessPedigreeState 2 "HARNESS_PEDIGREE_VALID" 1 "HARNESS_PEDIGREE_INVALID" 0 "HARNESS_PEDIGREE_UNKNOWN_SNA" ;
VAL_TABLE_ CP_hvChargeStatus 6 "CP_CHARGE_FAULTED" 5 "CP_CHARGE_ENABLED" 4 "CP_EVSE_TEST_PASSED" 3 "CP_EXT_EVSE_TEST_ACTIVE" 2 "CP_CHARGE_STANDBY" 1 "CP_CHARGE_CONNECTED" 0 "CP_CHARGE_INACTIVE" ;
VAL_TABLE_ CP_iecComboState 12 "IEC_COMBO_WAIT_RESTART" 11 "IEC_COMBO_FAULT" 10 "IEC_COMBO_END_OF_CHARGE" 9 "IEC_COMBO_SHUTDOWN" 8 "IEC_COMBO_ENABLED" 7 "IEC_COMBO_PRECHARGE" 6 "IEC_COMBO_CABLE_CHECK" 5 "IEC_COMBO_CHARGE_PARAM_DISCOVERY" 4 "IEC_COMBO_PAYMENT_SELECTION" 3 "IEC_COMBO_SERVICE_DISCOVERY" 2 "IEC_COMBO_V2G_SESSION_SETUP" 1 "IEC_COMBO_CONNECTED" 0 "IEC_COMBO_INACTIVE" ;
VAL_TABLE_ CP_iecPilotState 9 "IEC_PILOT_SNA" 8 "IEC_PILOT_NUM" 7 "IEC_PILOT_F" 6 "IEC_PILOT_E" 5 "IEC_PILOT_C3" 4 "IEC_PILOT_C2" 3 "IEC_PILOT_C1" 2 "IEC_PILOT_B3" 1 "IEC_PILOT_B2" 0 "IEC_PILOT_B1" ;
VAL_TABLE_ CP_inductiveFaultExitReason 4 "LDC1612_FAULT_EXIT_REASON_TIMER" 3 "LDC1612_FAULT_EXIT_REASON_NOPOWEROFF" 2 "LDC1612_FAULT_EXIT_REASON_PAUSE" 1 "LDC1612_FAULT_EXIT_REASON_SHUTDOWN" 0 "LDC1612_FAULT_EXIT_REASON_NONE" ;
VAL_TABLE_ CP_inductiveSensorState 7 "CP_INDUCTIVE_SENSOR_CONFIG" 6 "CP_INDUCTIVE_SENSOR_RESET" 5 "CP_INDUCTIVE_SENSOR_FAULT" 4 "CP_INDUCTIVE_SENSOR_WAIT_FOR_INIT" 3 "CP_INDUCTIVE_SENSOR_PAUSE" 2 "CP_INDUCTIVE_SENSOR_SHUTDOWN" 1 "CP_INDUCTIVE_SENSOR_POLL" 0 "CP_INDUCTIVE_SENSOR_INIT" ;
VAL_TABLE_ CP_inletHeaterState 3 "INLET_HEATER_FAULTED" 2 "INLET_HEATER_ENABLED_LOWTEMP" 1 "INLET_HEATER_ENABLED_HIGHTEMP" 0 "INLET_HEATER_DISABLED" ;
VAL_TABLE_ CP_inletType 3 "CP_INLET_GBDC" 2 "CP_INLET_GBAC" 1 "CP_INLET_IEC" 0 "CP_INLET_SAE" ;
VAL_TABLE_ CP_ivledState 2 "IVLED_ON" 1 "IVLED_FADING" 0 "IVLED_OFF" ;
VAL_TABLE_ CP_latchControlState 5 "CP_latchEngaging" 4 "CP_latchDisengaged" 3 "CP_latchDisengaging" 2 "CP_latchDisengageRequested" 1 "CP_latchIdle" 0 "CP_latchInit" ;
VAL_TABLE_ CP_latchState 3 "CP_LATCH_BLOCKING" 2 "CP_LATCH_ENGAGED" 1 "CP_LATCH_DISENGAGED" 0 "CP_LATCH_SNA" ;
VAL_TABLE_ CP_ledColor 10 "CP_LEDS_FLASHING_BLUE" 9 "CP_LEDS_DEBUG" 8 "CP_LEDS_RAVE" 7 "CP_LEDS_AMBER" 6 "CP_LEDS_FLASHING_AMBER" 5 "CP_LEDS_FLASHING_GREEN" 4 "CP_LEDS_WHITE" 3 "CP_LEDS_BLUE" 2 "CP_LEDS_GREEN" 1 "CP_LEDS_RED" 0 "CP_LEDS_OFF" ;
VAL_TABLE_ CP_loggingFastSelect 3 "CP_LOGGING_FAST_3" 2 "CP_LOGGING_FAST_2" 1 "CP_LOGGING_FAST_1" 0 "CP_LOGGING_FAST_0" ;
VAL_TABLE_ CP_loggingSlowSelect 5 "CP_LOGGING_SLOW_5" 4 "CP_LOGGING_SLOW_4" 3 "CP_LOGGING_SLOW_3" 2 "CP_LOGGING_SLOW_2" 1 "CP_LOGGING_SLOW_1" 0 "CP_LOGGING_SLOW_0" ;
VAL_TABLE_ CP_nmKeepAwakeReason 4 "CP_KEEPAWAKE_REASON_SUPERCHARGER_CONNECTED" 3 "CP_KEEPAWAKE_REASON_CABLE_IN" 2 "CP_KEEPAWAKE_REASON_OPERATING_DOOR_LATCH" 1 "CP_KEEPAWAKE_REASON_CHARGING" 0 "CP_KEEPAWAKE_REASON_NONE_SNA" ;
VAL_TABLE_ CP_nmWakeUpReason 6 "CP_WAKEUP_REASON_SW_RESET" 5 "CP_WAKEUP_REASON_RESET" 4 "CP_WAKEUP_REASON_UHF" 3 "CP_WAKEUP_REASON_PILOT" 2 "CP_WAKEUP_REASON_PROXIMITY" 1 "CP_WAKEUP_REASON_DOOR_PUSHED" 0 "CP_WAKEUP_REASON_NONE" ;
VAL_TABLE_ CP_pilotWakeDataType 5 "CP_PILOT_PERIOD_LOG_COUNTER" 4 "CP_PILOT_PAST_PERIOD_MIN" 3 "CP_PILOT_PAST_PERIOD_MAX" 2 "CP_PILOT_CURRENT_PERIOD_MIN" 1 "CP_PILOT_CURRENT_PERIOD_MAX" 0 "CP_PILOT_PERIOD" ;
VAL_TABLE_ CP_pinState 1 "CP_PIN_HIGH" 0 "CP_PIN_LOW" ;
VAL_TABLE_ CP_plcErr 6 "CP_PLC_ERR_MODEM_OFF" 5 "CP_PLC_ERR_SPI_TRANSCEIVE_FAILED" 4 "CP_PLC_ERR_NO_WRITE_SPACE_AVAILABLE" 3 "CP_PLC_ERR_TX_FAILED_UNKNOWN" 2 "CP_PLC_ERR_TX_FAILED_SEMAPHORE" 1 "CP_PLC_ERR_TX_FAILED_NULL_DATA" 0 "CP_PLC_ERR_OK" ;
VAL_TABLE_ CP_qca700Err 9 "CP_QCA700X_ERR_WRITE_SPACE_DECREASED" 8 "CP_QCA700X_ERR_INIT_SEMAPHORE_FAILED" 7 "CP_QCA700X_ERR_SIGNATURE" 6 "CP_QCA700X_ERR_READ_PACKET_SEMAPHORE" 5 "CP_QCA700X_ERR_NO_WRITE_SPACE_AVAILABLE" 4 "CP_QCA700X_ERR_HEADER_READ_FAILED" 3 "CP_QCA700X_ERR_PREAMBLE_INVALID" 2 "CP_QCA700X_ERR_READ_RX_BUFFER_FAILED" 1 "CP_QCA700X_ERR_FOOTER_INVALID" 0 "CP_QCA700X_ERR_OK" ;
VAL_TABLE_ CP_switchedRail 3 "CP_SWITCHED_RAIL_NUM" 2 "CP_SWITCHED_RAIL_PLC" 1 "CP_SWITCHED_RAIL_SENSOR_EXT" 0 "CP_SWITCHED_RAIL_5V_SW" ;
VAL_TABLE_ CP_switchedRailState 3 "CP_SWITCHED_RAIL_ENABLING" 2 "CP_SWITCHED_RAIL_ENABLED" 1 "CP_SWITCHED_RAIL_DISABLING" 0 "CP_SWITCHED_RAIL_DISABLED" ;
VAL_TABLE_ CP_taskID 12 "CP_TASK_ISR" 11 "CP_TASK_BLDC_CONTROL" 10 "CP_TASK_UHF_sleep" 9 "CP_TASK_sleepPolling" 8 "CP_TASK_selfTests" 7 "CP_TASK_NVRAM" 6 "CP_TASK_UHF" 5 "CP_TASK_I2C" 4 "CP_TASK_UDS" 3 "CP_TASK_1000Hz" 2 "CP_TASK_100Hz" 1 "CP_TASK_10Hz" 0 "CP_TASK_1Hz" ;
VAL_TABLE_ CP_temperatureReading 255 "SNA" ;
VAL_TABLE_ CP_teslaDcState 10 "TESLA_DC_FAULT" 9 "TESLA_DC_EMERGENCY_SHUTDOWN" 8 "TESLA_DC_VEH_SHUTDOWN" 7 "TESLA_DC_EVSE_SHUTDOWN" 6 "TESLA_DC_ENABLED" 5 "TESLA_DC_EXT_PRECHARGE_ACTIVE" 4 "TESLA_DC_EXT_TEST_ACTIVE" 3 "TESLA_DC_EXT_TESTS_ENABLED" 2 "TESLA_DC_STANDBY" 1 "TESLA_DC_CONNECTED_CHARGE_BLOCKED" 0 "TESLA_DC_INACTIVE" ;
VAL_TABLE_ CP_thermalStatusSelect 1 "CP_THERMALSTATUS_1" 0 "CP_THERMALSTATUS_0" ;
VAL_TABLE_ CP_thermalVelocity 511 "SNA" ;
VAL_TABLE_ CP_type 3 "CP_TYPE_IEC_CCS" 2 "CP_TYPE_GB" 1 "CP_TYPE_EURO_IEC" 0 "CP_TYPE_US_TESLA" ;
VAL_TABLE_ CanReceiveError 6 "CAN_RECEIVE_ERROR_UNKNOWN_ID" 5 "CAN_RECEIVE_ERROR_DATA_INVALID" 4 "CAN_RECEIVE_ERROR_SEQUENCE" 3 "CAN_RECEIVE_ERROR_CHECKSUM" 2 "CAN_RECEIVE_ERROR_LENGTH_LONG" 1 "CAN_RECEIVE_ERROR_LENGTH_SHORT" 0 "CAN_RECEIVE_ERROR_NONE" ;
VAL_TABLE_ Contactor_Id 1 "NEGATIVE_CONTACTOR" 0 "POSITIVE_CONTACTOR" ;
VAL_TABLE_ Contactor_Set_Request 5 "SET_REQUEST_CLOSE_POSITIVE_ONLY" 4 "SET_REQUEST_CLOSE_NEGATIVE_ONLY" 3 "SET_REQUEST_OPEN_IMMEDIATELY" 2 "SET_REQUEST_OPEN" 1 "SET_REQUEST_CLOSE" 0 "SET_REQUEST_SNA" ;
VAL_TABLE_ Contactor_Set_State 9 "CONTACTOR_SET_STATE_NEGATIVE_CLOSED" 8 "CONTACTOR_SET_STATE_POSITIVE_CLOSED" 7 "CONTACTOR_SET_STATE_WELDED" 6 "CONTACTOR_SET_STATE_PARTIAL_WELD" 5 "CONTACTOR_SET_STATE_CLOSED" 4 "CONTACTOR_SET_STATE_OPENING" 3 "CONTACTOR_SET_STATE_BLOCKED" 2 "CONTACTOR_SET_STATE_CLOSING" 1 "CONTACTOR_SET_STATE_OPEN" 0 "CONTACTOR_SET_STATE_SNA" ;
VAL_TABLE_ Contactor_State 7 "CONTACTOR_STATE_WELDED" 6 "CONTACTOR_STATE_ECONOMIZED" 5 "CONTACTOR_STATE_OPENING" 4 "CONTACTOR_STATE_PULLED_IN" 3 "CONTACTOR_STATE_BLOCKED" 2 "CONTACTOR_STATE_PRECHARGE" 1 "CONTACTOR_STATE_OPEN" 0 "CONTACTOR_STATE_SNA" ;
VAL_TABLE_ DAS_NM_keepAwakeReason 2 "DAS_KEEPAWAKE_REASON_TELEMETRY" 1 "DAS_KEEPAWAKE_REASON_PRECONDITIONING" 0 "DAS_KEEPAWAKE_REASON_NONE_SNA" ;
VAL_TABLE_ DAS_aebEvent 3 "AEB_SNA" 2 "AEB_FAULT" 1 "AEB_ACTIVE" 0 "AEB_NOT_ACTIVE" ;
VAL_TABLE_ DAS_autoWiperState 5 "DAS_AUTO_WIPER_STATE_SNA" 4 "DAS_AUTO_WIPER_STATE_FAST_CONTINUOUS" 3 "DAS_AUTO_WIPER_STATE_SLOW_CONTINUOUS" 2 "DAS_AUTO_WIPER_STATE_FAST_INTERMITTENT" 1 "DAS_AUTO_WIPER_STATE_SLOW_INTERMITTENT" 0 "DAS_AUTO_WIPER_STATE_OFF" ;
VAL_TABLE_ DAS_hazardLightRequest 3 "DAS_REQUEST_HAZARDS_SNA" 2 "DAS_REQUEST_HAZARDS_UNUSED" 1 "DAS_REQUEST_HAZARDS_ON" 0 "DAS_REQUEST_HAZARDS_OFF" ;
VAL_TABLE_ DAS_headlightRequest 3 "DAS_HEADLIGHT_REQUEST_INVALID" 1 "DAS_HEADLIGHT_REQUEST_ON" 0 "DAS_HEADLIGHT_REQUEST_OFF" ;
VAL_TABLE_ DAS_heaterRequest 2 "DAS_HEATER_ON" 1 "DAS_HEATER_OFF" 0 "DAS_HEATER_SNA" ;
VAL_TABLE_ DAS_highLowBeamDecision 3 "DAS_HIGH_BEAM_SNA" 2 "DAS_HIGH_BEAM_ON" 1 "DAS_HIGH_BEAM_OFF" 0 "DAS_HIGH_BEAM_UNDECIDED" ;
VAL_TABLE_ DAS_highLowBeamOffReason 5 "HIGH_BEAM_OFF_REASON_SNA" 4 "HIGH_BEAM_OFF_REASON_HEAD_LIGHT" 3 "HIGH_BEAM_OFF_REASON_AMBIENT_LIGHT" 2 "HIGH_BEAM_OFF_REASON_MOVING_RADAR_TARGET" 1 "HIGH_BEAM_OFF_REASON_MOVING_VISION_TARGET" 0 "HIGH_BEAM_ON" ;
VAL_TABLE_ DAS_mirrorFoldRequest 3 "DAS_MIRROR_REQUEST_SNA" 2 "DAS_MIRROR_REQUEST_UNFOLD" 1 "DAS_MIRROR_REQUEST_FOLD" 0 "DAS_MIRROR_REQUEST_NONE" ;
VAL_TABLE_ DAS_radarHeaterReason 7 "SNA" 5 "PRECONDITIONING" 4 "RADAR_BLOCKAGE" 3 "RADAR_BLOCKAGE_PROBABILITY" 2 "POST_ACTIVATION_TIMEOUT" 1 "STOP_TIMED_OUT" 0 "NONE" ;
VAL_TABLE_ DAS_steeringAngleRequest 16384 "ZERO_ANGLE" ;
VAL_TABLE_ DAS_turnIndicatorRequest 4 "DAS_TURN_INDICATOR_DEFER" 3 "DAS_TURN_INDICATOR_CANCEL" 2 "DAS_TURN_INDICATOR_RIGHT" 1 "DAS_TURN_INDICATOR_LEFT" 0 "DAS_TURN_INDICATOR_NONE" ;
VAL_TABLE_ DAS_turnIndicatorRequestReason 23 "DAS_ACTIVE_INFEASIBLE_KINEMATICS_LANE_CHANGE" 22 "DAS_ACTIVE_STAY_OUT_OF_RIGHTMOST_LANE_LANE_CHANGE" 21 "DAS_ACTIVE_AWAY_FROM_MERGE_LANE_CHANGE" 20 "DAS_ACTIVE_EXIT_RIGHT_LANE_LANE_CHANGE" 19 "DAS_ACTIVE_EXIT_PASSING_LANE_LANE_CHANGE" 18 "DAS_ACTIVE_INCORRECT_ROAD_SIDE_LANE_CHANGE" 17 "DAS_ACTIVE_STATIC_OBJECT_LANE_CHANGE" 15 "DAS_CANCEL_MANUAL_BLINKER" 14 "DAS_CANCEL_AUTO_PARK" 13 "DAS_ACTIVE_AUTO_PARK" 12 "DAS_CANCEL_SUMMMON" 11 "DAS_ACTIVE_SUMMMON" 10 "DAS_CANCEL_INTERSECTION" 9 "DAS_ACTIVE_INTERSECTION" 8 "DAS_ACTIVE_COMMANDED_LANE_CHANGE" 7 "DAS_CANCEL_MERGE" 6 "DAS_ACTIVE_MERGE" 5 "DAS_CANCEL_FORK" 4 "DAS_CANCEL_LANE_CHANGE" 3 "DAS_ACTIVE_FORK" 2 "DAS_ACTIVE_SPEED_LANE_CHANGE" 1 "DAS_ACTIVE_NAV_LANE_CHANGE" 0 "DAS_NONE" ;
VAL_TABLE_ DAS_wiperSpeed 15 "DAS_WIPER_SPEED_INVALID" 14 "DAS_WIPER_SPEED_14" 13 "DAS_WIPER_SPEED_13" 12 "DAS_WIPER_SPEED_12" 11 "DAS_WIPER_SPEED_11" 10 "DAS_WIPER_SPEED_10" 9 "DAS_WIPER_SPEED_9" 8 "DAS_WIPER_SPEED_8" 7 "DAS_WIPER_SPEED_7" 6 "DAS_WIPER_SPEED_6" 5 "DAS_WIPER_SPEED_5" 4 "DAS_WIPER_SPEED_4" 3 "DAS_WIPER_SPEED_3" 2 "DAS_WIPER_SPEED_2" 1 "DAS_WIPER_SPEED_1" 0 "DAS_WIPER_SPEED_OFF" ;
VAL_TABLE_ DBG_DI_vdcDebugEnable 1 "DBG_DI_VDC_DEBUG_ENABLED" 0 "DBG_DI_VDC_DEBUG_DISABLED" ;
VAL_TABLE_ DBG_dynoCtrlSelector 3 "MAN_FLUX_REF_TORQUE_MODE" 2 "SPEED_MODE" 1 "TORQUE_MODE" 0 "DISABLED" ;
VAL_TABLE_ DBG_dynoOLParamTuneSelector 5 "Llr" 4 "Lls" 3 "Lm" 2 "Rr" 1 "Rs" 0 "None" ;
VAL_TABLE_ DBG_dynoOLSelector 8 "Generic8BitSignals" 7 "Generic14BitSignals" 6 "ParamTune" 5 "IQmax" 4 "GenSineV" 3 "GenSineM" 2 "GenSineI" 1 "GenSineT" 0 "Normal" ;
VAL_TABLE_ DBG_swanStatus 3 "MIA" 2 "ACTUATE" 1 "STANDBY" 0 "NONE" ;
VAL_TABLE_ DIF_VEH_receivedCanIds 2047 "GTW_carConfig" 1910 "DBG_xcpDIFCommand" 1541 "UDS_difRequest" 1320 "GTW_time" 1280 "UI_debugECU" 950 "DI_odometerStatus" 914 "BMS_packConfig" 820 "UI_powertrainControl" 801 "VCFRONT_sensors" 744 "EPBR_status" 680 "EPBL_status" 659 "UI_chassisControl" 644 "UI_vehicleModes" 577 "VCFRONT_coolant" 548 "PCS_dcdcStatus" 545 "VCFRONT_LVPowerState" 530 "BMS_status" 469 "PMF_state4" 306 "BMS_hvBusStatus" ;
VAL_TABLE_ DIF_alerts 255 "DIF_a255_currentGainFallback" 254 "DIF_a254_activeDischargeRail" 253 "DIF_a253_lvBoostedRail" 252 "DIF_a252_currentCoreFallback" 251 "DIF_a251_oilPumpService" 249 "DIF_a249_highStatorTempFromResist" 247 "DIF_a247_rotorOffsetError" 244 "DIF_a244_mechanicalSafeState" 243 "DIF_a243_ecuLogAvailable" 242 "DIF_a242_spinDownLearning" 241 "DIF_a241_systemThermallyLimited" 236 "DIF_a236_tasMIA" 234 "DIF_a234_pcsMIA" 233 "DIF_a233_diMsgMissed" 225 "DIF_a225_tmpEstPlausibility" 202 "DIF_a202_excessHeatUnavailable" 176 "DIF_a176_safetyICFault" 174 "DIF_a174_unitMayNotRestart" 161 "DIF_a161_epas3pMIA" 160 "DIF_a160_busVoltageAnomaly" 158 "DIF_a158_ibstMIA" 157 "DIF_a157_rcmMIA" 156 "DIF_a156_currentObserver" 155 "DIF_a155_vcfrontMIA" 154 "DIF_a154_resolver" 153 "DIF_a153_oilPumpDiagnostics" 152 "DIF_a152_linError" 151 "DIF_a151_shockTorqueLimiter" 150 "DIF_a150_busVD" 149 "DIF_a149_oilPumpFailure" 148 "DIF_a148_burnInCycleEnded" 147 "DIF_a147_highTorqueWearLimit" 144 "DIF_a144_configMismatch" 142 "DIF_a142_highLashAngle" 136 "DIF_a136_spiError" 134 "DIF_a134_wheelSpeedIrrational" 133 "DIF_a133_capacitorOT" 128 "DIF_a128_fpgaVersionMismatch" 127 "DIF_a127_gracefulPowerOff" 126 "DIF_a126_limpMode" 123 "DIF_a123_lossMotorControl" 122 "DIF_a122_highStackUsage" 121 "DIF_a121_motorControlRegulation" 120 "DIF_a120_hvlinkMIA" 119 "DIF_a119_hvpMIA" 117 "DIF_a117_diMIA" 114 "DIF_a114_noMotorSpeed" 113 "DIF_a113_noFuncHeatsinkSensor" 112 "DIF_a112_noPhaseCurrent" 111 "DIF_a111_badPhaseSensorCalib" 110 "DIF_a110_brakeMIA" 108 "DIF_a108_stateTrans" 107 "DIF_a107_fpgaError" 106 "DIF_a106_absMIA" 103 "DIF_a103_lowFlow" 101 "DIF_a101_eccTestData1" 100 "DIF_a100_assertion" 99 "DIF_a099_threadOverrun" 98 "DIF_a098_intTimeTooLong" 97 "DIF_a097_eepromError" 96 "DIF_a096_memoryError" 95 "DIF_a095_canOverrunBusA" 94 "DIF_a094_canDataBusA" 93 "DIF_a093_canHardwareBusA" 92 "DIF_a092_bmsMIA" 91 "DIF_a091_espMIA" 90 "DIF_a090_pmMIA" 88 "DIF_a088_uiMIA" 87 "DIF_a087_gtwMIA" 86 "DIF_a086_activeDischargeOn" 84 "DIF_a084_eccTestData0" 79 "DIF_a079_adcRefHigh" 78 "DIF_a078_adcRefLow" 77 "DIF_a077_12vSupplyUV" 76 "DIF_a076_12vSupplyOV" 75 "DIF_a075_motorSpeedMismatch" 74 "DIF_a074_motorEncoder" 73 "DIF_a073_motorSpeed" 72 "DIF_a072_gateDriveFaultCounter" 71 "DIF_a071_busDisconnected" 70 "DIF_a070_udsTransactionInitiated" 69 "DIF_a069_rotorTempLimit" 67 "DIF_a067_canOverrunBusB" 66 "DIF_a066_canDataBusB" 65 "DIF_a065_canHardwareBusB" 64 "DIF_a064_torqueIntervention" 62 "DIF_a062_systemLimpMode" 61 "DIF_a061_heatsinkSensor" 60 "DIF_a060_heatsinkUT" 59 "DIF_a059_heatsinkOT" 58 "DIF_a058_ambientSensor" 57 "DIF_a057_ambientUT" 56 "DIF_a056_ambientOT" 55 "DIF_a055_trqCrossCheck" 54 "DIF_a054_driveInverterOT" 53 "DIF_a053_unexpectedLatchState" 52 "DIF_a052_dirMIA" 50 "DIF_a050_noStatorSensor" 49 "DIF_a049_statorSensorDiff" 48 "DIF_a048_statorSensor2" 47 "DIF_a047_statorSensor1" 46 "DIF_a046_statorOT" 45 "DIF_a045_outletSensor" 44 "DIF_a044_outletUT" 43 "DIF_a043_outletOT" 42 "DIF_a042_inletSensor" 40 "DIF_a040_difMIA" 38 "DIF_a038_busVsensor" 37 "DIF_a037_busUV" 36 "DIF_a036_busOV" 35 "DIF_a035_phaseCurrentBalance" 34 "DIF_a034_phaseBcurrentSensor" 33 "DIF_a033_phaseAcurrentSensor" 32 "DIF_a032_phaseBcurrentOffset" 31 "DIF_a031_phaseAcurrentOffset" 30 "DIF_a030_phaseCrms" 29 "DIF_a029_phaseBrms" 28 "DIF_a028_phaseArms" 27 "DIF_a027_phaseCpeak" 26 "DIF_a026_phaseBpeak" 25 "DIF_a025_phaseApeak" 24 "DIF_a024_selfTest" 22 "DIF_a022_hw5vSupplyUV" 21 "DIF_a021_hwBusOV" 20 "DIF_a020_hwMotorEncoder" 18 "DIF_a018_hw12vSupplyUV" 17 "DIF_a017_hwPedalMonitor" 16 "DIF_a016_safeStateApplied" 15 "DIF_a015_mechSafeStateAnomaly" 14 "DIF_a014_activeDamping" 13 "DIF_a013_eccError" 11 "DIF_a011_swPowerStageNotReady" 10 "DIF_a010_unintendedReset" 9 "DIF_a009_hwEncoderB" 8 "DIF_a008_hwEncoderA" 7 "DIF_a007_statorAnomalyDetected" 6 "DIF_a006_hwPhaseCpeak" 5 "DIF_a005_hwPhaseBpeak" 4 "DIF_a004_hwPhaseApeak" 3 "DIF_a003_hwPhaseCgateDrive" 2 "DIF_a002_hwPhaseBgateDrive" 1 "DIF_a001_hwPhaseAgateDrive" 0 "DIF_ALERT_DO_NOT_USE_ZERO" 177 "DIF_a177_fluxReferenceCorrected" 162 "DIF_a162_endOfLifetimeBurnIn" ;
VAL_TABLE_ DIF_debugMux 132 "Mux132" 131 "Mux131" 128 "Mux128" 72 "Mux72" 70 "Mux70" 69 "Mux69" 68 "Mux68" 67 "Mux67" 66 "Mux66" 64 "Mux64" 63 "Mux63" 52 "Mux52" 50 "Mux50" 49 "Mux49" 48 "Mux48" 47 "Mux47" 46 "Mux46" 43 "Mux43" 42 "Mux42" 41 "Mux41" 40 "Mux40" 39 "Mux39" 38 "Mux38" 37 "Mux37" 36 "Mux36" 35 "Mux35" 34 "Mux34" 33 "Mux33" 32 "Mux32" ;
VAL_TABLE_ DIF_dynoMux 64 "Mux64" 33 "Mux33" 32 "Mux32" 2 "Mux2" 1 "Mux1" 0 "Mux0" ;
VAL_TABLE_ DIF_elecPower -1024 "SNA" ;
VAL_TABLE_ DIF_temperatureMux 2 "Mux2" 1 "Mux1" 0 "Mux0" 4 "Mux4" 3 "Mux3" ;
VAL_TABLE_ DIR_VEH_receivedCanIds 2047 "GTW_carConfig" 1798 "DBG_xcpDIRCommand" 1542 "UDS_dirRequest" 1320 "GTW_time" 1280 "UI_debugECU" 914 "BMS_packConfig" 820 "UI_powertrainControl" 801 "VCFRONT_sensors" 744 "EPBR_status" 680 "EPBL_status" 659 "UI_chassisControl" 644 "UI_vehicleModes" 577 "VCFRONT_coolant" 548 "PCS_dcdcStatus" 545 "VCFRONT_LVPowerState" 530 "BMS_status" 472 "PMR_state4" 306 "BMS_hvBusStatus" 950 "DI_odometerStatus" ;
VAL_TABLE_ DIR_alerts 255 "DIR_a255_currentGainFallback" 254 "DIR_a254_activeDischargeRail" 253 "DIR_a253_lvBoostedRail" 252 "DIR_a252_currentCoreFallback" 251 "DIR_a251_oilPumpService" 249 "DIR_a249_highStatorTempFromResist" 248 "DIR_a248_vehicleSpeedLimited" 247 "DIR_a247_rotorOffsetError" 244 "DIR_a244_mechanicalSafeState" 243 "DIR_a243_ecuLogAvailable" 242 "DIR_a242_spinDownLearning" 241 "DIR_a241_systemThermallyLimited" 236 "DIR_a236_tasMIA" 234 "DIR_a234_pcsMIA" 233 "DIR_a233_diMsgMissed" 225 "DIR_a225_tmpEstPlausibility" 202 "DIR_a202_excessHeatUnavailable" 176 "DIR_a176_safetyICFault" 174 "DIR_a174_unitMayNotRestart" 161 "DIR_a161_epas3pMIA" 160 "DIR_a160_busVoltageAnomaly" 158 "DIR_a158_ibstMIA" 157 "DIR_a157_rcmMIA" 156 "DIR_a156_currentObserver" 155 "DIR_a155_vcfrontMIA" 154 "DIR_a154_resolver" 153 "DIR_a153_oilPumpDiagnostics" 152 "DIR_a152_linError" 151 "DIR_a151_shockTorqueLimiter" 150 "DIR_a150_busVD" 149 "DIR_a149_oilPumpFailure" 148 "DIR_a148_burnInCycleEnded" 147 "DIR_a147_highTorqueWearLimit" 144 "DIR_a144_configMismatch" 142 "DIR_a142_highLashAngle" 136 "DIR_a136_spiError" 134 "DIR_a134_wheelSpeedIrrational" 133 "DIR_a133_capacitorOT" 128 "DIR_a128_fpgaVersionMismatch" 127 "DIR_a127_gracefulPowerOff" 126 "DIR_a126_limpMode" 123 "DIR_a123_lossMotorControl" 122 "DIR_a122_highStackUsage" 121 "DIR_a121_motorControlRegulation" 120 "DIR_a120_hvlinkMIA" 119 "DIR_a119_hvpMIA" 117 "DIR_a117_diMIA" 114 "DIR_a114_noMotorSpeed" 113 "DIR_a113_noFuncHeatsinkSensor" 112 "DIR_a112_noPhaseCurrent" 111 "DIR_a111_badPhaseSensorCalib" 110 "DIR_a110_brakeMIA" 108 "DIR_a108_stateTrans" 107 "DIR_a107_fpgaError" 106 "DIR_a106_absMIA" 103 "DIR_a103_lowFlow" 101 "DIR_a101_eccTestData1" 100 "DIR_a100_assertion" 99 "DIR_a099_threadOverrun" 98 "DIR_a098_intTimeTooLong" 97 "DIR_a097_eepromError" 96 "DIR_a096_memoryError" 95 "DIR_a095_canOverrunBusA" 94 "DIR_a094_canDataBusA" 93 "DIR_a093_canHardwareBusA" 92 "DIR_a092_bmsMIA" 91 "DIR_a091_espMIA" 90 "DIR_a090_pmMIA" 88 "DIR_a088_uiMIA" 87 "DIR_a087_gtwMIA" 86 "DIR_a086_activeDischargeOn" 84 "DIR_a084_eccTestData0" 79 "DIR_a079_adcRefHigh" 78 "DIR_a078_adcRefLow" 77 "DIR_a077_12vSupplyUV" 76 "DIR_a076_12vSupplyOV" 75 "DIR_a075_motorSpeedMismatch" 74 "DIR_a074_motorEncoder" 73 "DIR_a073_motorSpeed" 72 "DIR_a072_gateDriveFaultCounter" 71 "DIR_a071_busDisconnected" 70 "DIR_a070_udsTransactionInitiated" 69 "DIR_a069_rotorTempLimit" 67 "DIR_a067_canOverrunBusB" 66 "DIR_a066_canDataBusB" 65 "DIR_a065_canHardwareBusB" 64 "DIR_a064_torqueIntervention" 62 "DIR_a062_systemLimpMode" 61 "DIR_a061_heatsinkSensor" 60 "DIR_a060_heatsinkUT" 59 "DIR_a059_heatsinkOT" 58 "DIR_a058_ambientSensor" 57 "DIR_a057_ambientUT" 56 "DIR_a056_ambientOT" 55 "DIR_a055_trqCrossCheck" 54 "DIR_a054_driveInverterOT" 53 "DIR_a053_unexpectedLatchState" 52 "DIR_a052_dirMIA" 50 "DIR_a050_noStatorSensor" 49 "DIR_a049_statorSensorDiff" 48 "DIR_a048_statorSensor2" 47 "DIR_a047_statorSensor1" 46 "DIR_a046_statorOT" 45 "DIR_a045_outletSensor" 44 "DIR_a044_outletUT" 43 "DIR_a043_outletOT" 42 "DIR_a042_inletSensor" 40 "DIR_a040_difMIA" 38 "DIR_a038_busVsensor" 37 "DIR_a037_busUV" 36 "DIR_a036_busOV" 35 "DIR_a035_phaseCurrentBalance" 34 "DIR_a034_phaseBcurrentSensor" 33 "DIR_a033_phaseAcurrentSensor" 32 "DIR_a032_phaseBcurrentOffset" 31 "DIR_a031_phaseAcurrentOffset" 30 "DIR_a030_phaseCrms" 29 "DIR_a029_phaseBrms" 28 "DIR_a028_phaseArms" 27 "DIR_a027_phaseCpeak" 26 "DIR_a026_phaseBpeak" 25 "DIR_a025_phaseApeak" 24 "DIR_a024_selfTest" 22 "DIR_a022_hw5vSupplyUV" 21 "DIR_a021_hwBusOV" 20 "DIR_a020_hwMotorEncoder" 18 "DIR_a018_hw12vSupplyUV" 17 "DIR_a017_hwPedalMonitor" 16 "DIR_a016_safeStateApplied" 15 "DIR_a015_mechSafeStateAnomaly" 14 "DIR_a014_activeDamping" 13 "DIR_a013_eccError" 11 "DIR_a011_swPowerStageNotReady" 10 "DIR_a010_unintendedReset" 9 "DIR_a009_hwEncoderB" 8 "DIR_a008_hwEncoderA" 7 "DIR_a007_statorAnomalyDetected" 6 "DIR_a006_hwPhaseCpeak" 5 "DIR_a005_hwPhaseBpeak" 4 "DIR_a004_hwPhaseApeak" 3 "DIR_a003_hwPhaseCgateDrive" 2 "DIR_a002_hwPhaseBgateDrive" 1 "DIR_a001_hwPhaseAgateDrive" 0 "DIR_ALERT_DO_NOT_USE_ZERO" 177 "DIR_a177_fluxReferenceCorrected" 162 "DIR_a162_endOfLifetimeBurnIn" ;
VAL_TABLE_ DIR_debugMux 132 "Mux132" 131 "Mux131" 128 "Mux128" 72 "Mux72" 70 "Mux70" 69 "Mux69" 68 "Mux68" 67 "Mux67" 66 "Mux66" 64 "Mux64" 63 "Mux63" 52 "Mux52" 50 "Mux50" 49 "Mux49" 48 "Mux48" 47 "Mux47" 46 "Mux46" 43 "Mux43" 42 "Mux42" 41 "Mux41" 40 "Mux40" 39 "Mux39" 38 "Mux38" 37 "Mux37" 36 "Mux36" 35 "Mux35" 34 "Mux34" 33 "Mux33" 32 "Mux32" ;
VAL_TABLE_ DIR_dynoMux 64 "Mux64" 33 "Mux33" 32 "Mux32" 2 "Mux2" 1 "Mux1" 0 "Mux0" ;
VAL_TABLE_ DIR_elecPower -1024 "SNA" ;
VAL_TABLE_ DIR_temperatureMux 2 "Mux2" 1 "Mux1" 0 "Mux0" 4 "Mux4" 3 "Mux3" ;
VAL_TABLE_ DI_FPGA_version 255 "FPGA_VERSION_SNA" 254 "FPGA_VERSION_LOCAL_BUILD" ;
VAL_TABLE_ DI_TPakTemperature 0 "SNA" ;
VAL_TABLE_ DI_VEH_receivedCanIds 2047 "GTW_carConfig" 1926 "DBG_dynoVehicleSim" 1911 "DBG_xcpDICommand" 1863 "DBG_DI_vdcControl" 1862 "DBG_dynoControl" 1562 "UDS_diRequest" 1320 "GTW_time" 1280 "UI_debugECU" 1106 "BMS_voltageRegGain" 1005 "GTW_updateStatus" 985 "VCSEC_authenticityResponse" 962 "VCLEFT_switchStatus" 947 "UI_vehicleControl2" 929 "VCFRONT_vehicleStatus" 925 "IBST_status" 914 "BMS_packConfig" 851 "UI_status" 820 "UI_powertrainControl" 801 "VCFRONT_sensors" 799 "TPMS_data" 787 "UI_trackModeSettings" 786 "BMS_thermalStatus" 744 "EPBR_status" 741 "DIF_power" 737 "VCFRONT_status" 722 "BMS_driveLimits" 680 "EPBL_status" 679 "CMPD_state" 659 "UI_chassisControl" 644 "UI_vehicleModes" 614 "DIR_power" 605 "CP_status" 602 "VCSEC_TPMSDisplay" 594 "BMS_powerAvailable" 583 "CMP_HVStatus" 577 "VCFRONT_coolant" 553 "SCCM_rightStalk" 548 "PCS_dcdcStatus" 545 "VCFRONT_LVPowerState" 531 "UI_cruiseControl" 530 "BMS_status" 519 "PTC_feedbackStatus" 421 "DIF_hvStatus" 306 "BMS_hvBusStatus" 294 "DIR_hvStatus" 262 "DBG_swanCommand" 259 "VCRIGHT_doorStatus" 258 "VCLEFT_doorStatus" 130 "UI_tripPlanning" 472 "PMR_state4" 469 "PMF_state4" ;
VAL_TABLE_ DI_a011_reason 3 "FAULT_DURING_CONFIG" 2 "CRC_MISMATCH" 1 "REG_DATA_MISMATCH" 0 "GATE_DRIVE_SUPPLY" ;
VAL_TABLE_ DI_a015_reason 1 "ARMED_AFTER_PREAUTH" 0 "AUTH_FAIL" ;
VAL_TABLE_ DI_a038_reason 2 "DI_BMS_VOLTAGE_MISMATCH" 1 "UNDERVOLTAGE_HV_UP" 0 "UNDERVOLTAGE_PRE_CHARGE" ;
VAL_TABLE_ DI_a055_torqueType 2 "PEDAL_POSITION" 1 "TORQUE_COMMAND" 0 "TORQUE_ESTIMATE" ;
VAL_TABLE_ DI_a061_reason 1 "RAILED" 0 "RATE_OF_CHANGE" ;
VAL_TABLE_ DI_a061_sensor 2 "PH3" 1 "PH2" 0 "PH1" ;
VAL_TABLE_ DI_a074_speedType 3 "DELTA" 2 "MOTOR" 1 "EDGE2" 0 "EDGE1" ;
VAL_TABLE_ DI_a090_reason 1 "TOOFAST" 0 "TOOSLOW" ;
VAL_TABLE_ DI_a097_errorType 6 "DPOT_WRITE" 5 "DPOT_READ" 4 "LOST" 3 "CRC" 2 "WRITE" 1 "READ" 0 "OPEN" ;
VAL_TABLE_ DI_a121_badRegReason 5 "TORQUE_OFF_TARGET" 4 "FLUX_OFF_TARGET" 3 "IQ_OFF_TARGET" 2 "ID_OFF_TARGET" 1 "RMS_I_HIGH" ;
VAL_TABLE_ DI_a123_lossReason 4 "HIGH_FLUX_DISTURBANCE" 3 "HIGH_VAR_CURR" 2 "HIGH_VAR_FLUX" 1 "NO_FLUX_UP" ;
VAL_TABLE_ DI_a136_spiErrorType 7 "DI_SPI_BUFFER0_OVERWRITE" 6 "DI_SPI_UNKNOWN_ID" 5 "DI_SPI_CRC_MISMATCH" 4 "DI_SPI_CANID_MISMATCH" 3 "DI_SPI_SUBID_SEQUENCE" 2 "DI_SPI_SYNC_BIT" 1 "DI_SPI_RESERVED" 0 "DI_SPI_NONE" ;
VAL_TABLE_ DI_a233_impactedWheel 2 "UNKNOWN" 1 "FRONT_RIGHT" 0 "FRONT_LEFT" ;
VAL_TABLE_ DI_a253_reason 2 "OVERVOLTAGE" 1 "UNDERVOLTAGE" 0 "NONE" ;
VAL_TABLE_ DI_a254_reason 2 "OVERVOLTAGE" 1 "UNDERVOLTAGE" 0 "NONE" ;
VAL_TABLE_ DI_accelPedalPos 255 "SNA" ;
VAL_TABLE_ DI_activeState 1 "ACTIVE" 0 "INACTIVE" ;
VAL_TABLE_ DI_aebFaultReason 15 "DI_AEB_FAULT_DAS_REQ_DI_UNAVAIL" 14 "DI_AEB_FAULT_ACCEL_REQ_INVALID" 13 "DI_AEB_FAULT_MIN_TIME_BTWN_EVENTS" 12 "DI_AEB_FAULT_ESP_MIA" 11 "DI_AEB_FAULT_ESP_FAULT" 10 "DI_AEB_FAULT_EPB_NOT_PARKED" 9 "DI_AEB_FAULT_ACCEL_OUT_OF_BOUNDS" 8 "DI_AEB_FAULT_PM_REQUEST" 7 "DI_AEB_FAULT_VEL_EST_ABNORMAL" 6 "DI_AEB_FAULT_DAS_SNA" 5 "DI_AEB_FAULT_DAS_CONTROL_MIA" 4 "DI_AEB_FAULT_SPEED_DELTA" 3 "DI_AEB_FAULT_EBR_FAULT" 2 "DI_AEB_FAULT_PM_MIA" 1 "DI_AEB_FAULT_EPB_MIA" 0 "DI_AEB_FAULT_NONE" ;
VAL_TABLE_ DI_aebSmState 6 "DI_AEB_STATE_FAULT" 5 "DI_AEB_STATE_EXIT" 4 "DI_AEB_STATE_STANDSTILL" 3 "DI_AEB_STATE_STOPPING" 2 "DI_AEB_STATE_ENABLE" 1 "DI_AEB_STATE_STANDBY" 0 "DI_AEB_STATE_UNAVAILABLE" ;
VAL_TABLE_ DI_aebState 7 "AEB_CAN_STATE_SNA" 4 "AEB_CAN_STATE_FAULT" 3 "AEB_CAN_STATE_STANDSTILL" 2 "AEB_CAN_STATE_ENABLED" 1 "AEB_CAN_STATE_STANDBY" 0 "AEB_CAN_STATE_UNAVAILABLE" ;
VAL_TABLE_ DI_aebUnavailableReason 10 "DI_AEB_UNAVAILABLE_REVERSE_SPEED" 9 "DI_AEB_UNAVAILABLE_TRACK_MODE" 8 "DI_AEB_UNAVAILABLE_HYSTERESIS" 7 "DI_AEB_UNAVAILABLE_EPB" 6 "DI_AEB_UNAVAILABLE_EBR_UNAVAILABLE" 5 "DI_AEB_UNAVAILABLE_DI_STATE" 4 "DI_AEB_UNAVAILABLE_NEGATIVE_SPEED" 3 "DI_AEB_UNAVAILABLE_SKID" 2 "DI_AEB_UNAVAILABLE_GEAR" 1 "DI_AEB_UNAVAILABLE_CLOSURE" 0 "DI_AEB_UNAVAILABLE_NONE" ;
VAL_TABLE_ DI_alerts 253 "DI_a253_accelSynchWarn" 252 "DI_a252_swanMIA" 251 "DI_a251_diPowerOnStateMismatch" 250 "DI_a250_tasSpeedLimitActive" 249 "DI_a249_spinDownLearningInProgress" 246 "DI_a246_opdUnavailable" 245 "DI_a245_opdReducedWithoutEbr" 244 "DI_a244_vseRLSMassMismatch" 242 "DI_a242_vdcTrailerSwayDetected" 241 "DI_a241_vdcMotorSpeed_dir" 240 "DI_a240_torqueSplitStuck" 239 "DI_a239_neutralRequestByPM" 238 "DI_a238_brakeOverTempBrembo" 236 "DI_a236_tasMIA" 235 "DI_a235_trackModeActive" 234 "DI_a234_pcsMIA" 233 "DI_a233_frontWheelImpactDetected" 232 "DI_a232_velocityEstimatorDegraded" 231 "DI_a231_ptcMIA" 230 "DI_a230_cmpMIA" 229 "DI_a229_heatingOnNav" 228 "DI_a228_brakeTempEstUnavailable" 227 "DI_a227_contactorsNotClosed" 226 "DI_a226_sysStartConditionNotMet" 224 "DI_a224_brakeOverTemp" 223 "DI_a223_tractionControlDisabled" 222 "DI_a222_vdcDisabled" 221 "DI_a221_vdcUndersteerdMzActive" 220 "DI_a220_vdcUndersteerDecelActive" 219 "DI_a219_vdcOversteerdMzActive" 218 "DI_a218_vdcOSPreControlActive" 217 "DI_a217_vdcOutputIrrational" 216 "DI_a216_vdcMBPAlmostTripped" 215 "DI_a215_vdcWheelSpeedRe" 214 "DI_a214_vdcWheelSpeedFr" 213 "DI_a213_lowMuProbabilityChange" 212 "DI_a212_vdcWheelRotations" 211 "DI_a211_vdcMotorSpeed_dif" 210 "DI_a210_vdcOtherControllerStates" 208 "DI_a208_vdcPowertrainTorque_dir" 207 "DI_a207_vdcPowertrainTorque_dif" 206 "DI_a206_vdcRcmVertical" 205 "DI_a205_vdcRcmLateral" 204 "DI_a204_vdcRcmLongitudinal" 203 "DI_a203_TCReducedByADD" 202 "DI_a202_excessHeatUnavailable" 201 "DI_a201_decelTorqueLimited" 200 "DI_a200_vdcModelBasedPlausibility" 199 "DI_a199_vdcFaulted" 198 "DI_a198_vdcEspMCPressAndSteering" 197 "DI_a197_vdcEspWheelSaturations" 196 "DI_a196_vdcEspSlipRe" 195 "DI_a195_vdcEspSlipFr" 194 "DI_a194_vdcBrakeTorqueRe" 193 "DI_a193_vdcBrakeTorqueFr" 192 "DI_a192_invalidOdometer" 191 "DI_a191_brakeShiftReq" 190 "DI_a190_tireRotationRecommended" 189 "DI_a189_garageShiftWithPedal" 187 "DI_a187_pedalMisapplication" 186 "DI_a186_brakeStand" 185 "DI_a185_autoparkAborted" 184 "DI_a184_autoparkCanceled" 183 "DI_a183_holdReleaseRqrd" 182 "DI_a182_frontMotorMode" 181 "DI_a181_rearMotorMode" 180 "DI_a180_crsSeatbeltUnbuckled" 179 "DI_a179_steeringAngleOffsetWarning" 178 "DI_a178_steeringAngleOffsetFault" 177 "DI_a177_tireFitmentChanged" 176 "DI_a176_EBRreleased" 175 "DI_a175_crsNotAvailable" 174 "DI_a174_notOkToStartDrive" 173 "DI_a173_bothPedalsPressed" 172 "DI_a172_accelPressedInNP" 171 "DI_a171_driveRailNotRequested" 169 "DI_a169_regenOffOverride" 168 "DI_a168_proximityDriveDenial" 167 "DI_a167_keyNotAuthenticated" 166 "DI_a166_driverLeft" 165 "DI_a165_cruiseCancelled" 164 "DI_a164_brakeOverride" 163 "DI_a163_shiftMotorSpeed" 162 "DI_a162_shiftDenied" 161 "DI_a161_epas3pMIA" 159 "DI_a159_cruiseSelfCheck" 158 "DI_a158_ibstMIA" 157 "DI_a157_rcmMIA" 155 "DI_a155_vcfrontMIA" 148 "DI_a148_overtorqueUsed" 146 "DI_a146_pbrkPanicEpbFault" 145 "DI_a145_pbrkPanicSkid" 144 "DI_a144_configMismatch" 143 "DI_a143_mcuLimitActive" 141 "DI_a141_dasMIA" 139 "DI_a139_rearUnitDisabled" 138 "DI_a138_frontUnitDisabled" 137 "DI_a137_noCapableDriveUnits" 135 "DI_a135_vehicleHoldFault" 134 "DI_a134_wheelSpeedIrrational" 131 "DI_a131_highSpeedWearLimit" 130 "DI_a130_aebFault" 129 "DI_a129_epbNotApplied" 125 "DI_a125_noBatteryPower" 124 "DI_a124_cruiseFault" 122 "DI_a122_highStackUsage" 119 "DI_a119_hvpMIA" 116 "DI_a116_powerConvIrrational" 110 "DI_a110_brakeMIA" 109 "DI_a109_cruiseMIA" 105 "DI_a105_cpMIA" 104 "DI_a104_proximityIrrational" 101 "DI_a101_eccTestData1" 99 "DI_a099_threadOverrun" 97 "DI_a097_eepromError" 96 "DI_a096_memoryError" 95 "DI_a095_canOverrunBusA" 94 "DI_a094_canDataBusA" 93 "DI_a093_canHardwareBusA" 92 "DI_a092_bmsMIA" 91 "DI_a091_espMIA" 90 "DI_a090_pmMIA" 89 "DI_a089_sccmMIA" 88 "DI_a088_uiMIA" 87 "DI_a087_gtwMIA" 85 "DI_a085_proximityInEnable" 84 "DI_a084_eccTestData0" 83 "DI_a083_brakePedalSensor" 82 "DI_a082_accelTrack2" 81 "DI_a081_accelTrack1" 80 "DI_a080_accelSynch" 79 "DI_a079_adcRefHigh" 78 "DI_a078_adcRefLow" 77 "DI_a077_12vSupplyUV" 76 "DI_a076_12vSupplyOV" 70 "DI_a070_udsTransactionInitiated" 67 "DI_a067_canOverrunBusB" 66 "DI_a066_canDataBusB" 65 "DI_a065_canHardwareBusB" 63 "DI_a063_systemGracefulPowerOff" 62 "DI_a062_systemLimpMode" 52 "DI_a052_dirMIA" 51 "DI_a051_batteryOvercurrent" 41 "DI_a041_driverBrakeApplyStuck" 40 "DI_a040_difMIA" 25 "DI_a025_regenBackfillUnavailable" 24 "DI_a024_holdNForNeutral" 23 "DI_a023_carNotParked" 22 "DI_a022_hw5vSupplyUV" 21 "DI_a021_packOvervoltage" 19 "DI_a019_hwAccelPedalPower" 18 "DI_a018_hw12vSupplyUV" 17 "DI_a017_hwPedalMonitor" 16 "DI_a016_parkRequestByPM" 15 "DI_a015_immobilizer" 13 "DI_a013_eccError" 12 "DI_a012_accel5VSupply" 10 "DI_a010_unintendedReset" 5 "DI_a005_stalkPanicked" 2 "DI_a002_parkButtonDuringStalkReq" 1 "DI_a001_frunkSpeedLimitActive" 0 "DI_ALERT_DO_NOT_USE_ZERO" 188 "DI_a188_tireRotationRecommendedGhosted" 170 "DI_a170_tireConfigUpdated" 100 "DI_a100_nvramError" 98 "DI_a098_eepromManagerError" 61 "DI_a061_canHardwareBusE" 60 "DI_a060_canOverrunBusE" 59 "DI_a059_canDataBusE" 58 "DI_a058_canHardwareBusD" 57 "DI_a057_canOverrunBusD" 56 "DI_a056_canDataBusD" 55 "DI_a055_canHardwareBusC" 54 "DI_a054_canOverrunBusC" 53 "DI_a053_canDataBusC" 43 "DI_a043_pmrMIA" 42 "DI_a042_pmfMIA" ;
VAL_TABLE_ DI_apcCancelReason 24 "DI_APC_ABORT_GEAR_STALK" 23 "DI_APC_ABORT_EPB_INTERLOCK" 22 "DI_APC_ABORT_EPB_FAULT" 21 "DI_APC_ABORT_DISTANCE" 20 "DI_APC_ABORT_GRADE_TOO_STEEP" 19 "DI_APC_ABORT_VEHICLE_SPEED" 18 "DI_APC_ABORT_DAS_SPEED" 17 "DI_APC_CANCEL_SELFPARK_STATE_TIMEOUT" 16 "DI_APC_ABORT_DRIVER_LEAVING" 15 "DI_APC_ABORT_CLOSURE" 14 "DI_APC_ABORT_BRAKE" 13 "DI_APC_ABORT_CRUISE_STATE" 12 "DI_APC_ABORT_STOPPING_TIMEOUT" 11 "DI_APC_ABORT_DI_SYS_STATE" 10 "DI_APC_ABORT_SHIFT_TIMEOUT" 9 "DI_APC_ABORT_CONTROL_INTEGRATOR" 8 "DI_APC_ABORT_DAS_STATE" 7 "DI_APC_ABORT_DAS_REQUEST" 6 "DI_APC_CANCEL_CRUISE" 5 "DI_APC_CANCEL_AEB_ACTIVE" 4 "DI_APC_ABORT_MOTION_TIMEOUT" 3 "DI_APC_ABORT_OVERRIDE" 2 "DI_APC_CANCEL_EPB_APPLY" 1 "DI_APC_CANCEL_GEAR" 0 "DI_APC_CANCEL_NONE" ;
VAL_TABLE_ DI_apcUnavailableReason 14 "DI_APC_UNAVAILABLE_ACCEL_PEDAL" 13 "DI_APC_UNAVAILABLE_BRAKE_PEDAL" 12 "DI_APC_UNAVAILABLE_SYSTEM_STATE" 11 "DI_APC_UNAVAILABLE_EBR" 10 "DI_APC_UNAVAILABLE_GEAR" 9 "DI_APC_UNAVAILABLE_NOT_SUPPORTED" 8 "DI_APC_UNAVAILABLE_TRAILER_MODE" 7 "DI_APC_UNAVAILABLE_EPB" 6 "DI_APC_UNAVAILABLE_VALET_MODE" 5 "DI_APC_UNAVAILABLE_GRADE_TOO_STEEP" 4 "DI_APC_UNAVAILABLE_DRIVER_LEAVING" 3 "DI_APC_UNAVAILABLE_CLOSURE_OPEN" 2 "DI_APC_UNAVAILABLE_VDC" 1 "DI_APC_UNAVAILABLE_CRUISE" 0 "DI_APC_UNAVAILABLE_NONE" ;
VAL_TABLE_ DI_autoparkInternalState 17 "APC_STATE_ABORTED" 16 "APC_STATE_ABORTING" 15 "APC_STATE_UNPARK_COMPLETE" 14 "APC_STATE_COMPLETE" 13 "APC_STATE_PRE_COMPLETE" 12 "APC_STATE_ACTIVE_SHFT_R" 11 "APC_STATE_ACTIVE_SHFT_D" 10 "APC_STATE_ACTIVE_DRIVE_FW" 9 "APC_STATE_ACTIVE_DRIVE_BW" 8 "APC_STATE_RESUMED" 7 "APC_STATE_PAUSED" 6 "APC_STATE_PAUSING" 5 "APC_STATE_SELFPARK_UNPARK" 4 "APC_STATE_SELFPARK_START" 3 "APC_STATE_STARTED_CRUISE" 2 "APC_STATE_STARTED_BRAKE" 1 "APC_STATE_STANDBY" 0 "APC_STATE_UNAVAILABLE" ;
VAL_TABLE_ DI_autoparkState 15 "DI_APC_SNA" 9 "DI_APC_SELFPARK_STARTED" 8 "DI_APC_UNPARK_COMPLETE" 7 "DI_APC_RESUMED" 6 "DI_APC_ABORTED" 5 "DI_APC_PAUSED" 4 "DI_APC_COMPLETE" 3 "DI_APC_ACTIVE" 2 "DI_APC_STARTED" 1 "DI_APC_STANDBY" 0 "DI_APC_UNAVAILABLE" ;
VAL_TABLE_ DI_axleSpeed -32768 "SNA" ;
VAL_TABLE_ DI_brakePedalState 2 "INVALID" 1 "ON" 0 "OFF" ;
VAL_TABLE_ DI_brakeTemps 1023 "SNA" ;
VAL_TABLE_ DI_brkStState 6 "BRKST_STATE_FINISHED" 5 "BRKST_STATE_INTERRUPTED" 4 "BRKST_STATE_RUNNING_PRESSED" 3 "BRKST_STATE_RUNNING_PRESSING" 2 "BRKST_STATE_RUNNING_UNPRESSED" 1 "BRKST_STATE_IDLE" 0 "BRKST_STATE_UNAVAILABLE" ;
VAL_TABLE_ DI_btcState 1 "ON" 0 "OFF" ;
VAL_TABLE_ DI_burnInStatus 5 "COMPLETE" 4 "ACTIVE" 3 "INCOMPLETE" 2 "UNAVAILABLE" 1 "NOT_REQUIRED" 0 "INIT" ;
VAL_TABLE_ DI_canHardwareError 1 "DI_CAN_HARDWARE_TRANSMIT_ERROR" 0 "DI_CAN_HARDWARE_RECEIVE_ERROR" ;
VAL_TABLE_ DI_criticalFlowReq 1 "ACTIVE" 0 "NOT_ACTIVE" ;
VAL_TABLE_ DI_cruiseCancelReason 9 "DI_CRUISE_CANCEL_SHIFT_REQUEST" 8 "DI_CRUISE_CANCEL_ACCEL_OVERRIDE_IN_REVERSE" 7 "DI_CRUISE_CANCEL_DAS" 6 "DI_CRUISE_CANCEL_PARK" 5 "DI_CRUISE_CANCEL_GEAR" 4 "DI_CRUISE_CANCEL_STALK" 3 "DI_CRUISE_CANCEL_BRAKE" 2 "DI_CRUISE_CANCEL_SKID" 1 "DI_CRUISE_CANCEL_APC_REQUEST" 0 "DI_CRUISE_CANCEL_NONE" ;
VAL_TABLE_ DI_cruiseFaultReason 22 "DI_CRUISE_FAULT_VHLD_FAULTED" 21 "DI_CRUISE_FAULT_CONFIG_MISMATCH" 20 "DI_CRUISE_FAULT_EPB_MIA" 19 "DI_CRUISE_FAULT_ACCEL_JERK_OUT_OF_ISO_BOUNDS" 18 "DI_CRUISE_FAULT_DAS_CONTROL_MIA" 17 "DI_CRUISE_FAULT_DAS_SNA" 16 "DI_CRUISE_FAULT_VELOCITY_ESTIMATE_NOT_NORMAL" 15 "DI_CRUISE_FAULT_ACCEL_OUT_OF_BOUNDS" 14 "DI_CRUISE_FAULT_EBR_FAULT" 13 "DI_CRUISE_FAULT_TC_FAULT" 12 "DI_CRUISE_FAULT_ESP_MIA" 11 "DI_CRUISE_FAULT_VDC_FAULT" 10 "DI_CRUISE_FAULT_EPB_FAULT" 9 "DI_CRUISE_FAULT_BRAKE_MIA" 8 "DI_CRUISE_FAULT_CRS_STATE_MISM" 7 "DI_CRUISE_FAULT_ABS_MIA" 6 "DI_CRUISE_FAULT_CRUISE_SCCM_MIA" 5 "DI_CRUISE_FAULT_BRAKE_INVALID" 4 "DI_CRUISE_FAULT_STALK" 3 "DI_CRUISE_FAULT_PM_REQUEST" 2 "DI_CRUISE_FAULT_PM_MIA" 1 "DI_CRUISE_FAULT_MOTOR_SPEED_MISMATCH" 0 "DI_CRUISE_FAULT_NONE" ;
VAL_TABLE_ DI_cruiseNotAvailableReason 25 "DI_CRUISE_NOT_AVAILABLE_ACC_BACKWARD_AT_HIGH_FORWARD_SPEED" 24 "DI_CRUISE_NOT_AVAILABLE_DAS_SET_SPEED_TOO_HIGH_IN_REVERSE" 23 "DI_CRUISE_NOT_AVAILABLE_MOTOR_SPEED_TOO_HIGH_IN_REVERSE" 22 "DI_CRUISE_NOT_AVAILABLE_VHLD_UNAVAILABLE" 21 "DI_CRUISE_NOT_AVAILABLE_CRUISE_FAULTED" 20 "DI_CRUISE_NOT_AVAILABLE_TRACK_MODE_ACTIVE" 19 "DI_CRUISE_NOT_AVAILABLE_DAS_SNA" 18 "DI_CRUISE_NOT_AVAILABLE_UI_MIA" 17 "DI_CRUISE_NOT_AVAILABLE_WAIT_INIT" 16 "DI_CRUISE_NOT_AVAILABLE_VEL_EST" 15 "DI_CRUISE_NOT_AVAILABLE_MIN_SPEED" 14 "DI_CRUISE_NOT_AVAILABLE_AEB" 13 "DI_CRUISE_NOT_AVAILABLE_CONFIG" 12 "DI_CRUISE_NOT_AVAILABLE_DI_STATE" 11 "DI_CRUISE_NOT_AVAILABLE_MOTOR_SPEED" 10 "DI_CRUISE_NOT_AVAILABLE_EBR" 9 "DI_CRUISE_NOT_AVAILABLE_VALET_MODE" 8 "DI_CRUISE_NOT_AVAILABLE_SEAT_BELT_UNBUCKLED" 7 "DI_CRUISE_NOT_AVAILABLE_CLOSURE_OPEN" 6 "DI_CRUISE_NOT_AVAILABLE_ACC_CANCEL" 5 "DI_CRUISE_NOT_AVAILABLE_ABS_ACTIVE" 4 "DI_CRUISE_NOT_AVAILABLE_TC_ACTIVE" 3 "DI_CRUISE_NOT_AVAILABLE_VDC_ACTIVE_OR_DEGRADED" 2 "DI_CRUISE_NOT_AVAILABLE_VDC_OR_TC_OFF" 1 "DI_CRUISE_NOT_AVAILABLE_NO_ALERT" 0 "DI_CRUISE_NOT_AVAILABLE_NONE" 27 "DI_CRUISE_NOT_AVAILABLE_UNIT0_FAULT" 26 "DI_CRUISE_NOT_AVAILABLE_BRAKE_TEMPERATURE" ;
VAL_TABLE_ DI_cruiseRegulationState 9 "CRS_REG_FAULT" 8 "CRS_REG_OVERRIDE" 7 "CRS_REG_RESTART" 6 "CRS_REG_STANDSTILL" 5 "CRS_REG_HOLD" 4 "CRS_REG_STOPPING" 3 "CRS_REG_ENABLE" 2 "CRS_REG_ENABLE_INIT" 1 "CRS_REG_STANDBY" 0 "CRS_REG_UNAVAILABLE" ;
VAL_TABLE_ DI_cruiseState 7 "CRS_STATE_PRE_CANCEL" 6 "CRS_STATE_PRE_FAULT" 5 "CRS_STATE_FAULT" 4 "CRS_STATE_OVERRIDE" 3 "CRS_STATE_STANDSTILL" 2 "CRS_STATE_ENABLED" 1 "CRS_STATE_STANDBY" 0 "CRS_STATE_UNAVAILABLE" ;
VAL_TABLE_ DI_currentObserverObservation 10 "PSTG_OBS_UNKNOWN" 9 "PSTG_OBS_SINGLE_OPEN_PHASE" 8 "PSTG_OBS_DIODE_OPEN_LOW" 7 "PSTG_OBS_DIODE_OPEN_HIGH" 6 "PSTG_OBS_DOUBLE_SHORT_LOW" 5 "PSTG_OBS_DOUBLE_SHORT_HIGH" 4 "PSTG_OBS_SINGLE_SHORT_LOW" 3 "PSTG_OBS_SINGLE_SHORT_HIGH" 2 "PSTG_OBS_UNCONTROLLED_REGEN" 1 "PSTG_OBS_THREE_PHASE_SHORT" 0 "PSTG_OBS_NO_CURRENT" ;
VAL_TABLE_ DI_currentObserverPolarity 3 "PSTG_OBS_POLARITY_ALL" 2 "PSTG_OBS_POLARITY_POSITIVE" 1 "PSTG_OBS_POLARITY_NEGATIVE" 0 "PSTG_OBS_POLARITY_ZERO" ;
VAL_TABLE_ DI_currentObserverResult 2 "PSTG_OBS_RESULT_SPEED_LOW" 1 "PSTG_OBS_RESULT_SENSOR_BAD" 0 "PSTG_OBS_RESULT_SUCCESS" ;
VAL_TABLE_ DI_debugMux 75 "longControl" 68 "Mux68" 67 "Mux67" 66 "Mux66" 65 "Mux65" 53 "Mux53" 50 "sysHeat" 45 "aeb" 39 "regenBackfill" 38 "pedalTorque1" 37 "onePedalDriving3" 36 "onePedalDriving2" 35 "onePedalDriving1" 34 "sysPedal" 33 "Mux33" 32 "pwrSat" 2 "Mux2" ;
VAL_TABLE_ DI_driveBlocked 3 "DRIVE_BLOCKED_FALCON" 2 "DRIVE_BLOCKED_PROX" 1 "DRIVE_BLOCKED_FRUNK" 0 "DRIVE_BLOCKED_NONE" ;
VAL_TABLE_ DI_drivePowerMax 511 "SNA" ;
VAL_TABLE_ DI_epbRequest 2 "DI_EPBREQUEST_UNPARK" 1 "DI_EPBREQUEST_PARK" 0 "DI_EPBREQUEST_NO_REQUEST" ;
VAL_TABLE_ DI_excessHeatUnavailableReason 12 "DI_WASTE_UNAVAILABLE_CRUISE" 11 "DI_WASTE_UNAVAILABLE_OPD" 10 "DI_WASTE_UNAVAILABLE_UI" 9 "DI_WASTE_UNAVAILABLE_DRV_FAULT" 8 "DI_WASTE_UNAVAILABLE_IMMEDIATE" 7 "DI_WASTE_UNAVAILABLE_SERVICE_MODE" 6 "DI_WASTE_UNAVAILABLE_UPDATE_STARTED" 5 "DI_WASTE_UNAVAILABLE_GPO" 4 "DI_WASTE_UNAVAILABLE_LIMP" 3 "DI_WASTE_UNAVAILABLE_MOVEMENT" 2 "DI_WASTE_UNAVAILABLE_PARKBRAKE" 1 "DI_WASTE_UNAVAILABLE_NO_ALERT" 0 "DI_WASTE_UNAVAILABLE_NONE" ;
VAL_TABLE_ DI_fetBurnIn 65535 "SNA" ;
VAL_TABLE_ DI_fluxState 10 "DI_FLUXSTATE_STATIONARY_WASTE" 9 "DI_FLUXSTATE_FAULT" 7 "DI_FLUXSTATE_VCONTROL" 6 "DI_FLUXSTATE_ICONTROL" 5 "DI_FLUXSTATE_ENABLED" 4 "DI_FLUXSTATE_FLUX_DOWN" 3 "DI_FLUXSTATE_FLUX_UP" 2 "DI_FLUXSTATE_STANDBY" 1 "DI_FLUXSTATE_TEST" 0 "DI_FLUXSTATE_START" ;
VAL_TABLE_ DI_gateDriveState 4 "PSTG_GD_STATE_NOT_CONFIGURED" 3 "PSTG_GD_STATE_CONFIGURED" 2 "PSTG_GD_STATE_CONFIGURING" 1 "PSTG_GD_STATE_SELFTEST" 0 "PSTG_GD_STATE_INIT" ;
VAL_TABLE_ DI_gateDriveSupplyState 3 "PSTG_GD_SUPPLY_FALLING" 2 "PSTG_GD_SUPPLY_UP" 1 "PSTG_GD_SUPPLY_RISING" 0 "PSTG_GD_SUPPLY_DOWN" ;
VAL_TABLE_ DI_gear 7 "DI_GEAR_SNA" 4 "DI_GEAR_D" 3 "DI_GEAR_N" 2 "DI_GEAR_R" 1 "DI_GEAR_P" 0 "DI_GEAR_INVALID" ;
VAL_TABLE_ DI_gpoReason 8 "DI_GPO_MOTOR_HALT_REQUEST" 7 "DI_GPO_CAPACITOR_OVERTEMP" 6 "DI_GPO_NOT_ENOUGH_12V" 5 "DI_GPO_NO_BATTERY_POWER" 4 "DI_GPO_AMBIENT_OVERTEMP" 3 "DI_GPO_FLUID_DELTAT" 2 "DI_GPO_STATOR_OVERTEMP" 1 "DI_GPO_HEATSINK_OVERTEMP" 0 "DI_GPO_OUTLET_OVERTEMP" ;
VAL_TABLE_ DI_hvilStatus 3 "SNA" 2 "CLOSED" 1 "OPEN" 0 "DISABLED" ;
VAL_TABLE_ DI_hvilSupplyState 2 "ACTIVE" 1 "INACTIVE" 0 "NOT_AVAILABLE" ;
VAL_TABLE_ DI_immobilizerCondition 1 "DI_IMM_CONDITION_LEARNED" 0 "DI_IMM_CONDITION_VIRGIN_SNA" ;
VAL_TABLE_ DI_immobilizerState 6 "DI_IMM_STATE_FAULT" 5 "DI_IMM_STATE_RESET" 4 "DI_IMM_STATE_IDLE" 3 "DI_IMM_STATE_DISARMED" 2 "DI_IMM_STATE_AUTHENTICATING" 1 "DI_IMM_STATE_REQUEST" 0 "DI_IMM_STATE_INIT_SNA" ;
VAL_TABLE_ DI_inverterTQualifier 3 "INVERTERT_UNKNOWN" 2 "INVERTERT_RATIONAL" 1 "INVERTERT_IRRATIONAL" 0 "INVERTERT_INIT" ;
VAL_TABLE_ DI_junctionTemp 255 "SNA" ;
VAL_TABLE_ DI_keepAliveRequest 1 "KEEP_ALIVE" 0 "NO_REQUEST" ;
VAL_TABLE_ DI_limpReason 34 "DI_LIMP_MECHANICAL_SAFE_ST_UNAVAIL" 33 "DI_LIMP_MOTION_IN_DYNO" 32 "DI_LIMP_RESIST_STATOR_TEMP" 31 "DI_LIMP_OIL_PRESSURE_LOW" 30 "DI_LIMP_HEATSINK_SENSOR_IRRATIONAL" 29 "DI_LIMP_OIL_PUMP_FLUID_OVERTEMP" 28 "DI_LIMP_OIL_PUMP_FAILURE" 27 "DI_LIMP_FACTORY_GLIDER" 26 "DI_LIMP_SLAVE_MIA" 25 "DI_LIMP_SLAVE_REQUEST" 24 "DI_LIMP_CONTACTOR_WELD" 23 "DI_LIMP_CAPACITOR_OVERTEMP" 22 "DI_LIMP_GTW_MIA" 21 "DI_LIMP_TRQCMD_VALIDITY_UNKNOWN" 20 "DI_LIMP_DI_MIA" 19 "DI_LIMP_CONFIG_MISMATCH" 18 "DI_LIMP_HEATSINK_TEMP" 17 "DI_LIMP_PMREQUEST" 16 "DI_LIMP_PMHEARTBEAT" 15 "DI_LIMP_TRQ_CROSS_CHECK" 14 "DI_LIMP_EXTERNAL_COMMAND" 13 "DI_LIMP_WRONG_CS_CALIBRATION" 12 "DI_LIMP_STATOR_TEMP" 11 "DI_LIMP_DELTAT_TOO_NEGATIVE" 10 "DI_LIMP_DELTAT_TOO_POSITIVE" 9 "DI_LIMP_AMBIENT_TEMP" 8 "DI_LIMP_OUTLET_TEMP" 7 "DI_LIMP_LOW_FLOW" 6 "DI_LIMP_BMS_MIA" 5 "DI_LIMP_12V_SUPPLY_UNDERVOLTAGE" 4 "DI_LIMP_NO_FLUID" 3 "DI_LIMP_NO_FUNC_HEATSINK_SENSOR" 2 "DI_LIMP_NO_FUNC_STATORT_SENSOR" 1 "DI_LIMP_BUSV_SENSOR_IRRATIONAL" 0 "DI_LIMP_PHASE_IMBALANCE" 35 "DI_LIMP_CURRENT_CORE_FALLBACK" ;
VAL_TABLE_ DI_linErrorType 6 "LIN_TIMEOUT_ERROR" 5 "LIN_HEADER_ERROR" 4 "LIN_OVERFLOW_ERROR" 3 "LIN_SCHEDULE_ERROR" 2 "LIN_CHECKSUM_ERROR" 1 "LIN_FRAMING_ERROR" 0 "LIN_NO_ERROR" ;
VAL_TABLE_ DI_lowMuProbabilityState 3 "NUM_STATES" 2 "HIGH" 1 "MEDIUM" 0 "LOW" ;
VAL_TABLE_ DI_magnetTempEst 0 "SNA" ;
VAL_TABLE_ DI_motorType 37 "DI_MOTOR_PM275C" 36 "DI_MOTOR_PM291D" 35 "DI_MOTOR_PM291C" 34 "DI_MOTOR_PM291B" 33 "DI_MOTOR_PM228C" 32 "DI_MOTOR_PM228B" 31 "DI_MOTOR_PM216CSR_N42" 30 "DI_MOTOR_PM216CSR" 29 "DI_MOTOR_PM350B" 28 "DI_MOTOR_PM275B" 27 "DI_MOTOR_IM130D_AL_POSCO" 26 "DI_MOTOR_F2AE_AL" 25 "DI_MOTOR_IM130D_AL" 24 "DI_MOTOR_IM130D" 23 "DI_MOTOR_PM216D" 22 "DI_MOTOR_IM130C" 21 "DI_MOTOR_PM216C" 20 "DI_MOTOR_IM216A" 19 "DI_MOTOR_IM100B" 18 "DI_MOTOR_PM216B" 17 "DI_MOTOR_IM100A" 16 "DI_MOTOR_PM216A" 15 "DI_MOTOR_F2APMSRM" 14 "DI_MOTOR_F2AE" 13 "DI_MOTOR_F2AD" 12 "DI_MOTOR_F2AC" 11 "DI_MOTOR_F2AB" 10 "DI_MOTOR_F1AC" 9 "DI_MOTOR_SSR1A" 8 "DI_MOTOR_F1A" 7 "DI_MOTOR_M7M6" 6 "DI_MOTOR_M8A" 5 "DI_MOTOR_M7M5" 4 "DI_MOTOR_M7M4" 3 "DI_MOTOR_M7M3" 2 "DI_MOTOR_ROADSTER_SPORT" 1 "DI_MOTOR_ROADSTER_BASE" 0 "DI_MOTOR_SNA" ;
VAL_TABLE_ DI_odometer -1 "SNA" ;
VAL_TABLE_ DI_oilPumpAlert 27 "DI_OILPUMP_A027_FLUID_PRESSURE_CHECK" 26 "DI_OILPUMP_A026_FLUID_PRESSURE_VERY_LOW" 25 "DI_OILPUMP_A025_MOTOR_CONTROL" 24 "DI_OILPUMP_A024_MEMORY_ERROR" 23 "DI_OILPUMP_A023_SPI_ERROR" 22 "DI_OILPUMP_A022_MOTOR_STALL" 21 "DI_OILPUMP_A021_MOTOR_OVERLOAD" 20 "DI_OILPUMP_A020_FLUID_TEMP_IRRAT" 19 "DI_OILPUMP_A019_FLUID_PRESS_IRRAT" 18 "DI_OILPUMP_A018_FLUID_PRESS_HIGH" 17 "DI_OILPUMP_A017_FLUID_PRESS_LOW" 16 "DI_OILPUMP_A016_PUMP_TEMP_IRRAT" 15 "DI_OILPUMP_A015_PUMP_OVERTEMP" 14 "DI_OILPUMP_A014_MOTOR_SPEED_IRRAT" 13 "DI_OILPUMP_A013_MOTOR_SPEED_TOO_HIGH" 12 "DI_OILPUMP_A012_MOTOR_SPEED_NEG" 11 "DI_OILPUMP_A011_MOTOR_CURRENT_IRRAT" 10 "DI_OILPUMP_A010_MOTOR_OPEN_PHASE" 9 "DI_OILPUMP_A009_MOTOR_SHORTED" 8 "DI_OILPUMP_A008_12V_SUPPLY_IRRAT" 7 "DI_OILPUMP_A007_12V_SUPPLY_OV" 6 "DI_OILPUMP_A006_12V_SUPPLY_UV" 5 "DI_OILPUMP_A005_LIN_ID_PARITY_ERR" 4 "DI_OILPUMP_A004_LIN_FRAMING_ERR" 3 "DI_OILPUMP_A003_LIN_CHECKSUM_ERR" 2 "DI_OILPUMP_A002_LIN_DATA_ERR" 1 "DI_OILPUMP_A001_ECU_RESET" 0 "DI_OILPUMP_A000_NONE" 28 "DI_OILPUMP_A028_PHASE_CURRENT_IRRATIONAL" ;
VAL_TABLE_ DI_oilPumpCurrent 255 "SNA" ;
VAL_TABLE_ DI_oilPumpDiagnosticsReason 5 "DI_OILPUMP_DIAG_PRESS_HIGH" 4 "DI_OILPUMP_DIAG_PRESS_LOW" 3 "DI_OILPUMP_DIAG_PRESS_9LPM_OK" 2 "DI_OILPUMP_DIAG_PRESS_6LPM_OK" 1 "DI_OILPUMP_DIAG_OPC_ALERT" 0 "DI_OILPUMP_DIAG_NONE" ;
VAL_TABLE_ DI_oilPumpFlow 255 "SNA" ;
VAL_TABLE_ DI_oilPumpFluidTQF 1 "OIL_PUMP_FLUIDT_HIGH_CONFIDENCE" 0 "OIL_PUMP_FLUIDT_LOW_CONFIDENCE" ;
VAL_TABLE_ DI_oilPumpPcbaID 1 "PCBA_ID_5" 0 "PCBA_ID_LESS_THAN_5" ;
VAL_TABLE_ DI_oilPumpPressure 255 "SNA" ;
VAL_TABLE_ DI_oilPumpServiceReason 2 "DI_OILPUMP_SERVICE_PRESSURE_HIGH" 1 "DI_OILPUMP_SERVICE_PRESSURE_LOW" 0 "DI_OILPUMP_SERVICE_NONE" 3 "DI_OILPUMP_SERVICE_CURRENT_SENSOR" ;
VAL_TABLE_ DI_oilPumpState 7 "OIL_PUMP_SNA" 6 "OIL_PUMP_FAULTED" 2 "OIL_PUMP_COLD_STARTUP" 1 "OIL_PUMP_ENABLE" 0 "OIL_PUMP_STANDBY" ;
VAL_TABLE_ DI_oilPumpTemp 255 "SNA" ;
VAL_TABLE_ DI_oilPumpVoltage 255 "SNA" ;
VAL_TABLE_ DI_onePedalDrivingState 8 "DI_OPD_NUM_STATES" 7 "DI_OPD_MOTOR_BLEND_IN" 6 "DI_OPD_NO_MOTOR" 5 "DI_OPD_MOTOR_BLEND_OUT_ACTIVE" 4 "DI_OPD_MOTOR_BLEND_OUT_PENDING" 3 "DI_OPD_NOMINAL" 2 "DI_OPD_STANDBY" 1 "DI_OPD_QUICK_BRAKE_RAMP" 0 "DI_OPD_UNAVAILABLE" ;
VAL_TABLE_ DI_opdUnavailableReason 15 "DI_OPD_UNAVAILABLE_MOTOR_HOLD_TIMEOUT" 14 "DI_OPD_UNAVAILABLE_INVALID_MSPD" 13 "DI_OPD_UNAVAILABLE_PARKED" 12 "DI_OPD_UNAVAILABLE_TORQUE_LIMIT" 11 "DI_OPD_UNAVAILABLE_GRADE_ESTIMATE" 10 "DI_OPD_UNAVAILABLE_TRACTION_CONTROL" 9 "DI_OPD_UNAVAILABLE_VELOCITY_ESTIMATE" 8 "DI_OPD_UNAVAILABLE_TRACK_MODE" 7 "DI_OPD_UNAVAILABLE_EPB_FAULT" 6 "DI_OPD_UNAVAILABLE_SKID" 5 "DI_OPD_UNAVAILABLE_INVALID_BRAKE_SENSE" 4 "DI_OPD_UNAVAILABLE_DI_SYS_STATE" 3 "DI_OPD_UNAVAILABLE_GEAR" 2 "DI_OPD_UNAVAILABLE_PM_FAULT" 1 "DI_OPD_UNAVAILABLE_DISABLED" 0 "DI_OPD_UNAVAILABLE_NONE" 16 "DI_OPD_UNAVAILABLE_UNIT0_FAULT" ;
VAL_TABLE_ DI_powerStageSafeState 3 "PSTG_SAFESTATE_3PS_LOW" 2 "PSTG_SAFESTATE_3PS_HIGH" 1 "PSTG_SAFESTATE_ALL_OFF" 0 "PSTG_SAFESTATE_NONE" ;
VAL_TABLE_ DI_ptcStateGlobal 3 "GLOBAL_PTC_STATE_SNA" 2 "GLOBAL_PTC_STATE_ON" 1 "GLOBAL_PTC_STATE_BACKUP" 0 "GLOBAL_PTC_STATE_FAULTED" ;
VAL_TABLE_ DI_ptcStateLocal 6 "LOCAL_PTC_STATE_SNA" 5 "LOCAL_PTC_STATE_STARTUP" 4 "LOCAL_PTC_STATE_ON" 3 "LOCAL_PTC_STATE_ADD_REDUCED" 2 "LOCAL_PTC_STATE_WHEELS_REDUCED" 1 "LOCAL_PTC_STATE_BACKUP" 0 "LOCAL_PTC_STATE_FAULTED" ;
VAL_TABLE_ DI_pwmState 3 "PWMSTATE_OPWM2" 2 "PWMSTATE_OPWM1" 1 "PWMSTATE_DPWM2" 0 "PWMSTATE_SVPWM" ;
VAL_TABLE_ DI_regenBackfillAbsSatState 2 "RAMP_IN" 1 "RAMP_OUT" 0 "IDLE" ;
VAL_TABLE_ DI_regenBackfillUnavailableReasons 12 "EBR_FAULT" 11 "PM_DISABLE_REQUEST" 10 "TRACK_MODE_ACTIVE" 9 "VELOCITY_ESTIMATOR_UNAVAILABLE" 8 "TRACTION_CONTROL_UNAVAILABLE" 7 "ACTIVE_DAMPING_UNAVAILABLE" 6 "UI_COASTDOWN_MODE" 5 "SYSTEM_STATE" 4 "NON_DRIVE_GEAR" 3 "EBR_UNAVAILABLE" 2 "UI_DISABLE" 1 "GTW_DISABLE" 0 "NONE" 13 "BRAKE_TEMP" ;
VAL_TABLE_ DI_regenPowerMax 255 "SNA" ;
VAL_TABLE_ DI_shiftDeniedReason 9 "SHIFT_DENIED_GARAGE_SHIFT_PEDAL" 8 "SHIFT_DENIED_DRIVE_RAIL_GOING_DOWN" 7 "SHIFT_DENIED_SHIFT_AFTER_CRUISE_CANCEL" 6 "SHIFT_DENIED_BRAKE_AFTER_CRUISE_CANCEL" 5 "SHIFT_DENIED_ACCEL_PEDAL_PRESSED" 4 "SHIFT_DENIED_SYS_STATE_NOT_ENABLED" 3 "SHIFT_DENIED_APC_PARKING" 2 "SHIFT_DENIED_APC_ACTIVE" 1 "SHIFT_DENIED_NO_BRAKES_FACTORY" 0 "SHIFT_DENIED_MOTOR_SPEED" ;
VAL_TABLE_ DI_signalAvailable 1 "AVAILABLE" 0 "UNAVAILABLE" ;
VAL_TABLE_ DI_siliconType 1 "IGBT" 0 "MOSFET" ;
VAL_TABLE_ DI_speedLimitReason 11 "USER" 10 "FRUNK_OPEN" 9 "LOAD_SHED" 8 "TAS" 7 "TRAILER_MODE" 6 "SPINDOWN_LEARNING" 5 "MAX_CAR_CONFIG" 4 "SERVICE_MODE" 3 "FACTORY_MODE" 2 "FACTORY_LOW_BRAKE_FLUID" 1 "DRIVE_UNIT_LIMIT" 0 "NONE" ;
VAL_TABLE_ DI_speedLimitType 2 "POWERTRAIN" 1 "USER" 0 "NONE" ;
VAL_TABLE_ DI_speedUnits 1 "DI_SPEED_KPH" 0 "DI_SPEED_MPH" ;
VAL_TABLE_ DI_ssmState 8 "SSM_STATE_FAULT" 7 "SSM_STATE_RETRY" 6 "SSM_STATE_WAIT_FOR_RETRY" 5 "SSM_STATE_ABORT" 4 "SSM_STATE_ENABLE" 3 "SSM_STATE_STANDBY" 2 "SSM_STATE_IDLE" 1 "SSM_STATE_UNAVAILABLE" 0 "SSM_STATE_START" ;
VAL_TABLE_ DI_state 4 "DI_STATE_ENABLE" 3 "DI_STATE_ABORT" 2 "DI_STATE_FAULT" 1 "DI_STATE_STANDBY" 0 "DI_STATE_UNAVAILABLE" ;
VAL_TABLE_ DI_statorTempFromResist 0 "SNA" ;
VAL_TABLE_ DI_systemState 5 "DI_SYS_ENABLE" 4 "DI_SYS_ABORT" 3 "DI_SYS_FAULT" 2 "DI_SYS_STANDBY" 1 "DI_SYS_IDLE" 0 "DI_SYS_UNAVAILABLE" ;
VAL_TABLE_ DI_targetFluxMode 2 "DI_FLUXMODE_FW" 1 "DI_FLUXMODE_FS" 0 "DI_FLUXMODE_OPTIMUM" ;
VAL_TABLE_ DI_taskID 20 "DI_EXT_STACK_IDLE" 19 "DI_EXT_STACK_TIMER" 18 "DI_EXT_STACK_UDS" 17 "DI_EXT_STACK_EEP" 16 "DI_EXT_STACK_IMM" 15 "DI_EXT_STACK_XCP" 14 "DI_EXT_STACK_MODULE_10HZ" 13 "DI_EXT_STACK_CLOCK" 12 "DI_EXT_STACK_SWI_PRI2" 11 "DI_EXT_STACK_SWI_PRI1" 10 "DI_EXT_STACK_SWI_PRI0" 9 "DI_EXT_STACK_BASE" 8 "DI_STACK_10Hz" 7 "DI_STACK_IMM" 6 "DI_STACK_XCP" 5 "DI_STACK_UDS" 4 "DI_STACK_EEP" 3 "DI_STACK_DHWF" 2 "DI_STACK_IDLE" 1 "DI_STACK_CONTROL" 0 "DI_STACK_SYSTEM" ;
VAL_TABLE_ DI_tcMaxRequest 255 "SNA" ;
VAL_TABLE_ DI_tcMinRequest 255 "SNA" ;
VAL_TABLE_ DI_telltale 1 "TELLTALE_ON" 0 "TELLTALE_OFF" ;
VAL_TABLE_ DI_ternaryQualifier 2 "FAULTED" 1 "VALID" 0 "INVALID" ;
VAL_TABLE_ DI_torque -4096 "SNA" ;
VAL_TABLE_ DI_trackModeState 2 "TRACK_MODE_ON" 1 "TRACK_MODE_AVAILABLE" 0 "TRACK_MODE_UNAVAILABLE" ;
VAL_TABLE_ DI_tractionControlMode 6 "TC_OFFROAD_ASSIST" 5 "TC_DYNO_MODE" 4 "TC_ROLLS_MODE" 3 "TC_DEV_MODE_2" 2 "TC_DEV_MODE_1" 1 "TC_SLIP_START" 0 "TC_NORMAL" ;
VAL_TABLE_ DI_uiSpeed 511 "DI_UI_SPEED_SNA" ;
VAL_TABLE_ DI_usmState 7 "USM_STATE_WAIT_FOR_RETRY" 6 "USM_STATE_UNAVAILABLE" 5 "USM_STATE_FAULT" 4 "USM_STATE_ENABLE" 3 "USM_STATE_ABORT" 2 "USM_STATE_RETRY" 1 "USM_STATE_STANDBY" 0 "USM_STATE_START" ;
VAL_TABLE_ DI_validityState 1 "VALID" 0 "INVALID" ;
VAL_TABLE_ DI_vdcActiveAlertType 2 "VDC_ACT_ALERT_VDCA_BRAKE_TORQUE_REQ" 1 "VDC_ACT_ALERT_VDCR_CONTROL_ACTIVE" 0 "VDC_ACT_ALERT_80_PRCNT_OF_THRESH" ;
VAL_TABLE_ DI_vdcMode 2 "VDC_MODE_TRACK" 1 "VDC_MODE_ON" 0 "VDC_MODE_OFF" ;
VAL_TABLE_ DI_vdcRegulatorActive 1 "VDC_REGULATOR_ACTIVE" 0 "VDC_REGULATOR_NOT_ACTIVE" ;
VAL_TABLE_ DI_vehicleAcceleration -2048 "SNA" ;
VAL_TABLE_ DI_vehicleHoldState 7 "DI_VHLD_STATE_INIT" 6 "DI_VHLD_STATE_FAULT" 5 "DI_VHLD_STATE_PARK" 4 "DI_VHLD_STATE_BLEND_OUT" 3 "DI_VHLD_STATE_STANDSTILL" 2 "DI_VHLD_STATE_BLEND_IN" 1 "DI_VHLD_STATE_STANDBY" 0 "DI_VHLD_STATE_UNAVAILABLE" ;
VAL_TABLE_ DI_vehicleSpeed 8191 "SNA" ;
VAL_TABLE_ DI_vehicleSpeedLimit 511 "SNA" ;
VAL_TABLE_ DI_vehicleSpeedRCM 4095 "SNA" ;
VAL_TABLE_ DI_velocityEstimatorState 5 "VE_STATE_BACKUP_MOTOR" 4 "VE_STATE_BACKUP_WHEELS_B" 3 "VE_STATE_BACKUP_WHEELS_A" 2 "VE_STATE_WHEELS_REDUCED" 1 "VE_STATE_WHEELS_NORMAL" 0 "VE_STATE_NOT_INITIALIZED" ;
VAL_TABLE_ DI_vhldFaultReason 10 "DI_VHLD_FAULT_ESP_MIA" 9 "DI_VHLD_FAULT_VDC_FAULT" 8 "DI_VHLD_FAULT_NOT_STOPPED" 7 "DI_VHLD_FAULT_EPB_NOT_PARKED" 6 "DI_VHLD_FAULT_PM_REQUEST" 5 "DI_VHLD_FAULT_WHEEL_SPDS_INVAL" 4 "DI_VHLD_FAULT_BRAKE_INVALID" 3 "DI_VHLD_FAULT_EBR_FAULT" 2 "DI_VHLD_FAULT_EPB_MIA" 1 "DI_VHLD_FAULT_PM_MIA" 0 "DI_VHLD_FAULT_NONE" ;
VAL_TABLE_ ECC_errorType 12 "RAM_CORRECTABLE_DMA" 11 "RAM_CORRECTABLE_CLA" 10 "RAM_CORRECTABLE_CPU" 9 "RAM_UNCORRECTABLE_DMA" 8 "RAM_UNCORRECTABLE_CLA" 7 "RAM_UNCORRECTABLE_CPU" 6 "FLASH_FAIL1_HIGH" 5 "FLASH_FAIL1_LOW" 4 "FLASH_FAIL0_HIGH" 3 "FLASH_FAIL0_LOW" 2 "FLASH_UNCORRECTABLE_HIGH" 1 "FLASH_UNCORRECTABLE_LOW" 0 "UNKNOWN" ;
VAL_TABLE_ ECU_logUploadRequest 3 "REQUEST_PRIORITY_3" 2 "REQUEST_PRIORITY_2" 1 "REQUEST_PRIORITY_1" 0 "REQUEST_PRIORITY_NONE" ;
VAL_TABLE_ EPB3_nmKeepAwakeReason 15 "EPB3_KEEPAWAKE_REASON_MULTIPLE" 5 "EPB3_KEEPAWAKE_REASON_UDS_ACTIVE" 4 "EPB3_KEEPAWAKE_REASON_EPB_SUMMON_ACTIVE" 3 "EPB3_KEEPAWAKE_REASON_EPB_LOCKOUT_PENDING" 2 "EPB3_KEEPAWAKE_REASON_EPB_NOT_SECURE" 1 "EPB3_KEEPAWAKE_REASON_EPB_STATE_NOT_SAVED" 0 "EPB3_KEEPAWAKE_REASON_NONE_SNA" ;
VAL_TABLE_ EPB3_nmWakeUpReason 4 "EPB3_WAKEUP_REASON_POWER_ON_RESET" 3 "EPB3_WAKEUP_REASON_RESET" 2 "EPB3_WAKEUP_REASON_SWITCH_INPUT" 1 "EPB3_WAKEUP_REASON_ECU_SPECIFIC" 0 "EPB3_WAKEUP_REASON_NONE" ;
VAL_TABLE_ EPBL_AlertMatrixIndex 5 "EPBL_AlertMatrix5" 4 "EPBL_AlertMatrix4" 3 "EPBL_AlertMatrix3" 2 "EPBL_AlertMatrix2" 1 "EPBL_AlertMatrix1" 0 "EPBL_AlertMatrix0" ;
VAL_TABLE_ EPBL_alerts 353 "EPBL_a353_missingSpeedUnableToPark" 352 "EPBL_a352_audioCurrentSpikeData" 351 "EPBL_a351_driverIsLeavingGhostFiringMismatch" 350 "EPBL_a350_ensOutOfRange" 303 "EPBL_a303_clampingOccuredEarly" 302 "EPBL_a302_csmLongRelease" 301 "EPBL_a301_oocSpeedViolation" 300 "EPBL_a300_leftRightConfusion" 272 "EPBL_a272_vhclPwrStateMsmtch" 252 "EPBL_a252_winchModePending" 251 "EPBL_a251_currentVarianceHigh" 250 "EPBL_a250_WinchModeCanceled" 249 "EPBL_a249_idleFaultRelease" 248 "EPBL_a248_csmDynamicApplyFailed" 247 "EPBL_a247_csmDynamicApplyRetry" 246 "EPBL_a246_idleFaultApply" 245 "EPBL_a245_serviceModeActive" 244 "EPBL_a244_WinchModeActive" 243 "EPBL_a243_bdwUnavailable" 242 "EPBL_a242_hvOutputLocked" 241 "EPBL_a241_diOutputLocked" 217 "EPBL_a217_SPI_MIA_debugData2" 216 "EPBL_a216_SPI_MIA_debugData1" 202 "EPBL_a202_remoteEpbConfigIncompatible" 201 "EPBL_a201_hwBrakeTypeMismatch" 200 "EPBL_a200_PmUnparkNotAllowed" 197 "EPBL_a197_freeRollModeAtSpeed" 196 "EPBL_a196_freeRollModeActive" 195 "EPBL_a195_parkForDriverIsLeaving" 191 "EPBL_a191_csmReleaseDegraded" 190 "EPBL_a190_csmApplyDegraded" 189 "EPBL_a189_epbDynamicParkCanceled" 188 "EPBL_a188_epbDynamic" 187 "EPBL_a187_cdpDynamic" 186 "EPBL_a186_externalParkAbort" 185 "EPBL_a185_summonAborted" 184 "EPBL_a184_dynamicParkAbort" 183 "EPBL_a183_cdpNotAvailable" 182 "EPBL_a182_OneEPBAppliedUnsecEnv" 181 "EPBL_a181_TooSteepGradeToPark" 180 "EPBL_a180_dynamicActive" 179 "EPBL_a179_epbProblem" 178 "EPBL_a178_caliperStateUnknown" 177 "EPBL_a177_csmApplyRetry" 176 "EPBL_a176_csmApplyFailed" 175 "EPBL_a175_csmReleaseRetry" 174 "EPBL_a174_csmReleaseFailed" 173 "EPBL_a173_hiCurrentMissing" 172 "EPBL_a172_SPI_MIA" 171 "EPBL_a171_12vUv" 170 "EPBL_a170_12vOv" 141 "EPBL_a141_invalidState" 138 "EPBL_a138_NVMWriteTime" 137 "EPBL_a137_PvUv" 136 "EPBL_a136_PvOv" 135 "EPBL_a135_NvUv" 134 "EPBL_a134_NvOv" 128 "EPBL_a128_MotorPVoltHigh" 127 "EPBL_a127_MotorNVoltHigh" 126 "EPBL_a126_MotorNVoltLow" 125 "EPBL_a125_IdleVMismatch" 124 "EPBL_a124_calOutOfBounds" 123 "EPBL_a123_Uc" 122 "EPBL_a122_Oc" 121 "EPBL_a121_nDriveFault" 120 "EPBL_a120_DI_DRIVE_MIA" 119 "EPBL_a119_SCCM_MIA" 118 "EPBL_a118_VCFRONT_MIA" 117 "EPBL_a117_VCLEFT_MIA" 116 "EPBL_a116_VCRIGHT_MIA" 115 "EPBL_a115_VCSEC_MIA" 114 "EPBL_a114_ESP_MIA" 113 "EPBL_a113_UI_MIA" 112 "EPBL_a112_EPBL_MIA" 111 "EPBL_a111_EPBR_MIA" 110 "EPBL_a110_GTW_MIA" 109 "EPBL_a109_RCM_MIA" 108 "EPBL_a108_DIF_MIA" 107 "EPBL_a107_BMS_MIA" 106 "EPBL_a106_PCS_MIA" 105 "EPBL_a105_TAS_MIA" 104 "EPBL_a104_DAS_MIA" 103 "EPBL_a103_CP_MIA" 102 "EPBL_a102_PTC_MIA" 101 "EPBL_a101_PM_MIA" 100 "EPBL_a100_CANbus_MIA" 99 "EPBL_a099_PARK_MIA" 98 "EPBL_a098_DIR_MIA" 97 "EPBL_a097_CMP_MIA" 96 "EPBL_a096_OCS1P_MIA" 95 "EPBL_a095_CHG_MIA" 94 "EPBL_a094_EPAS3P_MIA" 93 "EPBL_a093_VCSEATP_MIA" 92 "EPBL_a092_VCSEATD_MIA" 91 "EPBL_a091_CMPD_MIA" 90 "EPBL_a090_APS_MIA" 89 "EPBL_a089_IBST_MIA" 88 "EPBL_a088_DIRER_MIA" 87 "EPBL_a087_DIREL_MIA" 86 "EPBL_a086_VCBATT_MIA" 85 "EPBL_a085_CCCM_MIA" 84 "EPBL_a084_TPMS_MIA" 83 "EPBL_a083_VCLEFT_IPC_MIA" 82 "EPBL_a082_VCRIGHT_IPC_MIA" 64 "EPBL_a064_busSleepReqTimeout" 63 "EPBL_a063_SwitchFault" 62 "EPBL_a062_XCPWasConnected" 61 "EPBL_a061_XCPConnected" 60 "EPBL_a060_engineeringBuild" 59 "EPBL_a059_inputResistanceHigh" 58 "EPBL_a058_inputRHighSyncDebug" 46 "EPBL_a046_Task1000msError" 45 "EPBL_a045_Task100msError" 44 "EPBL_a044_Task10msError" 43 "EPBL_a043_Task1msError" 42 "EPBL_a042_HighStackUsage" 41 "EPBL_a041_HighCPULoad" 31 "EPBL_a031_UDSActive" 30 "EPBL_a030_ECULogUploadRequest" 22 "EPBL_a022_TaskInitError" 21 "EPBL_a021_TaskSchedulerError" 15 "EPBL_a015_NVMMAlert" 13 "EPBL_a013_AlertManagerFault" 12 "EPBL_a012_CPUReset" 6 "EPBL_a006_CANTX_cyclicError" 5 "EPBL_a005_CANTXError" 3 "EPBL_a003_SWAssertion" 2 "EPBL_a002_PowerLossReset" 1 "EPBL_a001_WatchdogReset" 0 "EPBL_ALERT_DO_NOT_USE_ZERO" 355 "EPBL_a355_brakeHwAndEpbHwMismatch" 354 "EPBL_a354_parkedForLowBrakeFluidMode" 305 "EPBL_a305_premiumAmpEFuseTrip" 304 "EPBL_a304_rearSeatControllerEFuseTrip" ;
VAL_TABLE_ EPBM_debugDataSelect 1 "EPBM_TRANSITIONS" 0 "EPBM_STATES" ;
VAL_TABLE_ EPBR_AlertMatrixIndex 5 "EPBR_AlertMatrix5" 4 "EPBR_AlertMatrix4" 3 "EPBR_AlertMatrix3" 2 "EPBR_AlertMatrix2" 1 "EPBR_AlertMatrix1" 0 "EPBR_AlertMatrix0" ;
VAL_TABLE_ EPBR_alerts 353 "EPBR_a353_missingSpeedUnableToPark" 352 "EPBR_a352_audioCurrentSpikeData" 351 "EPBR_a351_driverIsLeavingGhostFiringMismatch" 350 "EPBR_a350_ensOutOfRange" 303 "EPBR_a303_clampingOccuredEarly" 302 "EPBR_a302_csmLongRelease" 301 "EPBR_a301_oocSpeedViolation" 300 "EPBR_a300_leftRightConfusion" 272 "EPBR_a272_vhclPwrStateMsmtch" 252 "EPBR_a252_winchModePending" 251 "EPBR_a251_currentVarianceHigh" 250 "EPBR_a250_WinchModeCanceled" 249 "EPBR_a249_idleFaultRelease" 248 "EPBR_a248_csmDynamicApplyFailed" 247 "EPBR_a247_csmDynamicApplyRetry" 246 "EPBR_a246_idleFaultApply" 245 "EPBR_a245_serviceModeActive" 244 "EPBR_a244_WinchModeActive" 243 "EPBR_a243_bdwUnavailable" 242 "EPBR_a242_hvOutputLocked" 241 "EPBR_a241_diOutputLocked" 217 "EPBR_a217_SPI_MIA_debugData2" 216 "EPBR_a216_SPI_MIA_debugData1" 202 "EPBR_a202_remoteEpbConfigIncompatible" 201 "EPBR_a201_hwBrakeTypeMismatch" 200 "EPBR_a200_PmUnparkNotAllowed" 197 "EPBR_a197_freeRollModeAtSpeed" 196 "EPBR_a196_freeRollModeActive" 195 "EPBR_a195_parkForDriverIsLeaving" 191 "EPBR_a191_csmReleaseDegraded" 190 "EPBR_a190_csmApplyDegraded" 189 "EPBR_a189_epbDynamicParkCanceled" 188 "EPBR_a188_epbDynamic" 187 "EPBR_a187_cdpDynamic" 186 "EPBR_a186_externalParkAbort" 185 "EPBR_a185_summonAborted" 184 "EPBR_a184_dynamicParkAbort" 183 "EPBR_a183_cdpNotAvailable" 182 "EPBR_a182_OneEPBAppliedUnsecEnv" 181 "EPBR_a181_TooSteepGradeToPark" 180 "EPBR_a180_dynamicActive" 179 "EPBR_a179_epbProblem" 178 "EPBR_a178_caliperStateUnknown" 177 "EPBR_a177_csmApplyRetry" 176 "EPBR_a176_csmApplyFailed" 175 "EPBR_a175_csmReleaseRetry" 174 "EPBR_a174_csmReleaseFailed" 173 "EPBR_a173_hiCurrentMissing" 172 "EPBR_a172_SPI_MIA" 171 "EPBR_a171_12vUv" 170 "EPBR_a170_12vOv" 141 "EPBR_a141_invalidState" 138 "EPBR_a138_NVMWriteTime" 137 "EPBR_a137_PvUv" 136 "EPBR_a136_PvOv" 135 "EPBR_a135_NvUv" 134 "EPBR_a134_NvOv" 128 "EPBR_a128_MotorPVoltHigh" 127 "EPBR_a127_MotorNVoltHigh" 126 "EPBR_a126_MotorNVoltLow" 125 "EPBR_a125_IdleVMismatch" 124 "EPBR_a124_calOutOfBounds" 123 "EPBR_a123_Uc" 122 "EPBR_a122_Oc" 121 "EPBR_a121_nDriveFault" 120 "EPBR_a120_DI_DRIVE_MIA" 119 "EPBR_a119_SCCM_MIA" 118 "EPBR_a118_VCFRONT_MIA" 117 "EPBR_a117_VCLEFT_MIA" 116 "EPBR_a116_VCRIGHT_MIA" 115 "EPBR_a115_VCSEC_MIA" 114 "EPBR_a114_ESP_MIA" 113 "EPBR_a113_UI_MIA" 112 "EPBR_a112_EPBL_MIA" 111 "EPBR_a111_EPBR_MIA" 110 "EPBR_a110_GTW_MIA" 109 "EPBR_a109_RCM_MIA" 108 "EPBR_a108_DIF_MIA" 107 "EPBR_a107_BMS_MIA" 106 "EPBR_a106_PCS_MIA" 105 "EPBR_a105_TAS_MIA" 104 "EPBR_a104_DAS_MIA" 103 "EPBR_a103_CP_MIA" 102 "EPBR_a102_PTC_MIA" 101 "EPBR_a101_PM_MIA" 100 "EPBR_a100_CANbus_MIA" 99 "EPBR_a099_PARK_MIA" 98 "EPBR_a098_DIR_MIA" 97 "EPBR_a097_CMP_MIA" 96 "EPBR_a096_OCS1P_MIA" 95 "EPBR_a095_CHG_MIA" 94 "EPBR_a094_EPAS3P_MIA" 93 "EPBR_a093_VCSEATP_MIA" 92 "EPBR_a092_VCSEATD_MIA" 91 "EPBR_a091_CMPD_MIA" 90 "EPBR_a090_APS_MIA" 89 "EPBR_a089_IBST_MIA" 88 "EPBR_a088_DIRER_MIA" 87 "EPBR_a087_DIREL_MIA" 86 "EPBR_a086_VCBATT_MIA" 85 "EPBR_a085_CCCM_MIA" 84 "EPBR_a084_TPMS_MIA" 83 "EPBR_a083_VCLEFT_IPC_MIA" 82 "EPBR_a082_VCRIGHT_IPC_MIA" 64 "EPBR_a064_busSleepReqTimeout" 63 "EPBR_a063_SwitchFault" 62 "EPBR_a062_XCPWasConnected" 61 "EPBR_a061_XCPConnected" 60 "EPBR_a060_engineeringBuild" 59 "EPBR_a059_inputResistanceHigh" 58 "EPBR_a058_inputRHighSyncDebug" 46 "EPBR_a046_Task1000msError" 45 "EPBR_a045_Task100msError" 44 "EPBR_a044_Task10msError" 43 "EPBR_a043_Task1msError" 42 "EPBR_a042_HighStackUsage" 41 "EPBR_a041_HighCPULoad" 31 "EPBR_a031_UDSActive" 30 "EPBR_a030_ECULogUploadRequest" 22 "EPBR_a022_TaskInitError" 21 "EPBR_a021_TaskSchedulerError" 15 "EPBR_a015_NVMMAlert" 13 "EPBR_a013_AlertManagerFault" 12 "EPBR_a012_CPUReset" 6 "EPBR_a006_CANTX_cyclicError" 5 "EPBR_a005_CANTXError" 3 "EPBR_a003_SWAssertion" 2 "EPBR_a002_PowerLossReset" 1 "EPBR_a001_WatchdogReset" 0 "EPBR_ALERT_DO_NOT_USE_ZERO" 355 "EPBR_a355_brakeHwAndEpbHwMismatch" 354 "EPBR_a354_parkedForLowBrakeFluidMode" 305 "EPBR_a305_premiumAmpEFuseTrip" 304 "EPBR_a304_rearSeatControllerEFuseTrip" ;
VAL_TABLE_ EPB_brakeDiscWipeRequest 3 "EPB_BRAKEDISCWIPE_REQUEST_SNA" 2 "EPB_BRAKEDISCWIPE_REQUEST_STRONG" 1 "EPB_BRAKEDISCWIPE_REQUEST_LIGHT" 0 "EPB_BRAKEDISCWIPE_REQUEST_NONE" ;
VAL_TABLE_ EPB_cdpInvalidateReason 4 "EPB_CDP_EPBM_INVALID" 3 "EPB_CDP_BRAKE_FLUID_LOW" 2 "EPB_CDP_EPBM_MIA" 1 "EPB_CDP_ESP_INVALID" 0 "EPB_CDP_ESP_MIA" ;
VAL_TABLE_ EPB_cdpRequestState 1 "EPB_CDP_REQUESTED" 0 "EPB_CDP_NOT_REQUESTED" ;
VAL_TABLE_ EPB_config 9 "EPB_CONFIG_MODELS_CERAMIC" 8 "EPB_CONFIG_MODELY_PERFORMANCE_V2" 7 "EPB_CONFIG_MODEL3_PERFORMANCE_V2" 6 "EPB_CONFIG_MODELX_BASE" 5 "EPB_CONFIG_MODELY_PERFORMANCE" 4 "EPB_CONFIG_MODELY_BASE" 3 "EPB_CONFIG_MODELS_BASE" 2 "EPB_CONFIG_MODEL3_PERFORMANCE" 1 "EPB_CONFIG_MODEL3_BASE" 0 "EPB_CONFIG_UNKNOWN" ;
VAL_TABLE_ EPB_csmFaultReason 23 "CSM_FAULT_REMOTE_MIA" 22 "CSM_FAULT_NVM_MISMATCH" 21 "CSM_FAULT_EPBM_MIA" 20 "CSM_FAULT_MOTOR_NOT_READY" 19 "CSM_FAULT_MOTOR_ACTIVE_FAULT" 18 "CSM_FAULT_MOTOR_IDLE_FAULT" 17 "CSM_FAULT_TIMEOUT_EPBM_START" 16 "CSM_FAULT_TIMEOUT_NO_RAMP" 15 "CSM_FAULT_TIMEOUT_EPBM_CUTOFF" 14 "CSM_FAULT_TIMEOUT_RELEASE_COMPLETE" 13 "CSM_FAULT_TIMEOUT_RELEASE_NO_LOAD" 12 "CSM_FAULT_TIMEOUT_RELEASE_WAIT_FOR_ENDSTOP" 11 "CSM_FAULT_TIMEOUT_RELEASE_INRUSH" 10 "CSM_FAULT_TIMEOUT_EPBM_WAIT_FOR_CLAMP" 9 "CSM_FAULT_TIMEOUT_EPB_WAIT_FOR_CLAMP" 8 "CSM_FAULT_TIMEOUT_APPLY_INRUSH" 7 "CSM_FAULT_TIMEOUT_APPLY_COMPLETE" 6 "CSM_FAULT_RELEASE_BLOCKED" 5 "CSM_FAULT_APPLY_BLOCKED" 4 "CSM_FAULT_TIMEOUT_CALIBRATE" 3 "CSM_FAULT_STATE_MISMATCH" 2 "CSM_FAULT_EPBM_FAULTED" 1 "CSM_FAULT_EPBM_DISABLED" 0 "CSM_FAULT_NONE" ;
VAL_TABLE_ EPB_csmRequest 4 "CSM_RQST_ENDSTOP" 3 "CSM_RQST_RELEASE" 2 "CSM_RQST_APPLY" 1 "CSM_RQST_NONE" 0 "CSM_RQST_INVALID" ;
VAL_TABLE_ EPB_csmState 14 "CSM_HOLD_CLAMP" 13 "CSM_STATIONARY_FAULT" 12 "CSM_FAULT" 11 "CSM_HALT" 10 "CSM_CALIBRATE" 9 "CSM_RELEASE_COMPLETE" 8 "CSM_WAIT_FOR_ENDSTOP" 7 "CSM_RELEASE_NOLOAD" 6 "CSM_RELEASE_INRUSH" 5 "CSM_APPLY_COMPLETE" 4 "CSM_WAIT_FOR_CLAMP" 3 "CSM_APPLY_NOLOAD" 2 "CSM_APPLY_INRUSH" 1 "CSM_STANDBY" 0 "CSM_INIT" ;
VAL_TABLE_ EPB_debugDataSelect 2 "EPB_DEBUG_2" 1 "EPB_DEBUG_1" 0 "EPB_DEBUG_0" ;
VAL_TABLE_ EPB_driverIsLeavingSpeedClass 4 "DRIVER_IS_LEAVING_SPEED_UNKNOWN" 3 "DRIVER_IS_LEAVING_SPEED_TOO_FAST_FOR_DECEL" 2 "DRIVER_IS_LEAVING_SPEED_TOO_FAST_TO_PARK" 1 "DRIVER_IS_LEAVING_SPEED_SLOW_ENOUGH_TO_PARK" 0 "DRIVER_IS_LEAVING_SPEED_STOPPED" ;
VAL_TABLE_ EPB_esmOperationTrigger 33 "EPB_TRIGGER_TOUCHSCREEN_INVALID" 32 "EPB_TRIGGER_UI_DOOR_OPEN_REQUEST" 31 "EPB_TRIGGER_AUTOPARK_END" 30 "EPB_TRIGGER_DRIVER_IS_LEAVING" 29 "EPB_TRIGGER_SYSTEM_APPLY" 28 "EPB_TRIGGER_ACCELERATION" 27 "EPB_TRIGGER_EPBM_DISQUALIFIED" 26 "EPB_TRIGGER_DISQUALIFIED" 25 "EPB_TRIGGER_SUMMON_FAULT" 24 "EPB_TRIGGER_FAULT" 23 "EPB_TRIGGER_SUMMON_COMPLETE" 22 "EPB_TRIGGER_REAPPLY" 21 "EPB_TRIGGER_SAVESTATE_ON_BOOT" 20 "EPB_TRIGGER_TIMEOUT" 19 "EPB_TRIGGER_SPEED_FAST" 18 "EPB_TRIGGER_SPEED_OKAYTOPARK" 17 "EPB_TRIGGER_SPEED_STOPPED" 16 "EPB_TRIGGER_USER_CANCEL" 15 "EPB_TRIGGER_USER_CONFIRMED" 14 "EPB_TRIGGER_DIAG_EXIT" 13 "EPB_TRIGGER_DIAG_OPEN" 12 "EPB_TRIGGER_DIAG_CLOSE" 11 "EPB_TRIGGER_SERVICE" 10 "EPB_TRIGGER_WINCHMODE_UNAVAILABLE" 9 "EPB_TRIGGER_WINCHMODE_ENTER" 8 "EPB_TRIGGER_WINCHMODE_EXIT" 7 "EPB_TRIGGER_TOUCHSCREEN" 6 "EPB_TRIGGER_DI_UNPARK" 5 "EPB_TRIGGER_ACTIVE_PARK_REQUEST" 4 "EPB_TRIGGER_PBUTTON_RELEASED" 3 "EPB_TRIGGER_PBUTTON_PRESSED_UNKNOWN" 2 "EPB_TRIGGER_PBUTTON_PRESSED_FAST" 1 "EPB_TRIGGER_PBUTTON_PRESSED_OKTOPARK" 0 "EPB_TRIGGER_PBUTTON_PRESSED_STOPPED" 36 "EPB_TRIGGER_LOW_BRAKE_FLUID_MODE_DYNAMIC" 35 "EPB_TRIGGER_LOW_BRAKE_FLUID_MODE_DYNAMIC_PARK" 34 "EPB_TRIGGER_LOW_BRAKE_FLUID_MODE_PARK" ;
VAL_TABLE_ EPB_esmSpeedClass 4 "ESM_SPEED_CLASS_UNKNOWN" 3 "ESM_SPEED_CLASS_FAST" 2 "ESM_SPEED_CLASS_USER_APPLY_OK" 1 "ESM_SPEED_CLASS_SYSTEM_APPLY_OK" 0 "ESM_SPEED_CLASS_STOPPED" ;
VAL_TABLE_ EPB_esmState 20 "ESM_UNKNOWN" 19 "ESM_FREE_ROLL_MODE" 18 "ESM_DYNAMIC_EXTERNAL_EXIT" 17 "ESM_SERVICE_PENDING" 16 "ESM_LATCHED_DYNAMIC_EXTERNAL" 15 "ESM_DYNAMIC_PENDING" 14 "ESM_DYNAMIC_EXTERNAL" 13 "ESM_SUMMON_PARK" 12 "ESM_WINCHMODE_PENDING" 11 "ESM_PARK_PENDING" 10 "ESM_DYNAMIC_PARK" 9 "ESM_DIAGNOSTIC_OPEN" 8 "ESM_DIAGNOSTIC_PARK" 7 "ESM_SERVICE" 6 "ESM_WINCHMODE" 5 "ESM_SUMMON" 4 "ESM_DYNAMIC" 3 "ESM_OPEN" 2 "ESM_REAPPLY" 1 "ESM_PARK" 0 "ESM_INIT" ;
VAL_TABLE_ EPB_externalApplyOkay 2 "EPB_EXTERNAL_APPLY_INVALID" 1 "EPB_EXTERNAL_APPLY_VALID" 0 "EPB_EXTERNAL_APPLY_IDLE" ;
VAL_TABLE_ EPB_freeRollMode 2 "EPB_FREE_ROLL_MODE_ENABLED" 1 "EPB_FREE_ROLL_MODE_AVAILABLE" 0 "EPB_FREE_ROLL_MODE_UNAVAILABLE" ;
VAL_TABLE_ EPB_remoteADCIndex 6 "EPB_REMOTE_ADC_MONITORS_4" 5 "EPB_REMOTE_ADC_SENSORS" 4 "EPB_REMOTE_ADC_ECU_VOLTAGE" 3 "EPB_REMOTE_ADC_TEMPERATURES" 2 "EPB_REMOTE_ADC_MONITORS_3" 1 "EPB_REMOTE_ADC_MONITORS_2" 0 "EPB_REMOTE_ADC_MONITORS_1" ;
VAL_TABLE_ EPB_savedCaliperState 6 "EPB_SAVED_CALIPERSTATE_WINCHMODE" 5 "EPB_SAVED_CALIPERSTATE_SERVICE" 4 "EPB_SAVED_CALIPERSTATE_OPEN" 3 "EPB_SAVED_CALIPERSTATE_PARK" 2 "EPB_SAVED_CALIPERSTATE_REAPPLY" 1 "EPB_SAVED_CALIPERSTATE_UNKNOWN" 0 "EPB_SAVED_CALIPERSTATE_UNSAVED" ;
VAL_TABLE_ EPB_statsSelect 2 "EPB_MAX_DATA" 1 "EPB_DYNAMIC_COUNT" 0 "EPB_STATIC_COUNT" ;
VAL_TABLE_ EPB_summonFaultReason 28 "EPB_SUMMONFAULT_REMOTE_DID_NOT_START" 27 "EPB_SUMMONFAULT_INVALID_REMOTE_STATE" 26 "EPB_SUMMONFAULT_START_IN_UNAVAILABLE" 25 "EPB_SUMMONFAULT_REMOTE_UNIT_FAULTED" 24 "EPB_SUMMONFAULT_LOCAL_UNIT_FAULTED" 23 "EPB_SUMMONFAULT_REMOTE_SUMMON_FAULTED" 22 "EPB_SUMMONFAULT_EPBREMOTE_MIA" 21 "EPB_SUMMONFAULT_PASSIVE_REQUEST" 20 "EPB_SUMMONFAULT_DI_STATE_INVALID" 19 "EPB_SUMMONFAULT_EPB_FAULT" 18 "EPB_SUMMONFAULT_MISMATCH" 17 "EPB_SUMMONFAULT_OOC" 16 "EPB_SUMMONFAULT_PM_REQUEST" 15 "EPB_SUMMONFAULT_PM_MIA" 14 "EPB_SUMMONFAULT_PARK_MIA" 13 "EPB_SUMMONFAULT_EXTERNAL" 12 "EPB_SUMMONFAULT_SPEED" 11 "EPB_SUMMONFAULT_EPBM_REQUEST" 10 "EPB_SUMMONFAULT_EAC_NOT_ALLOWED" 9 "EPB_SUMMONFAULT_VEH_CAN_FAULT" 8 "EPB_SUMMONFAULT_ESP_FAULT" 7 "EPB_SUMMONFAULT_DAS_FAULT" 6 "EPB_SUMMONFAULT_DI_APC_FAULT" 5 "EPB_SUMMONFAULT_DI_FAULT" 4 "EPB_SUMMONFAULT_EPBM_MIA" 3 "EPB_SUMMONFAULT_ESP_MIA" 2 "EPB_SUMMONFAULT_DAS_MIA" 1 "EPB_SUMMONFAULT_DI_MIA" 0 "EPB_SUMMONFAULT_NONE" ;
VAL_TABLE_ EPB_summonState 6 "EPB_SUMMON_UNAVAILABLE" 5 "EPB_SUMMON_FAULT" 4 "EPB_SUMMON_COMPLETE" 3 "EPB_SUMMON_ACTIVE" 2 "EPB_SUMMON_ARMED" 1 "EPB_SUMMON_IDLE" 0 "EPB_SUMMON_INIT" ;
VAL_TABLE_ EPB_systemStatus 8 "EPB_VEHICLE_STATUS_MISMATCH" 7 "EPB_VEHICLE_STATUS_FAULT_SECURE" 6 "EPB_VEHICLE_STATUS_FAULT" 5 "EPB_VEHICLE_STATUS_RELEASING" 4 "EPB_VEHICLE_STATUS_PARKING" 3 "EPB_VEHICLE_STATUS_DYNAMIC" 2 "EPB_VEHICLE_STATUS_PARKED" 1 "EPB_VEHICLE_STATUS_RELEASED" 0 "EPB_VEHICLE_STATUS_UNKNOWN" ;
VAL_TABLE_ EPB_telltale 7 "EPB_TELLTALE_SNA" 3 "EPB_TELLTALE_LAMP_RED_FLASH" 2 "EPB_TELLTALE_LAMP_AMBER_ON" 1 "EPB_TELLTALE_LAMP_RED_ON" 0 "EPB_TELLTALE_LAMP_OFF" ;
VAL_TABLE_ EPB_unableToParkAlertPath 2 "EPB_UNABLETOPARKALERTPATH_NVRAM" 1 "EPB_UNABLETOPARKALERTPATH_GTW_RECOVERED" 0 "EPB_UNABLETOPARKALERTPATH_GTW_AVAILABLE" ;
VAL_TABLE_ EPB_unitFaultStatus 3 "EPB_STATUS_FAULT_IDLE" 2 "EPB_STATUS_FAULT" 1 "EPB_STATUS_RETRY" 0 "EPB_STATUS_NOMINAL" ;
VAL_TABLE_ EPB_unitStatus 22 "EPB_STATUS_COUNT" 21 "EPB_STATUS_FREE_ROLL_MODE" 20 "EPB_STATUS_DYNAMIC_PARKING" 19 "EPB_STATUS_EXTERNAL_PARKING" 18 "EPB_STATUS_RELEASING_FOR_EXTERNAL_PARK" 17 "EPB_STATUS_EXTERNAL_DYNAMIC" 16 "EPB_STATUS_SUMMON_PARKING" 15 "EPB_STATUS_SUMMON_RELEASING" 14 "EPB_STATUS_SUMMON" 13 "EPB_STATUS_WINCHMODE_PENDING" 12 "EPB_STATUS_PARK_PENDING" 11 "EPB_STATUS_SERVICE_RELEASING" 10 "EPB_STATUS_RELEASING" 9 "EPB_STATUS_DYNAMIC_APPLYING" 8 "EPB_STATUS_PARKING" 7 "EPB_STATUS_WINCHMODE_RELEASING" 6 "EPB_STATUS_WINCHMODE" 5 "EPB_STATUS_SERVICE" 4 "EPB_STATUS_START" 3 "EPB_STATUS_PARK" 2 "EPB_STATUS_DYNAMIC" 1 "EPB_STATUS_OPEN" 0 "EPB_STATUS_UNKNOWN" ;
VAL_TABLE_ ESP_btcTargetState 3 "SNA" 2 "ON" 1 "BACKUP" 0 "OFF" ;
VAL_TABLE_ ESP_ebrStatus 3 "EBR_COMMAND_INVALID" 2 "ACTUATING_DI_EBR" 1 "EBR_IS_AVAILABLE" 0 "EBR_IS_NOT_AVAILABLE" ;
VAL_TABLE_ ESP_ptcTargetState 3 "SNA" 2 "ON" 1 "BACKUP" 0 "FAULT" ;
VAL_TABLE_ ESP_vdcActuatorState 3 "VDC_COMMAND_INVALID" 2 "VDC_ACTUATOR_AVAILABLE" 1 "VDC_ACTUATOR_DEGRADED" 0 "VDC_ACTUATOR_UNAVAILABLE" ;
VAL_TABLE_ EVSE_chargeType 2 "AC_CHARGER_PRESENT" 1 "DC_CHARGER_PRESENT" 0 "NO_CHARGER_PRESENT" ;
VAL_TABLE_ FC_alertID 321 "FC_a321_FCAlertPlaceholder" 313 "FC_a313_GB_inputVoltageRailOv" 312 "FC_a312_GB_evseLimitsTimeout" 311 "FC_a311_GB_battParamsTimeout" 310 "FC_a310_GB_unused" 309 "FC_a309_GB_unused" 308 "FC_a308_GB_evseConLockTimeout" 307 "FC_a307_GB_fcContOpenTimeout" 306 "FC_a306_GB_vehReadyDeasserted" 305 "FC_a305_GB_posRecogTimeout" 304 "FC_a304_GB_unused" 303 "FC_a303_GB_negRecogTimeout" 302 "FC_a302_GB_unused" 301 "FC_a301_GB_unused" 300 "FC_a300_GB_unused" 299 "FC_a299_GB_evseReadyTimeout" 298 "FC_a298_GB_bmsCtrCloseTimeout" 297 "FC_a297_GB_unused" 296 "FC_a296_GB_invalidPilotTransitio" 295 "FC_a295_GB_pilotRationality" 294 "FC_a294_GB_unused" 293 "FC_a293_GB_proxRationality" 292 "FC_a292_GB_vehConLockTimeout" 291 "FC_a291_GB_vehDataTimeout" 290 "FC_a290_GB_pilotAcceptTimeout" 289 "FC_a289_GB_proxTimeout" 288 "FC_a288_GB_evseAbnormalStopReq" 287 "FC_a287_GB_vehConnUnlocked" 286 "FC_a286_GB_evseConnUnlocked" 285 "FC_a285_GB_proxDisconnected" 284 "FC_a284_GB_pcbTempHiFoldBk" 283 "FC_a283_GB_posTempHiFoldBk" 282 "FC_a282_GB_negTempHiFoldBk" 281 "FC_a281_GB_evseOutOfService" 280 "FC_a280_GB_retryLimitExceeded" 279 "FC_a279_GB_evseOverCurrent" 278 "FC_a278_GB_timeoutCCS" 277 "FC_a277_GB_posToPcbDeltaLo" 276 "FC_a276_GB_negToPcbDeltaLo" 275 "FC_a275_GB_posToPcbDeltaHi" 274 "FC_a274_GB_negToPcbDeltaHi" 273 "FC_a273_GB_negToPosDeltaLo" 272 "FC_a272_GB_negToPosDeltaHi" 271 "FC_a271_GB_timeoutCRO" 270 "FC_a270_GB_timeoutCML" 269 "FC_a269_GB_timeoutCRM" 268 "FC_a268_GB_pcb_OT" 267 "FC_a267_GB_posPin_OT" 266 "FC_a266_GB_negPin_OT" 265 "FC_a265_GB_bmsIncompatible" 264 "FC_a264_GB_timeoutCHM" 263 "FC_a263_GB_hwProxTrip" 262 "FC_a262_GB_evseRxBufOvf" 261 "FC_a261_GB_evseTxBufOvf" 260 "FC_a260_GB_vehRxBufOvf" 259 "FC_a259_GB_vehTxBufOvf" 258 "FC_a258_GB_evseMia" 257 "FC_a257_GB_bmsMia" 193 "FC_a193_FCAlertPlaceholder" 187 "FC_a187_CA_evseConLockTimeout" 186 "FC_a186_CA_fcContOpenTimeout" 185 "FC_a185_CA_vehReadyDeasserted" 184 "FC_a184_CA_evseBatMalfunc" 183 "FC_a183_CA_evseBatIncompat" 182 "FC_a182_CA_evseChrMalfunc" 181 "FC_a181_CA_vRegBrownout" 180 "FC_a180_CA_chargingProblem" 179 "FC_a179_CA_startupProblem" 178 "FC_a178_CA_evseStartTimeout" 177 "FC_a177_CA_bmsCtrCloseTimeout" 176 "FC_a176_CA_chargingBusTimeout" 175 "FC_a175_CA_evseIsoTestTimeout" 174 "FC_a174_CA_vehReadyTimeout" 173 "FC_a173_CA_evseDataTimeout" 172 "FC_a172_CA_ss2LowTimeout" 171 "FC_a171_CA_vehConLockTimeout" 170 "FC_a170_CA_vehDataTimeout" 169 "FC_a169_CA_pilotAcceptTimeout" 168 "FC_a168_CA_proxTimeout" 167 "FC_a167_CA_isoVoltageLow" 166 "FC_a166_CA_vehConnUnlocked" 165 "FC_a165_CA_evseConnUnlocked" 164 "FC_a164_CA_proxDisconnected" 163 "FC_a163_CA_pcbTempHiFoldBk" 162 "FC_a162_CA_evseTempHiFoldBk" 161 "FC_a161_CA_vehTempHiFoldBk" 160 "FC_a160_CA_ss2Deasserted" 159 "FC_a159_CA_wdtExpired" 158 "FC_a158_CA_evseOverCurrent" 157 "FC_a157_CA_unused" 156 "FC_a156_CA_flybackRunTimeout" 155 "FC_a155_CA_evseToPcbDeltaLo" 154 "FC_a154_CA_vehToPcbDeltaLo" 153 "FC_a153_CA_evseToPcbDeltaHi" 152 "FC_a152_CA_vehToPcbDeltaHi" 151 "FC_a151_CA_vehToEvseDeltaLo" 150 "FC_a150_CA_vehToEvseDeltaHi" 149 "FC_a149_CA_pcb_UT" 148 "FC_a148_CA_evseConn_UT" 147 "FC_a147_CA_vehConn_UT" 146 "FC_a146_CA_flybackBusLoadHi" 145 "FC_a145_CA_flybackDataStale" 144 "FC_a144_CA_flybackUnstable" 143 "FC_a143_CA_pcb_OT" 142 "FC_a142_CA_evseConn_OT" 141 "FC_a141_CA_vehConn_OT" 140 "FC_a140_CA_bmsIncompatible" 139 "FC_a139_CA_ss2NotLow" 138 "FC_a138_CA_hwProxTrip" 137 "FC_a137_CA_evseRxBufOvf" 136 "FC_a136_CA_evseTxBufOvf" 135 "FC_a135_CA_vehRxBufOvf" 134 "FC_a134_CA_vehTxBufOvf" 133 "FC_a133_CA_evseMia" 132 "FC_a132_CA_bmsMia" 131 "FC_a131_CA_flyback_HW_OV" 130 "FC_a130_CA_flyback_SW_OV" 129 "FC_a129_CA_flyback_HW_OC" 0 "FC_ALERT_DO_NOT_USE_ZERO" ;
VAL_TABLE_ FC_alertType 1 "FC_ALERT_TYPE_FAULT" 0 "FC_ALERT_TYPE_WARNING" ;
VAL_TABLE_ FC_brand 1 "FC_BRAND_TESLA" 0 "FC_BRAND_SNA" ;
VAL_TABLE_ FC_class 2 "FC_CLASS_URBANCHARGER" 1 "FC_CLASS_SUPERCHARGER" 0 "FC_CLASS_SNA" ;
VAL_TABLE_ FC_coolingType 2 "FC_COOLING_TYPE_CONVECTION" 1 "FC_COOLING_TYPE_LIQUID" 0 "FC_COOLING_TYPE_SNA" ;
VAL_TABLE_ FC_currentLimit 8191 "SNA" ;
VAL_TABLE_ FC_currentLimit_value -32768 "SNA" ;
VAL_TABLE_ FC_evseBillingMux 1 "FC_EVSEBILLING_DATASELECT_1" 0 "FC_EVSEBILLING_DATASELECT_0" ;
VAL_TABLE_ FC_generation 0 "GENERATION_SNA" ;
VAL_TABLE_ FC_maxCurrentLimit 8191 "SNA" ;
VAL_TABLE_ FC_maxPowerLimit 8191 "SNA" ;
VAL_TABLE_ FC_maxVoltageLimit 8191 "SNA" ;
VAL_TABLE_ FC_minVoltageLimit 8191 "SNA" ;
VAL_TABLE_ FC_minVoltageLimit_value -32768 "SNA" ;
VAL_TABLE_ FC_postID 3 "FC_POST_ID_SNA" 2 "FC_POST_ID_2" 1 "FC_POST_SLAVE" 0 "FC_POST_MASTER" ;
VAL_TABLE_ FC_powerLimit 8191 "SNA" ;
VAL_TABLE_ FC_powerLimit_value -32768 "SNA" ;
VAL_TABLE_ FC_serialMux 2 "Mux2" 1 "Mux1" 0 "Mux0" ;
VAL_TABLE_ FC_status 15 "FC_STATUS_NODATA" 14 "FC_STATUS_MALFUNCTION" 13 "FC_STATUS_NOTCOMPATIBLE" 7 "FC_STATUS_POST_OUT_OF_SERVICE" 6 "FC_STATUS_EXT_ISOACTIVE" 5 "FC_STATUS_INT_ISOACTIVE" 4 "FC_STATUS_DEPRECATED_4" 3 "FC_STATUS_DEPRECATED_3" 2 "FC_STATUS_UPDATE_IN_PROGRESS" 1 "FC_STATUS_READY" 0 "FC_STATUS_NOTREADY_SNA" ;
VAL_TABLE_ FC_status3Mux 1 "Mux1" 0 "Mux0" ;
VAL_TABLE_ FC_type 7 "FC_TYPE_SNA" 6 "FC_TYPE_OTHER" 5 "FC_TYPE_MC_EVSE" 4 "FC_TYPE_COMBO" 3 "FC_TYPE_CC_EVSE" 2 "FC_TYPE_GB" 1 "FC_TYPE_CHADEMO" 0 "FC_TYPE_SUPERCHARGER" ;
VAL_TABLE_ FC_uiStopType 2 "FC_UI_STOP_TYPE_MOMENTARY" 1 "FC_UI_STOP_TYPE_TOGGLE" 0 "FC_UI_STOP_TYPE_SNA" ;
VAL_TABLE_ FaultLine 1 "FAULT_LINE_SET" 0 "FAULT_LINE_CLEARED" ;
VAL_TABLE_ GBDC_failureReason 3 "GBDC_CRITICAL_FAILURE" 2 "GBDC_SHUTDOWN_FAILURE" 1 "GBDC_ATTEMPTS_EXPIRED" 0 "GBDC_FAILURE_NONE" ;
VAL_TABLE_ GBDC_state 15 "GBDC_TESTER_PRESENT" 14 "GBDC_FAULTED" 13 "GBDC_RETRY_CHARGE" 12 "GBDC_ERROR_HANDLING" 11 "GBDC_END_OF_CHARGE" 10 "GBDC_CHARGE_DISABLING" 9 "GBDC_STOP_CHARGE_REQUESTED" 8 "GBDC_CHARGING" 7 "GBDC_READY_TO_CHARGE" 6 "GBDC_VEH_PACK_PRECHARGE" 5 "GBDC_CHARGE_PARAM_CONFIG" 4 "GBDC_RECOGNITION" 3 "GBDC_HANDSHAKING_EXT_ISO" 2 "GBDC_COMMS_RECEIVED" 1 "GBDC_WAIT_FOR_COMMS" 0 "GBDC_INACTIVE" ;
VAL_TABLE_ GBDC_stopChargeReason 7 "GBDC_SUPERCHARGER_COMMS_TIMEOUT" 6 "GBDC_LIVE_DISCONNECT" 5 "GBDC_EVSE_CRITICAL_FAULT" 4 "GBDC_EVSE_FAULT" 3 "GBDC_COMMS_TIMEOUT" 2 "GBDC_EVSE_REQUESTED" 1 "GBDC_VEH_REQUESTED" 0 "GBDC_STOP_REASON_NONE" ;
VAL_TABLE_ GB_chgAllowed 1 "FC_CHG_ALLOWED" 0 "FC_CHG_FORBIDDEN" ;
VAL_TABLE_ GB_chgCommsTimeoutReason 2 "GB_COMMS_ERROR_SNA" 1 "GB_COMMS_ERROR_TRUE" 0 "GB_COMMS_ERROR_FALSE" ;
VAL_TABLE_ GB_chgLogDataSelect 11 "GB_LOG_HIGHPOWERCHARGE" 10 "GB_LOG_TESLAID" 9 "GB_LOG_TESLAINFO" 8 "GB_LOG_CEM" 7 "GB_LOG_CSD" 6 "GB_LOG_CST" 5 "GB_LOG_CCS" 4 "GB_LOG_CRO" 3 "GB_LOG_CML" 2 "GB_LOG_CRM2" 1 "GB_LOG_CRM" 0 "GB_LOG_CHM" ;
VAL_TABLE_ GB_chgStopReasonStatus 2 "GB_STOP_RSN_SNA" 1 "GB_STOP_RSN_SET" 0 "GB_STOP_RSN_CLEARED" ;
VAL_TABLE_ GB_ready 170 "GB_EVSE_READY" 0 "GB_EVSE_NOT_READY" ;
VAL_TABLE_ GB_recognitionResult 170 "GB_VEH_RECOGNIZABLE" 0 "GB_VEH_NOT_RECOGNIZABLE" ;
VAL_TABLE_ GB_vehLogDataSelect 14 "GB_LOG_VEH_TESLAVIN" 13 "GB_LOG_VEH_HIGHPOWERCHARGE" 12 "GB_LOG_VEH_TESLAINFO" 11 "GB_LOG_BEM" 10 "GB_LOG_BSD" 9 "GB_LOG_BST" 8 "GB_LOG_BSP" 7 "GB_LOG_BSM" 6 "GB_LOG_BCS" 5 "GB_LOG_BCL" 4 "GB_LOG_BRO" 3 "GB_LOG_BCP" 2 "GB_LOG_BRM2" 1 "GB_LOG_BRM" 0 "GB_LOG_BHM" ;
VAL_TABLE_ GB_vehicleStatus 170 "GB_VEH_READY" 0 "GB_VEH_NO_READY" ;
VAL_TABLE_ GTW_bmpState 255 "DUMMY" 5 "BMP_STATE_POWER_CYCLE" 4 "BMP_STATE_RESET" 3 "BMP_STATE_MIA" 2 "BMP_STATE_ASLEEP" 1 "BMP_STATE_ON" 0 "BMP_STATE_OFF" ;
VAL_TABLE_ GTW_canLogServiceStatus 3 "LOG_QUEUE_FULL" 2 "LOGGING_UNAVAILABLE" 1 "LOGGING_AVAILABLE" 0 "SNA" ;
VAL_TABLE_ GTW_diagLevel 100 "LEVEL_NORMAL_OPERATION" 80 "LEVEL_PARK" 50 "LEVEL_SERVICE_DRIVE" 25 "LEVEL_SERVICE" 10 "LEVEL_DIAG_LINK_ACTIVE" 0 "LEVEL_FACTORY" ;
VAL_TABLE_ GTW_ethKeepAwakeReason 1 "URGENT_TRANSMIT_ALERT" 0 "NONE_SNA" ;
VAL_TABLE_ GTW_hrlMux 2 "Mux2" 1 "Mux1" ;
VAL_TABLE_ GTW_hrlState 1 "ENABLED" 0 "DISABLED" ;
VAL_TABLE_ GTW_hrlTriggerType 15 "HRL_TRIGGER_NONE" 3 "HRL_TRIGGER_CONTINUOUS" 2 "HRL_TRIGGER_GAME_MODE" 1 "HRL_TRIGGER_EVENT" 0 "HRL_TRIGGER_UDPAPI" ;
VAL_TABLE_ GTW_infohw 2 "INFOZ" 1 "INTEL" 0 "SNA" ;
VAL_TABLE_ GTW_mismatchFaultMux 1 "Mux1" ;
VAL_TABLE_ GTW_nmKeepAwakeReason 15 "GTW_KEEPAWAKE_REASON_TBD" 4 "GTW_KEEPAWAKE_REASON_URGENT_TRANSMIT_ALERT" 3 "GTW_KEEPAWAKE_REASON_FCSM_ACTIVE" 2 "GTW_KEEPAWAKE_REASON_GSM_RI" 1 "GTW_KEEPAWAKE_REASON_UI_SCHEDULED" 0 "GTW_KEEPAWAKE_REASON_NONE_SNA" ;
VAL_TABLE_ GTW_nmWakeUpReason 11 "GTW_WAKEUP_REASON_URGENT_TRANSMIT_ALERT" 10 "GTW_WAKEUP_REASON_BDY_CAN" 9 "GTW_WAKEUP_REASON_PT_CAN" 8 "GTW_WAKEUP_REASON_UI_SCHEDULED" 7 "GTW_WAKEUP_REASON_RTC_ALARM" 6 "GTW_WAKEUP_REASON_VCFRONT" 5 "GTW_WAKEUP_REASON_VEH_CAN" 4 "GTW_WAKEUP_REASON_ETH_CAN" 3 "GTW_WAKEUP_REASON_CH_CAN" 2 "GTW_WAKEUP_REASON_GSM_RI" 1 "GTW_WAKEUP_REASON_RESET" 0 "GTW_WAKEUP_REASON_NONE" ;
VAL_TABLE_ GTW_offboardUpdateState 5 "OFFBOARD_UPDATE_LATCH_RESULT" 4 "OFFBOARD_UPDATE_CONFIRM_UPDATE" 3 "OFFBOARD_UPDATE_RUNNING" 2 "OFFBOARD_UPDATE_PREPARING" 1 "OFFBOARD_UPDATE_WAIT_UPDATE_TRIGGER" 0 "OFFBOARD_UPDATE_WAITING_FOR_CONNECTION" ;
VAL_TABLE_ GTW_offboardUpdateStatus 7 "OFFBOARD_UPDATE_APPTRIPLE_MISMATCH" 6 "OFFBOARD_UPDATE_NOT_NEEDED" 5 "OFFBOARD_UPDATE_LOST_DIGITAL_COMMS" 4 "OFFBOARD_UPDATE_SUCCESS" 3 "OFFBOARD_UPDATE_UDS_FAILED" 2 "OFFBOARD_UPDATE_UNPLUGGED" 1 "OFFBOARD_UPDATE_FILE_OPEN_ERROR" 0 "OFFBOARD_UPDATE_OK" ;
VAL_TABLE_ GTW_vinMux 18 "VinLow" 17 "VinMid" 16 "VinHigh" ;
VAL_TABLE_ HEAT_PUMP_MODE 22 "CABIN_COOL_EVAPORATOR_BATTERY_HEAT_AMBIENT_SOURCE" 21 "BATTERY_HEAT_CABIN_HEAT_COP1" 20 "BATTERY_HEAT_CABIN_HEAT_AMBIENT_SOURCE" 19 "BATTERY_COOL_EVAPORATOR" 18 "BATTERY_COOL_CABIN_REHEAT" 17 "BATTERY_COOL_CABIN_CONDENSER" 16 "BATTERY_COOL_CABIN_CONDENSER_REHEAT" 15 "BATTERY_COOL" 14 "BATTERY_HEAT_COP1" 13 "BATTERY_HEAT_AMBIENT_SOURCE" 12 "CABIN_COOL_EVAPORATOR_REHEAT" 11 "CABIN_COOL_EVAPORATOR" 10 "CABIN_HEAT_BATTERY_COOL_REHEAT" 9 "CABIN_HEAT_BATTERY_HEAT_REHEAT_AMBIENT_SOURCE" 8 "CABIN_HEAT_COP1" 7 "CABIN_HEAT_BLEND" 6 "CABIN_HEAT_REHEAT_AMBIENT_SOURCE" 5 "CABIN_HEAT_REHEAT_SCAVENGE" 4 "CABIN_HEAT_AMBIENT_SOURCE" 3 "CABIN_HEAT_SCAVENGE_ONLY" 2 "AMBIENT_SOURCE" 1 "GENERAL" 0 "NONE" ;
VAL_TABLE_ HVACActuatorOperationMode 1 "HVACACTUATOR_OPERATION_MODE_CALIBRATION" 0 "HVACACTUATOR_OPERATION_MODE_NORMAL" ;
VAL_TABLE_ HVACActuatorState 2 "HVACACTUATOR_STATE_COASTING" 1 "HVACACTUATOR_STATE_RUNNING" 0 "HVACACTUATOR_STATE_BRAKING" ;
VAL_TABLE_ HVFaultLoadShedSMState 3 "HV_FAULT_LOADSHED_SM_STATE_ACTIVE" 2 "HV_FAULT_LOADSHED_SM_STATE_BLOCKED" 1 "HV_FAULT_LOADSHED_SM_STATE_IDLE" 0 "HV_FAULT_LOADSHED_SM_STATE_INIT" ;
VAL_TABLE_ HVP_a020_energyReserveV 65535 "SNA" ;
VAL_TABLE_ HVP_a020_shuntCurrentAux -32768 "SNA" ;
VAL_TABLE_ HVP_a020_shuntTemperature -32768 "SNA" ;
VAL_TABLE_ HVP_a021_Aout 16383 "SNA" ;
VAL_TABLE_ HVP_a021_SquibResistance 65535 "SNA" ;
VAL_TABLE_ HVP_a022_Aout 16383 "SNA" ;
VAL_TABLE_ HVP_a022_SquibResistance 65535 "SNA" ;
VAL_TABLE_ HVP_a026_difVoltage 255 "SNA" ;
VAL_TABLE_ HVP_a026_dirVoltage 255 "SNA" ;
VAL_TABLE_ HVP_a026_internalVoltage 255 "SNA" ;
VAL_TABLE_ HVP_a051_energyReserveV 65535 "SNA" ;
VAL_TABLE_ HVP_a051_shuntCurrent -32768 "SNA" ;
VAL_TABLE_ HVP_a051_shuntTemperature -32768 "SNA" ;
VAL_TABLE_ HVP_a061_auxCurrent -32768 "SNA" ;
VAL_TABLE_ HVP_a061_shuntCurrent -32768 "SNA" ;
VAL_TABLE_ HVP_alerts 62 "HVP_a062_BmbOtpConfigError" 61 "HVP_a061_ShuntCurrentRationality" 60 "HVP_a060_StackVoltageSense" 59 "HVP_a059_BmbVrefWarning" 58 "HVP_a058_BmbVrefBad" 57 "HVP_a057_BatmanDiagnosticsError" 56 "HVP_a056_contactorFailedToOpen" 55 "HVP_a055_swMissingPartNumber" 54 "HVP_a054_swMissingConfigBlock" 53 "HVP_a053_hvVoltageSensorRationality" 52 "HVP_a052_BmbStatusRegError" 51 "HVP_a051_shuntThermistorMia" 50 "HVP_a050_fcCtrCloseFailed" 49 "HVP_a049_packCtrCloseFailed" 47 "HVP_a047_passivePyroDeploy" 46 "HVP_a046_shuntOverTemperature" 45 "HVP_a045_dcLinkOverVoltage" 44 "HVP_a044_fcContactorForceOpen" 43 "HVP_a043_packContactorForceOpen" 42 "HVP_a042_fcCtrCloseBlocked" 41 "HVP_a041_packCtrCloseBlocked" 40 "HVP_a040_FcContactorFellOpen" 39 "HVP_a039_PackContactorFellOpen" 38 "HVP_a038_CpilFault" 37 "HVP_a037_pyroFuseFailedToBlow" 36 "HVP_a036_pyroFuseBlown" 35 "HVP_a035_packContHwFault" 34 "HVP_a034_cpMismatchFault" 33 "HVP_a033_fcContHwFault" 32 "HVP_a032_ShuntHwAndBmsMiaFault" 31 "HVP_a031_packNegCtrArcFault" 30 "HVP_a030_PackPosCtrArcFault" 29 "HVP_a029_EnsMiaFault" 28 "HVP_a028_PackVoltMismatchFault" 27 "HVP_a027_BmsMiaOnHvsFault" 26 "HVP_a026_HvilFault" 25 "HVP_a025_VerSupplyFault" 24 "HVP_a024_Supply12vFault" 22 "HVP_a022_PyroMiaWarning" 21 "HVP_a021_PyroMiaFault" 20 "HVP_a020_ShuntHwMiaFault" 19 "HVP_a019_CpFault" 17 "HVP_a017_GtwMiaFault" 16 "HVP_a016_PcsMiaFault" 15 "HVP_a015_CpMiaFault" 14 "HVP_a014_BmsMiaOnHviFault" 13 "HVP_a013_BmbCommunication" 12 "HVP_a012_BmbDataIntegrityLoss" 11 "HVP_a011_PrimaryBmbMiaFault" 10 "HVP_a010_UnderVoltageFault" 9 "HVP_a009_OverVoltageFault" 8 "HVP_a008_OverTemperatureFault" 7 "HVP_a007_OverCurrentFault" 6 "HVP_a006_OverChargeCurrentFault" 5 "HVP_a005_OverDchgCurrentFault" 4 "HVP_a004_CrashEvent" 3 "HVP_a003_SwAssertion" 2 "HVP_a002_UnusedAlert2" 1 "HVP_a001_WatchdogReset" 0 "HVP_ALERT_DO_NOT_USE_ZERO" 64 "HVP_a064_BmbAuxVRationality" 63 "HVP_a063_BmbBrickVRationality" ;
VAL_TABLE_ HVP_contactorFailedToOpenCause 2 "PACK_CONTACTOR_WELDED" 1 "HIGH_SHUNT_CURRENT" 0 "SHUNT_CURRENT_SNA" ;
VAL_TABLE_ HVP_contactorRequestStatus 2 "REQUEST_COMPLETED" 1 "REQUEST_ACTIVE" 0 "REQUEST_NOT_ACTIVE" ;
VAL_TABLE_ HVP_dcLinkVoltageFiltered -550 "SNA" ;
VAL_TABLE_ HVP_debugMessageMux 12 "Mux12" 11 "Mux11" 10 "Mux10" 9 "Mux9" 8 "Mux8" 7 "Mux7" 6 "Mux6" 5 "Mux5" 4 "Mux4" 3 "Mux3" 2 "Mux2" 1 "Mux1" 0 "Mux0" ;
VAL_TABLE_ HVP_hvilDiag 13 "PM_OPEN_FAULT" 12 "DI_OPEN_FAULT" 11 "PM_STATUS_MISSING_FAULT" 10 "DI_STATUS_MISSING_FAULT" 9 "VEHICLE_OR_PENTHOUSE_LID_OPEN_FAULT" 8 "NO_12V_SUPPLY" 7 "VEHICLE_NODE_FAULT" 6 "UNKNOWN_LOCATION_OPEN_FAULT" 5 "PENTHOUSE_LID_OPEN_FAULT" 4 "VEHICLE_OPEN_FAULT" 3 "INTERNAL_OPEN_FAULT" 2 "CURRENT_SOURCE_OR_GROUND_LEAK_FAULT" 1 "OK" 0 "UNKNOWN" ;
VAL_TABLE_ HVP_log1hzMux 1 "Mux1" 0 "Mux0" ;
VAL_TABLE_ HVP_pcsDcdcControlRequest 3 "DISCHARGE" 2 "PRECHARGE" 1 "SUPPORT" 0 "SHUTDOWN" ;
VAL_TABLE_ HVP_pyroDeviceDbgMux 6 "PYRO_AOUT_LS_SWITCH" 5 "PYRO_AOUT_HS_SWITCH" 4 "PYRO_AOUT_SQUIB_RES" 3 "PYRO_AOUT_REF" 2 "PYRO_AOUT_LEAK" 1 "PYRO_AOUT_ER" 0 "PYRO_AOUT_VST" ;
VAL_TABLE_ HVP_pyroFiringHandle 12 "PYRO_HANDLE_PACK_NEGATIVE_CTR_ARC" 11 "PYRO_HANDLE_PACK_POSITIVE_CTR_ARC" 10 "PYRO_HANDLE_ENS_CRASH" 9 "PYRO_HANDLE_SHUNT_MIA" 8 "PYRO_HANDLE_OPEN_IMMEDIATELY" 7 "PYRO_HANDLE_TEMPERATURE" 6 "PYRO_HANDLE_UNDER_VOLTAGE" 5 "PYRO_HANDLE_OVER_VOLTAGE" 4 "PYRO_HANDLE_OVER_CURRENT" 3 "PYRO_HANDLE_OVER_CHARGE_CURRENT" 2 "PYRO_HANDLE_OVER_DISCHARGE_CURRENT" 1 "PYRO_HANDLE_HVP" ;
VAL_TABLE_ HVP_pyroSquibResistance 65535 "SNA" ;
VAL_TABLE_ HVP_pyroStatus 3 "STATUS_ACTIVATED" 2 "STATUS_FAULT" 1 "STATUS_OK" 0 "STATUS_UNKNOWN" ;
VAL_TABLE_ IBST_driverBrakeApply 3 "FAULT" 2 "DRIVER_APPLYING_BRAKES" 1 "BRAKES_NOT_APPLIED" 0 "NOT_INIT_OR_OFF" ;
VAL_TABLE_ IBST_iBoosterStatus 6 "IBOOSTER_ACTUATION" 5 "IBOOSTER_READY" 4 "IBOOSTER_ACTIVE_GOOD_CHECK" 3 "IBOOSTER_DIAGNOSTIC" 2 "IBOOSTER_FAILURE" 1 "IBOOSTER_INIT" 0 "IBOOSTER_OFF" ;
VAL_TABLE_ IBST_internalState 6 "POST_DRIVE_CHECK" 5 "TRANSITION_TO_IDLE" 4 "DIAGNOSTIC" 3 "EXTERNAL_BRAKE_REQUEST" 2 "LOCAL_BRAKE_REQUEST" 1 "PRE_DRIVE_CHECK" 0 "NO_MODE_ACTIVE" ;
VAL_TABLE_ IBST_sOutputRodDriverQF 2 "OUTPUT_ROD_DRIVER_FAULT" 1 "OUTPUT_ROD_DRIVER_NORMAL" 0 "OUTPUT_ROD_DRIVER_NOT_INITIALIZED" ;
VAL_TABLE_ IBSTemperature 2047 "IBS_TEMPERATURE_SNA" ;
VAL_TABLE_ IBSVoltage 4095 "IBS_VOLTAGE_SNA" ;
VAL_TABLE_ ICRAlgoVersion 7 "ICR_ALGO_VERSION_FUTURE_RELEASE_6" 6 "ICR_ALGO_VERSION_FUTURE_RELEASE_5" 5 "ICR_ALGO_VERSION_FUTURE_RELEASE_4" 4 "ICR_ALGO_VERSION_FUTURE_RELEASE_3" 3 "ICR_ALGO_VERSION_FUTURE_RELEASE_2" 2 "ICR_ALGO_VERSION_FUTURE_RELEASE_1" 1 "ICR_ALGO_VERSION_V170" 0 "ICR_ALGO_VERSION_NONE" ;
VAL_TABLE_ ICR_intrusionStatus 2 "INSTRUSION_STATUS_INTRUSION_DETECTED" 1 "INSTRUSION_STATUS_NONE" 0 "INSTRUSION_STATUS_UNKNOWN" ;
VAL_TABLE_ ICR_nmKeepAwakeReason 0 "ICR_KEEPAWAKE_REASON_NONE_SNA" ;
VAL_TABLE_ ICR_nmWakeUpReason 2 "ICR_WAKEUP_REASON_INTRUSION" 1 "ICR_WAKEUP_REASON_CAN" 0 "ICR_WAKEUP_REASON_NONE" ;
VAL_TABLE_ KAYAK_AlertMatrixIndex 0 "KAYAK_AlertMatrix0" ;
VAL_TABLE_ KAYAK_alertSource 9 "KAYAK_ALERT_SOURCE_DCDC_SYSTEM" 8 "KAYAK_ALERT_SOURCE_DCAC_SYSTEM" 7 "KAYAK_ALERT_SOURCE_DCAC_B" 6 "KAYAK_ALERT_SOURCE_DCAC_A" 5 "KAYAK_ALERT_SOURCE_DCDC_B" 4 "KAYAK_ALERT_SOURCE_DCDC_A" 3 "KAYAK_ALERT_SOURCE_CPU3" 2 "KAYAK_ALERT_SOURCE_CPU2" 1 "KAYAK_ALERT_SOURCE_CPU1" 0 "KAYAK_ALERT_SOURCE_CPU0" ;
VAL_TABLE_ KAYAK_alerts 20 "KAYAK_a020_chassisNOverVoltage" 19 "KAYAK_a019_dcdcBTankOverVoltage" 18 "KAYAK_a018_dcdcBTankOverCurrent" 17 "KAYAK_a017_dcdcATankOverVoltage" 16 "KAYAK_a016_dcdcATankOverCurrent" 15 "KAYAK_a015_cycloBTankOverVoltage" 14 "KAYAK_a014_cycloBTankOverCurrent" 13 "KAYAK_a013_cycloATankOverVoltage" 12 "KAYAK_a012_cycloATankOverCurrent" 11 "KAYAK_a011_hvdcOverCurrent" 10 "KAYAK_a010_acNOverCurrent" 9 "KAYAK_a009_acL3NOverCurrent" 8 "KAYAK_a008_acL3NOverVoltage" 7 "KAYAK_a007_acL2NOverCurrent" 6 "KAYAK_a006_acL2NOverVoltage" 5 "KAYAK_a005_acL1NOverCurrent" 4 "KAYAK_a004_acL1NOverVoltage" 3 "KAYAK_a003_softwareAssertion" 2 "KAYAK_a002_canRationality" 1 "KAYAK_a001_watchdogAlarmed" 0 "KAYAK_ALERT_DO_NOT_USE_ZERO" 21 "KAYAK_a021_18V0RailOutOfBounds" ;
VAL_TABLE_ KAYAK_canErrorType 6 "KAYAK_CAN_ERR_UNKNOWN_ID" 5 "KAYAK_CAN_ERR_DATAINVALID" 4 "KAYAK_CAN_ERR_SEQUENCE" 3 "KAYAK_CAN_ERR_CHECKSUM" 2 "KAYAK_CAN_ERR_LENGTH_LONG" 1 "KAYAK_CAN_ERR_LENGTH_SHORT" 0 "KAYAK_CAN_ERR_NONE" ;
VAL_TABLE_ KAYAK_cmpssTripStatus 1 "KAYAK_COMPL_TRIP" 0 "KAYAK_COMPH_TRIP" ;
VAL_TABLE_ KAYAK_cpuID 4 "KAYAK_CPU_ID_NUM_OF_CPUS" 3 "KAYAK_CPU_ID_CPU3" 2 "KAYAK_CPU_ID_CPU2" 1 "KAYAK_CPU_ID_CPU1" 0 "KAYAK_CPU_ID_CPU0" ;
VAL_TABLE_ KAYAK_softwareAssertion 2 "KAYAK_ASSERTION_UNABLE_TO_ACQUIRE_IPC_QUEUE_MUTEX" 1 "KAYAK_ASSERTION_UNABLE_TO_CREATE_RTOS_QUEUE" 0 "KAYAK_ASSERTION_SWITCH_STATEMENT_REACH_DEFAULT" ;
VAL_TABLE_ LINFrameStatus 4 "LIN_FRAME_STATUS_NA" 3 "LIN_FRAME_STATUS_ERROR" 2 "LIN_FRAME_STATUS_TIMEOUT" 1 "LIN_FRAME_STATUS_OK" 0 "LIN_FRAME_STATUS_UNKNOWN" ;
VAL_TABLE_ LV8907StatusMode 3 "LV8907_NORMAL" 2 "LV8907_STANDBY" 1 "LV8907_STARTUP" 0 "LV8907_SLEEP" ;
VAL_TABLE_ LVBMS_AhCharged -1 "SNA" ;
VAL_TABLE_ LVBMS_AhDischarged -1 "SNA" ;
VAL_TABLE_ LVBMS_ECPAState 3 "LVBMS_ECPA_STATE_SNA" 2 "LVBMS_ECPA_STATE_INVALID" 1 "LVBMS_ECPA_STATE_CLOSED" 0 "LVBMS_ECPA_STATE_OPEN" ;
VAL_TABLE_ LVBMS_LINWakeState 1 "LVBMS_LIN_WAKE_DISABLED" 0 "LVBMS_LIN_WAKE_ENABLED" ;
VAL_TABLE_ LVBMS_MOSState 3 "LVBMS_MOS_STATE_SNA" 2 "LVBMS_MOS_STATE_INVALID" 1 "LVBMS_MOS_STATE_CLOSED" 0 "LVBMS_MOS_STATE_OPEN" ;
VAL_TABLE_ LVBMS_MOSTemperature 4095 "SNA" ;
VAL_TABLE_ LVBMS_SOC 127 "SNA" ;
VAL_TABLE_ LVBMS_SOE 127 "SNA" ;
VAL_TABLE_ LVBMS_SOH 127 "SNA" ;
VAL_TABLE_ LVBMS_SOP 16777215 "SNA" ;
VAL_TABLE_ LVBMS_TimeSlept 16777215 "SNA" ;
VAL_TABLE_ LVBMS_VehicleState 3 "LVBMS_VEHICLE_STATE_OFF" 2 "LVBMS_VEHICLE_STATE_CONDITIONING" 1 "LVBMS_VEHICLE_STATE_ACCESSORY" 0 "LVBMS_VEHICLE_STATE_DRIVE" ;
VAL_TABLE_ LVBMS_balancingState 1 "LVBMS_BALANCING_STATE_ACTIVE" 0 "LVBMS_BALANCING_STATE_INACTIVE" ;
VAL_TABLE_ LVBMS_cellBalancingAh 16777215 "SNA" ;
VAL_TABLE_ LVBMS_cellVoltage 65535 "SNA" ;
VAL_TABLE_ LVBMS_chargeType 4 "LVBMS_CHARGE_SNA" 3 "LVBMS_CHARGE_COMPLETE" 2 "LVBMS_CHARGE_CONSTANT_VOLTAGE" 1 "LVBMS_CHARGE_CONSTANT_CURRENT" 0 "LVBMS_CHARGE_UNDEFINED" ;
VAL_TABLE_ LVBMS_currentTarget 32767 "SNA" ;
VAL_TABLE_ LVBMS_infoIndex 5 "LVBMS_INFO_INVALID" 4 "LVBMS_INFO_SERIAL_NUMBER" 3 "LVBMS_INFO_BUILDTYPE" 2 "LVBMS_INFO_GITHASH" 1 "LVBMS_INFO_APP_USAGEID_CRC" 0 "LVBMS_INFO_PCBAID_ASSYID" ;
VAL_TABLE_ LVBMS_maxAllowedChargeCurrent 8191 "SNA" ;
VAL_TABLE_ LVBMS_maxAllowedDischargeCurrent 8191 "SNA" ;
VAL_TABLE_ LVBMS_packCurrent 4194303 "SNA" ;
VAL_TABLE_ LVBMS_packTemperature 511 "SNA" ;
VAL_TABLE_ LVBMS_packVoltage 65535 "SNA" ;
VAL_TABLE_ LVBMS_sleepCurrent 65535 "SNA" ;
VAL_TABLE_ LVBMS_socCorrectionState 1 "LVBMS_CORRECTION_STATE_ACTIVE" 0 "LVBMS_CORRECTION_STATE_INACTIVE" ;
VAL_TABLE_ LVBMS_statusHighIndex 6 "LVBMS_STATUS_HIGH_INVALID" 5 "LVBMS_STATUS_HIGH_PCS_INTERFACE" 4 "LVBMS_STATUS_HIGH_STATE_AND_COMMANDS" 3 "LVBMS_STATUS_HIGH_TARGETS" 2 "LVBMS_STATUS_HIGH_CELL_VITALS_2" 1 "LVBMS_STATUS_HIGH_CELL_VITALS_1" 0 "LVBMS_STATUS_HIGH_PACK_VITALS_1" ;
VAL_TABLE_ LVBMS_statusLowIndex 8 "LVBMS_STATUS_LOW_INVALID" 7 "LVBMS_STATUS_LOW_CELL_VITALS_4" 6 "LVBMS_STATUS_LOW_CELL_VITALS_3" 5 "LVBMS_STATUS_LOW_FAULT_STATS" 4 "LVBMS_STATUS_LOW_PACK_VITALS_2" 3 "LVBMS_STATUS_LOW_THROUGHPUT_3" 2 "LVBMS_STATUS_LOW_THROUGHPUT_2" 1 "LVBMS_STATUS_LOW_THROUGHPUT_1" 0 "LVBMS_STATUS_LOW_STATE" ;
VAL_TABLE_ LVBMS_sumCellVoltage 65535 "SNA" 65534 "INVALID" ;
VAL_TABLE_ LVBMS_voltageTarget 32767 "SNA" ;
VAL_TABLE_ LVBatterySupportRqrdTrigger 1024 "LV_BATTERY_SUPPORT_REQUIRED_TRIGGER_POST_OTA" 512 "LV_BATTERY_SUPPORT_REQUIRED_TRIGGER_EXIT_TRANSPORT_MODE" 256 "LV_BATTERY_SUPPORT_REQUIRED_TRIGGER_POWER_ON_RESET" 128 "LV_BATTERY_SUPPORT_REQUIRED_TRIGGER_PERIODIC_CHARGE" 64 "LV_BATTERY_SUPPORT_REQUIRED_TRIGGER_AH_COUNT" 32 "LV_BATTERY_SUPPORT_REQUIRED_TRIGGER_UNKNOWN_VOLTAGE" 16 "LV_BATTERY_SUPPORT_REQUIRED_TRIGGER_VBAT_RAW_VOLTAGE" 8 "LV_BATTERY_SUPPORT_REQUIRED_TRIGGER_PACK_RAW_VOLTAGE" 4 "LV_BATTERY_SUPPORT_REQUIRED_TRIGGER_IBS_RAW_VOLTAGE" 2 "LV_BATTERY_SUPPORT_REQUIRED_TRIGGER_PACK_FILTERED_VOLTAGE" 1 "LV_BATTERY_SUPPORT_REQUIRED_TRIGGER_IBS_FILTERED_VOLTAGE" 0 "LV_BATTERY_SUPPORT_REQUIRED_TRIGGER_NONE" 20 "LV_BATTERY_SUPPORT_REQUIRED_TRIGGER_RAW_VC_VOLTAGES" 12 "LV_BATTERY_SUPPORT_REQUIRED_TRIGGER_RAW_BATTERY_VOLTAGES" 10 "LV_BATTERY_SUPPORT_REQUIRED_TRIGGER_PACK_VOLTAGES" 5 "LV_BATTERY_SUPPORT_REQUIRED_TRIGGER_IBS_VOLTAGES" 3 "LV_BATTERY_SUPPORT_REQUIRED_TRIGGER_FILTERED_VOLTAGES" ;
VAL_TABLE_ LVPowerState 3 "LV_FAULT" 2 "LV_GOING_DOWN" 1 "LV_ON" 0 "LV_OFF" ;
VAL_TABLE_ LV_Battery_Status_For_Drive 2 "LV_BATTERY_EXIT_DRIVE_REQUESTED" 1 "LV_BATTERY_READY_FOR_DRIVE" 0 "LV_BATTERY_NOT_READY_FOR_DRIVE" ;
VAL_TABLE_ LV_batterySMStateDBG 9 "BATTERY_SM_STATE_RECOVERY" 8 "BATTERY_SM_STATE_FAULT" 7 "BATTERY_SM_STATE_SHORTED_CELL_TEST" 6 "BATTERY_SM_STATE_DISCONNECTED_BATTERY_TEST" 5 "BATTERY_SM_STATE_OTA_STANDBY" 4 "BATTERY_SM_STATE_RESISTANCE_ESTIMATION" 3 "BATTERY_SM_STATE_STANDBY" 2 "BATTERY_SM_STATE_DISCHARGE" 1 "BATTERY_SM_STATE_CHARGE" 0 "BATTERY_SM_STATE_INIT" ;
VAL_TABLE_ LV_voltageProfile 3 "VOLTAGE_PROFILE_ALWAYS_CLOSED_CONTACTORS" 2 "VOLTAGE_PROFILE_REDUCED_FLOAT" 1 "VOLTAGE_PROFILE_FLOAT" 0 "VOLTAGE_PROFILE_CHARGE" ;
VAL_TABLE_ MONTH 12 "DECEMBER" 11 "NOVEMBER" 10 "OCTOBER" 9 "SEPTEMBER" 8 "AUGUST" 7 "JULY" 6 "JUNE" 5 "MAY" 4 "APRIL" 3 "MARCH" 2 "FEBRUARY" 1 "JANUARY" ;
VAL_TABLE_ NVRAM_configErrorType 2 "NVRAM_CFG_ERROR_UNKNOWN" 1 "NVRAM_CFG_BUFFER_SIZE_ERROR" 0 "NVRAM_CFG_FILESYSTEM_ERROR" ;
VAL_TABLE_ OCS1P_classificationHoldState 3 "OCCUPANCY_HOLD_FAULT" 2 "OCCUPANCY_HOLD_EXTERNAL" 1 "OCCUPANCY_HOLD_BASIC" 0 "OCCUPANCY_HOLD_OFF" ;
VAL_TABLE_ OCS1P_classificationVariant 7 "CLASSIFICATION_VARIANT_UNKNOWN" 1 "CLASSIFICATION_VARIANT_SELF_ONLY" 0 "CLASSIFICATION_VARIANT_ALL_SENSORS" ;
VAL_TABLE_ OCS1P_noSandwichType 3 "NO_SANDWICH_UNKNOWN" 2 "NO_SANDWICH_NA" 1 "NO_SANDWICH_EU" 0 "SANDWICH_INSTALLED" ;
VAL_TABLE_ OCS1P_occupantClassification 255 "OCCUPANT_CLASSIFICATION_SNA" 4 "OCCUPANT_CLASSIFICATION_INIT" 3 "OCCUPANT_CLASSIFICATION_OCCUPIED_ALLOW_LARGE" 2 "OCCUPANT_CLASSIFICATION_OCCUPIED_ALLOW_SMALL" 1 "OCCUPANT_CLASSIFICATION_OCCUPIED_INHIBIT" 0 "OCCUPANT_CLASSIFICATION_EMPTY" ;
VAL_TABLE_ OCS1P_occupantClassificationQF 1 "OCCUPANT_CLASSIFICATION_NOT_FAULTED" 0 "OCCUPANT_CLASSIFICATION_FAULTED" ;
VAL_TABLE_ OCS1P_occupiedState 3 "OCCUPIED_STATE_SNA" 1 "OCCUPIED_STATE_OCCUPIED" 0 "OCCUPIED_STATE_UNOCCUPIED" ;
VAL_TABLE_ PARK_offCourse 1023 "NONE" ;
VAL_TABLE_ PARK_oocCollisionSide 7 "COLLISION_SNA" 5 "COLLISION_UNKNOWN" 4 "REAR_COLLISION" 3 "FRONT_COLLISION" 2 "LEFT_SIDE_COLLISION" 1 "RIGHT_SIDE_COLLISION" 0 "NO_COLLISION" ;
VAL_TABLE_ PARK_oocConfidence 127 "SNA" 0 "NO_CONFIDENCE" ;
VAL_TABLE_ PARK_oocDistance 511 "SNA" 501 "NOT_INITIALIZED" 500 "NO_OBJ_COLLISION" ;
VAL_TABLE_ PARK_oocHeight 3 "HEIGHT_UNKNOWN" 2 "HIGH_OBJ" 1 "LOW_OBJ" 0 "NO_OBJ" ;
VAL_TABLE_ PARK_oocUntrackedTime 63 "SNA" ;
VAL_TABLE_ PARK_oocVehiclePosition 255 "UNKNOWN" ;
VAL_TABLE_ PBRK_panicReason 6 "PBRK_PANIC_EPB_RELEASE_TIMEOUT" 5 "PBRK_PANIC_SKID_DETECTED" 4 "PBRK_PANIC_EPB_INVALID" 3 "PBRK_PANIC_EPB_APPLY_TIMEOUT" 2 "PBRK_PANIC_EPB_MIA" 1 "PBRK_PANIC_EPB_FAULT" 0 "PBRK_PANIC_NONE" ;
VAL_TABLE_ PCS_AlertMatrixIndex 1 "PCS_AlertMatrix1" 0 "PCS_AlertMatrix0" ;
VAL_TABLE_ PCS_alertSource 5 "PCS_ALERT_SOURCE_DCDC" 4 "PCS_ALERT_SOURCE_CHG_SYSTEM" 3 "PCS_ALERT_SOURCE_CHG_PHC" 2 "PCS_ALERT_SOURCE_CHG_PHB" 1 "PCS_ALERT_SOURCE_CHG_PHA" 0 "PCS_ALERT_SOURCE_DEFAULT" ;
VAL_TABLE_ PCS_alerts 108 "PCS_a108_misconfigurationDetected" 107 "PCS_a107_vcPcsDCDCInterfaceMia" 106 "PCS_a106_clockSourceNotFromExternalCrystal" 105 "PCS_a105_redundantVoltageSourceIrrational" 104 "PCS_a104_ambientTempRationality" 103 "PCS_a103_pchgWithLowLvDetected" 102 "PCS_a102_resetWithDCDCCmdAsserted" 101 "PCS_a101_phMachineModelIrrational" 100 "PCS_a100_suspectedViperChipIssue" 99 "PCS_a099_microGridOverLoadedSilent" 98 "PCS_a098_gridFreqDroopDetectedSilent" 97 "PCS_a097_rebootPhaseDetected" 96 "PCS_a096_microGridOverLoaded" 95 "PCS_a095_dcdcSensorlessModeActive" 94 "PCS_a094_pcsDcdcNeedService" 93 "PCS_a093_powerRailRationality" 92 "PCS_a092_chgPowerLimitedByBusRipple" 91 "PCS_a091_chgIntBusRationality" 90 "PCS_a090_expectedAcVoltageSourceMissing" 89 "PCS_a089_hvBusDischargeIrrational" 88 "PCS_a088_gridFreqDroopDetected" 87 "PCS_a087_nvramRecordStatusError" 86 "PCS_a086_dcdcInsufficientCooling" 85 "PCS_a085_dcdcFetsNotSwitching" 84 "PCS_a084_vDropFastInParasiticDiodeRegion" 83 "PCS_a083_triggerOdin" 82 "PCS_a082_dcdcPchgUnsafeDiVoltage" 81 "PCS_a081_dcdcPchgTimeout" 80 "PCS_a080_damagedPhaseDetected" 79 "PCS_a079_eepromOperationError" 78 "PCS_a078_chgStopDcdcTooHot" 77 "PCS_a077_microGridWobbleDetected" 76 "PCS_a076_dcdcEnDeassertedErr" 75 "PCS_a075_hvBusDischargeTimeout" 74 "PCS_a074_hvBusDischargeFailure" 73 "PCS_a073_unexpectedAcInputVoltage" 72 "PCS_a072_cpu2ClaStopped" 71 "PCS_a071_chgPfcILoopRationality" 70 "PCS_a070_chgPfcLineDvdt" 69 "PCS_a069_chgPfcLineDidt" 68 "PCS_a068_dcdcTankvRationality" 67 "PCS_a067_dcdcLvRationality" 66 "PCS_a066_dcdcHvRationality" 65 "PCS_a065_chgPllNotLocked" 64 "PCS_a064_chgIOutRationality" 63 "PCS_a063_chgVOutRationality" 62 "PCS_a062_chgILineRationality" 61 "PCS_a061_chgVLineRationality" 60 "PCS_a060_chgInputOvPeak" 59 "PCS_a059_chgInputOvRms" 58 "PCS_a058_chgInputUnderFreq" 57 "PCS_a057_chgInputOverFreq" 56 "PCS_a056_chgLineImpedanceTooHigh" 55 "PCS_a055_chgLineImpedanceHigh" 54 "PCS_a054_chgInputVDropTooHigh" 53 "PCS_a053_chgInputVDropHigh" 52 "PCS_a052_acVoltageNotPresent" 51 "PCS_a051_chgIntBusUv" 50 "PCS_a050_dcdc12VsupportFaulted" 49 "PCS_a049_dcdcTempRationality" 48 "PCS_a048_softwareAssertion" 47 "PCS_a047_bootloaderCrcMismatch" 46 "PCS_a046_hvBusHighImpedence" 45 "PCS_a045_hvBusLowImpedance" 44 "PCS_a044_12vSupportRegulation" 43 "PCS_a043_hvBusPrechargeFailure" 42 "PCS_a042_dcdcEnableLineMismatch" 41 "PCS_a041_dcdcOverTemp" 40 "PCS_a040_dcdcMaxPowerReached" 39 "PCS_a039_sdModuleClkFault" 38 "PCS_a038_claFaulted" 37 "PCS_a037_resonantTankOc" 36 "PCS_a036_lvBusOv" 35 "PCS_a035_lvBusUv" 34 "PCS_a034_hvBusOv" 33 "PCS_a033_hvBusUv" 32 "PCS_a032_excessiveGridTransientsDetected" 31 "PCS_a031_uiMia" 30 "PCS_a030_canRationality" 29 "PCS_a029_chgPowerRationality" 28 "PCS_a028_chgOutputUv" 27 "PCS_a027_chgInsufficientCooling" 26 "PCS_a026_watchdogAlarmed" 25 "PCS_a025_cpu2Malfunction" 24 "PCS_a024_vcfrontMia" 23 "PCS_a023_cpMia" 22 "PCS_a022_bmsMia" 21 "PCS_a021_hvpMia" 20 "PCS_a020_chgEnableLineMismatch" 19 "PCS_a019_acChargePowerLimited" 18 "PCS_a018_chgUnknownGridConfig" 17 "PCS_a017_chgWallPowerRemoval" 16 "PCS_a016_chgAllPhasesFaulted" 15 "PCS_a015_chg12vUv" 14 "PCS_a014_chgTempRationality" 13 "PCS_a013_chgPrechargeFailedBoost" 12 "PCS_a012_chgPfcIBandTracerFault" 11 "PCS_a011_chgLlcCurrentRegulation" 10 "PCS_a010_chgIntBusVRegulation" 9 "PCS_a009_chgPfcCurrentRegulation" 8 "PCS_a008_chgPhaseOverTemp" 7 "PCS_a007_chgPhaseTempHot" 6 "PCS_a006_chgPrechargeFailedScr" 5 "PCS_a005_chgOutputOv" 4 "PCS_a004_chgHwIntBusOv" 3 "PCS_a003_chgHwInputOv" 2 "PCS_a002_chgHwOutputOc" 1 "PCS_a001_chgHwInputOc" 0 "PCS_ALERT_DO_NOT_USE_ZERO" ;
VAL_TABLE_ PCS_canErrorType 6 "PCS_CAN_ERR_UNKNOWN_ID" 5 "PCS_CAN_ERR_DATAINVALID" 4 "PCS_CAN_ERR_SEQUENCE" 3 "PCS_CAN_ERR_CHECKSUM" 2 "PCS_CAN_ERR_LENGTH_LONG" 1 "PCS_CAN_ERR_LENGTH_SHORT" 0 "PCS_CAN_ERR_NONE" ;
VAL_TABLE_ PCS_chgAcpwHeartbeatState 4 "PCS_ACPW_HEARTBEAT_STATE_NUM" 3 "PCS_ACPW_HEARTBEAT_STATE_DETECTED_ONGRID" 2 "PCS_ACPW_HEARTBEAT_STATE_DETECTED_OFFGRID" 1 "PCS_ACPW_HEARTBEAT_STATE_NOT_DETECTED" 0 "PCS_ACPW_HEARTBEAT_STATE_UNKNOWN" ;
VAL_TABLE_ PCS_chgMainState 9 "PCS_CHG_STATE_CLEAR_FAULTS" 8 "PCS_CHG_STATE_FAULTED" 7 "PCS_CHG_STATE_SHUTDOWN" 6 "PCS_CHG_STATE_ENABLE" 5 "PCS_CHG_STATE_SYSTEM_CONFIG" 4 "PCS_CHG_STATE_QUALIFY_LINE_CONFIG" 3 "PCS_CHG_STATE_WAIT_FOR_LINE_VOLTAGE" 2 "PCS_CHG_STATE_STARTUP" 1 "PCS_CHG_STATE_IDLE" 0 "PCS_CHG_STATE_INIT" ;
VAL_TABLE_ PCS_chgNoFlowTetherStatus 2 "PCS_CHG_NO_FLOW_TETHER_READY" 1 "PCS_CHG_NO_FLOW_TETHER_NOT_READY" 0 "PCS_CHG_NO_FLOW_TETHER_NOT_AVAILABLE" ;
VAL_TABLE_ PCS_chgPhBootCheckNVRAMState 4 "CHG_PH_BOOTCHECK_NVRAM_RUNNING_CNT_EXPIRED" 3 "CHG_PH_BOOTCHECK_NVRAM_RUNNING_CNT_2" 2 "CHG_PH_BOOTCHECK_NVRAM_RUNNING_CNT_1" 1 "CHG_PH_BOOTCHECK_NVRAM_RUNNING_CNT_0" 0 "CHG_PH_BOOTCHECK_NVRAM_PENDING" ;
VAL_TABLE_ PCS_chgPhInputCurrentLimitReason 5 "PCS_IAC_LIMITED_BY_PHASE_MACHINE_MODEL" 4 "PCS_IAC_LIMITED_BY_PHASE_THERMAL_LIMIT" 3 "PCS_IAC_LIMITED_BY_INPUT_POWER" 2 "PCS_IAC_LIMITED_BY_OUTPUT_POWER" 1 "PCS_IAC_LIMITED_BY_RIPPLE_RELAXED" 0 "PCS_IAC_LIMITED_BY_NONE" ;
VAL_TABLE_ PCS_chgPhasesPriority 36 "PHASES_PRIORITY_ABC" 33 "PHASES_PRIORITY_BAC" 24 "PHASES_PRIORITY_ACB" 18 "PHASES_PRIORITY_CAB" 9 "PHASES_PRIORITY_BCA" 6 "PHASES_PRIORITY_CBA" 0 "UNDEFINED_PHASES_PRIORITY" ;
VAL_TABLE_ PCS_chgPllSourceStatus 2 "PLL_SOURCE_NOT_POPULATED" 1 "PLL_SOURCE_IRRATIONAL" 0 "PLL_SOURCE_RATIONAL" ;
VAL_TABLE_ PCS_claDcdcFaultCode 8 "PCS_DCDC_CLA_FAULT_DEBUG_FORCED" 7 "PCS_DCDC_CLA_FAULT_VTANK_DVDT" 6 "PCS_DCDC_CLA_FAULT_TBCTR_TIMEOUT" 5 "PCS_DCDC_CLA_FAULT_LV_BRD_B_BOOTSTRAP_PRD" 4 "PCS_DCDC_CLA_FAULT_LV_BRD_A_BOOTSTRAP_PRD" 3 "PCS_DCDC_CLA_FAULT_UNEQUAL_ONTIME_ACCUM" 2 "PCS_DCDC_CLA_FAULT_UNEQUAL_ONTIME" 1 "PCS_DCDC_CLA_FAULT_UNEQUAL_PERIOD" 0 "PCS_DCDC_CLA_FAULT_NOT_FAULTED" ;
VAL_TABLE_ PCS_cpu2BootStates 3 "CPU2_STATE_ERROR" 2 "CPU2_STATE_APPLICATION" 1 "CPU2_STATE_BOOTLOADER" 0 "CPU2_STATE_BOOTROM" ;
VAL_TABLE_ PCS_cpu2_errorCode 10 "PCS_CPU2_ERROR_CPU2_HWID_CHK_INCOMPLETED" 9 "PCS_CPU2_ERROR_CRC_VALIDATION_FAILED" 8 "PCS_CPU2_ERROR_APP_HWID_BAD" 7 "PCS_CPU2_ERROR_FAILED_TO_RETRIEVE_HWID" 6 "PCS_CPU2_ERROR_BOOTLOADER_STATUS_INVALID" 5 "PCS_CPU2_ERROR_FAILED_TO_RETRIEVE_APPCRC" 4 "PCS_CPU2_ERROR_BOOTSTATUS_INVALID" 3 "PCS_CPU2_ERROR_APPCRC_MISMATCH" 2 "PCS_CPU2_ERROR_NO_APP_INSTALLED" 1 "PCS_CPU2_ERROR_LOSSCOMMS_BOOTLOADER" 0 "PCS_CPU2_ERROR_NONE" ;
VAL_TABLE_ PCS_dLogDataContent 3 "PCS_DLOG_INT_BUS_VOLTAGE" 2 "PCS_DLOG_OUTPUT_CURRENT" 1 "PCS_DLOG_INPUT_CURRENT" 0 "PCS_DLOG_INPUT_VOLTAGE" ;
VAL_TABLE_ PCS_dcdcHvBusDischargeStatus 2 "PCS_DCDC_DIS_HVBUS_FAULTED" 1 "PCS_DCDC_DIS_HVBUS_ACTIVE" 0 "PCS_DCDC_DIS_HVBUS_IDLE" ;
VAL_TABLE_ PCS_dcdcLvSupportStatus 2 "PCS_DCDC_LV_SUPPORT_FAULTED" 1 "PCS_DCDC_LV_SUPPORT_ACTIVE" 0 "PCS_DCDC_LV_SUPPORT_IDLE" ;
VAL_TABLE_ PCS_dcdcMalfunctionCode 2 "PCS_DCDC_MALFUNC_SENSORS" 1 "PCS_DCDC_MALFUNC_POWERRAIL" 0 "PCS_DCDC_MALFUNC_NONE" ;
VAL_TABLE_ PCS_dcdcPrechargeStatus 2 "PCS_DCDC_PRECHARGE_FAULTED" 1 "PCS_DCDC_PRECHARGE_ACTIVE" 0 "PCS_DCDC_PRECHARGE_IDLE" ;
VAL_TABLE_ PCS_dcdcSubState 18 "DCDC_SUBSTATE_NUM" 17 "DCDC_SUBSTATE_FAULTED" 16 "DCDC_SUBSTATE_CLEAR_FAULTS" 15 "DCDC_SUBSTATE_PCHG_FAULTED" 14 "DCDC_SUBSTATE_DIS_HVBUS_FAULTED" 13 "DCDC_SUBSTATE_LV_SUPPORT_FAULTED" 12 "DCDC_SUBSTATE_SHUTDOWN" 11 "DCDC_SUBSTATE_PCHG_FLT_FAST_DIS_HVBUS" 10 "DCDC_SUBSTATE_PCHG_ACTIVE" 9 "DCDC_SUBSTATE_PCHG_DI_RECOVERY_WAIT" 8 "DCDC_SUBSTATE_PCHG_DWELL_WAIT" 7 "DCDC_SUBSTATE_PCHG_DWELL_CHARGE" 6 "DCDC_SUBSTATE_PCHG_SLOW_DIS_HVBUS" 5 "DCDC_SUBSTATE_PCHG_FAST_DIS_HVBUS" 4 "DCDC_SUBSTATE_SLOW_DIS_HVBUS" 3 "DCDC_SUBSTATE_FAST_DIS_HVBUS" 2 "DCDC_SUBSTATE_LV_SUPPORT_ACTIVE" 1 "DCDC_SUBSTATE_STANDBY" 0 "DCDC_SUBSTATE_PWR_UP_INIT" ;
VAL_TABLE_ PCS_dcdcTankVoltage -1024 "TANK_VOLTAGE_SNA" ;
VAL_TABLE_ PCS_eepromOperation 15 "EEPROM_OPERATION_SNA" 9 "EEPROM_WRITE_RECORD_DATA" 8 "EEPROM_WRITE_RECORD_DESC" 7 "EEPROM_WRITE_RECORD_METADATA" 6 "EEPROM_WRITE_VALIDITY_MARKER" 5 "EEPROM_WRITE_REGION_VALIDITY" 4 "EEPROM_READ_RECORD_DATA" 3 "EEPROM_READ_RECORD_DESC" 2 "EEPROM_READ_RECORD_METADATA" 1 "EEPROM_READ_REGION_VALIDITY_MARKERS" 0 "EEPROM_READ_REGION_VALIDITY" ;
VAL_TABLE_ PCS_eepromOperationRegion 3 "EEPROM_UNDEFINED_REGION" 2 "EEPROM_SECONDARY_REGION" 1 "EEPROM_PRIMARY_REGION" 0 "EEPROM_VALIDITY_REGION" ;
VAL_TABLE_ PCS_gridConfig 3 "GRID_CONFIG_THREE_PHASE_DELTA" 2 "GRID_CONFIG_THREE_PHASE" 1 "GRID_CONFIG_SINGLE_PHASE" 0 "GRID_CONFIG_SNA" ;
VAL_TABLE_ PCS_hvChargeStatus 3 "PCS_CHARGE_FAULTED" 2 "PCS_CHARGE_ENABLED" 1 "PCS_CHARGE_BLOCKED" 0 "PCS_CHARGE_STANDBY" ;
VAL_TABLE_ PCS_hwVariantType 3 "PCS_HW_VARIANT_TYPE_SNA" 2 "PCS_THREE_PHASES_VARIANT" 1 "PCS_32A_SINGLE_PHASE_VARIANT" 0 "PCS_48A_SINGLE_PHASE_VARIANT" ;
VAL_TABLE_ PCS_logMessageSelect 27 "PCS_LOG_NUM_MSGS" 26 "PCS_LOG_PROCESSOR_DIE_ID" 25 "PCS_LOG_DCDC_IMPEDANCE_EST" 24 "PCS_LOG_DCDC_HVBUS_PCHG_DATA" 23 "PCS_LOG_CHG_MACHINEMODEL" 22 "PCS_LOG_DCDC_STATISTICS" 21 "PCS_LOG_CHG_LINE_OFFSET" 20 "PCS_LOG_CHG_NO_FLOW" 19 "PCS_LOG_DCDC_5" 18 "PCS_LOG_DCDC_4" 17 "PCS_LOG_DLOG_4" 16 "PCS_LOG_DLOG_3" 15 "PCS_LOG_DLOG_2" 14 "PCS_LOG_DLOG_1" 13 "PCS_LOG_CHG_4" 12 "PCS_LOG_PHC_2" 11 "PCS_LOG_PHB_2" 10 "PCS_LOG_PHA_2" 9 "PCS_LOG_SYSTEM_1" 8 "PCS_LOG_DCDC_3" 7 "PCS_LOG_DCDC_2" 6 "PCS_LOG_DCDC_1" 5 "PCS_LOG_CHG_3" 4 "PCS_LOG_CHG_2" 3 "PCS_LOG_CHG_1" 2 "PCS_LOG_PHC_1" 1 "PCS_LOG_PHB_1" 0 "PCS_LOG_PHA_1" ;
VAL_TABLE_ PCS_lvSupportRegulationFaultCode 3 "PCS_DCDC_LV_REGULATOR_IRRATIONAL_SHORTTIME" 2 "PCS_DCDC_LV_REGULATOR_WRONG_DIRECTION" 1 "PCS_DCDC_LV_REGULATOR_HIGH_CURRENT" 0 "PCS_DCDC_LV_REGULATOR_SNA" ;
VAL_TABLE_ PCS_phShutdownReason 17 "PCS_PH_SHUTDOWN_LINE_TRANSIENT_FAULT" 16 "PCS_PH_SHUTDOWN_FREQ_OUT_OF_RANGE" 15 "PCS_PH_SHUTDOWN_SENSOR_IRRATIONAL" 14 "PCS_PH_SHUTDOWN_TEMP_IRRATIONAL" 13 "PCS_PH_SHUTDOWN_OVER_TEMPERATURE" 12 "PCS_PH_SHUTDOWN_CONTROL_REGULATION_FAULT" 11 "PCS_PH_SHUTDOWN_INT_BUS_UV" 10 "PCS_PH_SHUTDOWN_PRECHARGE_TIMEOUT" 9 "PCS_PH_SHUTDOWN_OUTPUT_OV" 8 "PCS_PH_SHUTDOWN_OUTPUT_UV" 7 "PCS_PH_SHUTDOWN_INPUT_OV" 6 "PCS_PH_SHUTDOWN_INPUT_UV" 5 "PCS_PH_SHUTDOWN_PLL_NOT_LOCKED" 4 "PCS_PH_SHUTDOWN_HW_FAULT" 3 "PCS_PH_SHUTDOWN_SW_FAULT" 2 "PCS_PH_SHUTDOWN_HW_ENABLE" 1 "PCS_PH_SHUTDOWN_SW_ENABLE" 0 "PCS_PH_SHUTDOWN_REASON_NONE" ;
VAL_TABLE_ PCS_phState 6 "PCS_PH_STATE_SHUTTING_DOWN" 5 "PCS_PH_STATE_CLEAR_FAULTS" 4 "PCS_PH_STATE_FAULT" 3 "PCS_PH_STATE_ENABLE" 2 "PCS_PH_STATE_PRECHARGE" 1 "PCS_PH_STATE_IDLE" 0 "PCS_PH_STATE_INIT" ;
VAL_TABLE_ PCS_phaseConfig 9 "PHASE_CONFIG_TOTAL_NUM" 8 "PHASE_CONFIG_SINGLE_PHASE_EVSE_PARALLEL" 7 "PHASE_CONFIG_SINGLE_PHASE_BRIDGED_HARNESS" 6 "PHASE_CONFIG_MFG_TEST_CONFIG_2" 5 "PHASE_CONFIG_MFG_TEST_CONFIG_1" 4 "PHASE_CONFIG_SINGLE_PHASE_IEC_GB" 3 "PHASE_CONFIG_THREE_PHASE_DELTA" 2 "PHASE_CONFIG_THREE_PHASE" 1 "PHASE_CONFIG_SINGLE_PHASE" 0 "PHASE_CONFIG_SNA" ;
VAL_TABLE_ PCS_selfTestState 1 "PCS_SELF_TEST_STARTED" 0 "PCS_SELF_TEST_IDLE" ;
VAL_TABLE_ PCS_softwareAssertionError 0 "PCS_ERROR_CHG_MAINSM_DEFAULT_CASE" ;
VAL_TABLE_ PMF_alerts 95 "PMF_a095_safetyICFault" 94 "PMF_a094_safetyICWarn" 92 "PMF_a092_xtalOscillator" 64 "PMF_a064_torqueIntervention" 62 "PMF_a062_eccError" 61 "PMF_a061_DIPMVersionMismatch" 57 "PMF_a057_canDataBusB" 56 "PMF_a056_canHardwareBusB" 55 "PMF_a055_resolver" 54 "PMF_a054_uiMIA" 53 "PMF_a053_vcfrontMIA" 45 "PMF_a045_motorMovementDetected" 42 "PMF_a042_gtwMIA" 40 "PMF_a040_pmMIA" 39 "PMF_a039_disMIA" 37 "PMF_a037_hvpMIA" 36 "PMF_a036_preWatchdog" 35 "PMF_a035_udsTransactionInitiated" 34 "PMF_a034_trqCrossCheck" 33 "PMF_a033_selfTest" 32 "PMF_a032_registerConfigError" 31 "PMF_a031_highStackUsage" 28 "PMF_a028_torqueCmdError" 27 "PMF_a027_torqueEstimationOutOfBounds" 26 "PMF_a026_diHeartBeatMIA" 25 "PMF_a025_unintendedReset" 19 "PMF_a019_statorTempIrrational" 18 "PMF_a018_encoderIrrational" 17 "PMF_a017_brakeMIA" 13 "PMF_a013_canHardwareBusA" 12 "PMF_a012_canDataBusA" 11 "PMF_a011_phaseCurrentIrrational" 10 "PMF_a010_diMIA" 8 "PMF_a008_memoryError" 5 "PMF_a005_torqueInNeutralOrPark" 4 "PMF_a004_excessiveDecelTorque" 3 "PMF_a003_excessiveReversalTorque" 2 "PMF_a002_excessiveAccelTorque" 1 "PMF_a001_absoluteTorque" 0 "PMF_ALERT_DO_NOT_USE_ZERO" 96 "PMF_a096_safetyICDebug" ;
VAL_TABLE_ PMF_debugMux 70 "Mux70" 69 "Mux69" 68 "Mux68" 67 "Mux67" 66 "Mux66" 65 "Mux65" 64 "Mux64" 17 "Mux17" 16 "Mux16" 5 "Mux5" 4 "Mux4" 3 "Mux3" 2 "Mux2" 1 "Mux1" ;
VAL_TABLE_ PMR_alerts 95 "PMR_a095_safetyICFault" 94 "PMR_a094_safetyICWarn" 92 "PMR_a092_xtalOscillator" 64 "PMR_a064_torqueIntervention" 62 "PMR_a062_eccError" 61 "PMR_a061_DIPMVersionMismatch" 57 "PMR_a057_canDataBusB" 56 "PMR_a056_canHardwareBusB" 55 "PMR_a055_resolver" 54 "PMR_a054_uiMIA" 53 "PMR_a053_vcfrontMIA" 45 "PMR_a045_motorMovementDetected" 42 "PMR_a042_gtwMIA" 40 "PMR_a040_pmMIA" 39 "PMR_a039_disMIA" 37 "PMR_a037_hvpMIA" 36 "PMR_a036_preWatchdog" 35 "PMR_a035_udsTransactionInitiated" 34 "PMR_a034_trqCrossCheck" 33 "PMR_a033_selfTest" 32 "PMR_a032_registerConfigError" 31 "PMR_a031_highStackUsage" 28 "PMR_a028_torqueCmdError" 27 "PMR_a027_torqueEstimationOutOfBounds" 26 "PMR_a026_diHeartBeatMIA" 25 "PMR_a025_unintendedReset" 19 "PMR_a019_statorTempIrrational" 18 "PMR_a018_encoderIrrational" 17 "PMR_a017_brakeMIA" 13 "PMR_a013_canHardwareBusA" 12 "PMR_a012_canDataBusA" 11 "PMR_a011_phaseCurrentIrrational" 10 "PMR_a010_diMIA" 8 "PMR_a008_memoryError" 5 "PMR_a005_torqueInNeutralOrPark" 4 "PMR_a004_excessiveDecelTorque" 3 "PMR_a003_excessiveReversalTorque" 2 "PMR_a002_excessiveAccelTorque" 1 "PMR_a001_absoluteTorque" 0 "PMR_ALERT_DO_NOT_USE_ZERO" 96 "PMR_a096_safetyICDebug" ;
VAL_TABLE_ PMR_debugMux 70 "Mux70" 69 "Mux69" 68 "Mux68" 67 "Mux67" 66 "Mux66" 65 "Mux65" 64 "Mux64" 17 "Mux17" 16 "Mux16" 5 "Mux5" 4 "Mux4" 3 "Mux3" 2 "Mux2" 1 "Mux1" ;
VAL_TABLE_ PM_a005_torqueInNeutralReason 2 "SLAVE_ENABLE_IN_NEUTRAL" 1 "CURRENT_IN_NEUTRAL" 0 "TORQUE_IN_NEUTRAL" ;
VAL_TABLE_ PM_a014_accelErrorType 3 "AccelTracksOutOfSync" 2 "Accel2RangeError" 1 "Accel1RangeError" 0 "SNA" ;
VAL_TABLE_ PM_a026_reason 1 "TooFast" 0 "TooSlow" ;
VAL_TABLE_ PM_a034_torqueType 2 "PEDAL_POSITION" 1 "TORQUE_COMMAND" 0 "TORQUE_ESTIMATE" ;
VAL_TABLE_ PM_aebCancelReason 2 "PM_AEB_CANCEL_EPB_FAULT" 1 "PM_AEB_CANCEL_DAS" 0 "PM_AEB_CANCEL_NONE" ;
VAL_TABLE_ PM_aebFaultReason 6 "PM_AEB_FAULT_SPEED_DELTA" 5 "PM_AEB_FAULT_ESP_FAULT" 4 "PM_AEB_FAULT_EBR_FAULT" 3 "PM_AEB_FAULT_WHEEL_SPEEDS_INVALID" 2 "PM_AEB_FAULT_ESP_MIA" 1 "PM_AEB_FAULT_DAS_CONTROL_MIA" 0 "PM_AEB_FAULT_NONE" ;
VAL_TABLE_ PM_aebUnavailableReason 8 "PM_AEB_UNAVAILABLE_REVERSE_SPEED" 7 "PM_AEB_UNAVAILABLE_EBR" 6 "PM_AEB_UNAVAILABLE_NEGATIVE_SPEED" 5 "PM_AEB_UNAVAILABLE_GEAR" 4 "PM_AEB_UNAVAILABLE_SKID" 3 "PM_AEB_UNAVAILABLE_ESP_UNAVAILABLE" 2 "PM_AEB_UNAVAILABLE_DI_STATE" 1 "PM_AEB_UNAVAILBLE_EPB_PARK" 0 "PM_AEB_UNAVAILABLE_NONE" ;
VAL_TABLE_ PM_alerts 93 "PM_a093_accelPedalSupply" 92 "PM_a092_xtalOscillator" 67 "PM_a067_pmrMIA" 66 "PM_a066_pmfMIA" 64 "PM_a064_torqueIntervention" 63 "PM_a063_torqueCommandInhibit" 62 "PM_a062_eccError" 61 "PM_a061_DIPMVersionMismatch" 60 "PM_a060_onePedalDrivingInhibit" 59 "PM_a059_ptcMIA" 58 "PM_a058_cmpMIA" 57 "PM_a057_canDataBusB" 56 "PM_a056_canHardwareBusB" 55 "PM_a055_accelPedalSyncWarn" 54 "PM_a054_uiMIA" 53 "PM_a053_vcfrontMIA" 52 "PM_a052_stbCtrlDrvrDecelCflct" 51 "PM_a051_unintDecelStbCtrl" 50 "PM_a050_excessiveStbCtrlTrq" 49 "PM_a049_stbCtrlInWrongDir" 48 "PM_a048_stabilityControlInhibit" 47 "PM_a047_inconsAutoparkState" 46 "PM_a046_inconsVehicleHoldState" 45 "PM_a045_regenBackfillIntervention" 44 "PM_a044_ebrIntervention" 43 "PM_a043_inconsistentConfig" 42 "PM_a042_gtwMIA" 41 "PM_a041_dasMIA" 39 "PM_a039_disMIA" 38 "PM_a038_inconsistentTorqueSign" 37 "PM_a037_hvpMIA" 36 "PM_a036_preWatchdog" 35 "PM_a035_udsTransactionInitiated" 34 "PM_a034_trqCrossCheck" 32 "PM_a032_registerConfigError" 31 "PM_a031_highStackUsage" 30 "PM_a030_inconsistentAebState" 29 "PM_a029_cruiseRollback" 28 "PM_a028_torqueCmdError" 26 "PM_a026_diHeartBeatMIA" 25 "PM_a025_unintendedReset" 24 "PM_a024_brakeIrrational" 23 "PM_a023_cruiseInhibit" 22 "PM_a022_dirMIA" 21 "PM_a021_difMIA" 20 "PM_a020_swanMIA" 17 "PM_a017_brakeMIA" 16 "PM_a016_cruiseMIA" 15 "PM_a015_shifterMIA" 14 "PM_a014_accelPedalError" 13 "PM_a013_canHardwareBusA" 12 "PM_a012_canDataBusA" 10 "PM_a010_diMIA" 9 "PM_a009_espMIA" 8 "PM_a008_memoryError" 7 "PM_a007_ibstMIA" 6 "PM_a006_inconsistentDIGear" 5 "PM_a005_torqueInNeutralOrPark" 4 "PM_a004_excessiveDecelTorque" 3 "PM_a003_excessiveReversalTorque" 2 "PM_a002_excessiveAccelTorque" 1 "PM_a001_absoluteTorque" 0 "PM_ALERT_DO_NOT_USE_ZERO" ;
VAL_TABLE_ PM_autoparkCancelReason 3 "PM_APC_CANCEL_SPEED_VIOLATION" 2 "PM_APC_CRUISE_CANCEL_TIMEOUT" 1 "PM_APC_CANCEL_BRAKE_APPLY" 0 "PM_APC_CANCEL_NONE" ;
VAL_TABLE_ PM_canErrorType 5 "PM_CAN_ERR_IPC_TX_OVERRUN" 4 "PM_CAN_ERR_IPC_RX_OVERRUN" 3 "PM_CAN_ERR_TX_OVERRUN" 2 "PM_CAN_ERR_RX_OVERRUN" 1 "PM_CAN_ERR_TX" 0 "PM_CAN_ERR_RX" ;
VAL_TABLE_ PM_checkState 4 "TRQ_CHECK_CANNOT_POLICE_AT_ALL" 3 "TRQ_CHECK_CANNOT_POLICE_MEASUREMENT" 2 "TRQ_CHECK_CANNOT_POLICE_COMMAND" 1 "TRQ_CHECK_POLICING" 0 "TRQ_CHECK_START" ;
VAL_TABLE_ PM_crsCancelReason 10 "PM_CRS_CANCEL_SKID" 9 "PM_CRS_CANCEL_STALK_CMD" 8 "PM_CRS_CANCEL_BRAKE" 7 "PM_CRS_CANCEL_EPB" 6 "PM_CRS_CANCEL_DAS" 5 "PM_CRS_CANCEL_TC" 4 "PM_CRS_CANCEL_ESP" 3 "PM_CRS_CANCEL_GEAR" 2 "PM_CRS_CANCEL_AEB_ACTIVE" 1 "PM_CRS_CANCEL_OFF_BTN" 0 "PM_CRS_CANCEL_NONE" ;
VAL_TABLE_ PM_crsFaultReason 18 "PM_CRS_FAULT_VDC_FAULT" 17 "PM_CRS_FAULT_APC_FAULT" 16 "PM_CRS_FAULT_DECEL" 15 "PM_CRS_FAULT_ACCEL" 14 "PM_CRS_FAULT_TORQUE" 13 "PM_CRS_FAULT_DI_MIA" 12 "PM_CRS_FAULT_JERK_RQ" 11 "PM_CRS_FAULT_ACCEL_RQ" 10 "PM_CRS_FAULT_TC_FAULT" 9 "PM_CRS_FAULT_EPB_FAULT" 8 "PM_CRS_FAULT_DAS" 7 "PM_CRS_FAULT_CONFIG" 6 "PM_CRS_FAULT_WHEEL_SPDS_INVAL" 5 "PM_CRS_FAULT_EPB_MIA" 4 "PM_CRS_FAULT_SCCM_MIA" 3 "PM_CRS_FAULT_ESP_MIA" 2 "PM_CRS_FAULT_ESP_FAULT" 1 "PM_CRS_FAULT_EBR_FAULT" 0 "PM_CRS_FAULT_NONE" ;
VAL_TABLE_ PM_debugMux 69 "Mux69" 68 "Mux68" 67 "Mux67" 66 "Mux66" 65 "Mux65" 64 "Mux64" 18 "Mux18" 17 "Mux17" 16 "Mux16" 5 "Mux5" 4 "Mux4" 3 "Mux3" 2 "Mux2" 1 "Mux1" ;
VAL_TABLE_ PM_interventionType 15 "TRQP_excessiveMotorMz" 14 "TRQP_inconsistentAxleTorque" 13 "TRQP_diHeartbeat" 12 "TRQP_currentAfterIntervention" 11 "TRQP_switchingAfterIntervention" 10 "TRQP_switchOffPathTestFail" 9 "TRQP_inconsistentTorqueSign" 8 "TRQP_torqueInNeutral" 7 "TRQP_excessiveRegenTorque" 6 "TRQP_torqueReversal" 5 "TRQP_accumulatedTorque" 4 "TRQP_motorMovementDetected" 3 "TRQP_cruiseFault" 2 "TRQP_torqueCmdInvalid" 1 "TRQP_resolver" 0 "TRQP_masterTorqueMonitorShutoff" ;
VAL_TABLE_ PM_limpRequest 2 "PM_LIMP_SYSTEM" 1 "PM_LIMP_UNIT" 0 "PM_LIMP_OK" ;
VAL_TABLE_ PM_pllClockSource 2 "PM_CLOCK_INTOSC1" 1 "PM_CLOCK_XTAL" 0 "PM_CLOCK_INTOSC2" ;
VAL_TABLE_ PM_rollbackType 1 "ROLLBACK_SPEED" 0 "ROLLBACK_DISTANCE" ;
VAL_TABLE_ PM_taskID 12 "PM_EXT_STACK_IDLE" 11 "PM_EXT_STACK_TIMER" 10 "PM_EXT_STACK_UDS" 9 "PM_EXT_STACK_XCP" 8 "PM_EXT_STACK_CLOCK" 7 "PM_EXT_STACK_SWI_PRI2" 6 "PM_EXT_STACK_SWI_PRI1" 5 "PM_EXT_STACK_SWI_PRI0" 4 "PM_EXT_STACK_BASE" 3 "PM_STACK_IDLE" 2 "PM_STACK_XCP" 1 "PM_STACK_UDS" 0 "PM_STACK_SYSTEM" ;
VAL_TABLE_ PM_torqueCmdState 8 "TorqueCmd_Invalid" 6 "TorqueCmd_Valid" 0 "TorqueCmd_SNA" ;
VAL_TABLE_ PM_torqueState 2 "PM_TORQUE_INHIBITED" 1 "PM_TORQUE_DISALLOWED" 0 "PM_TORQUE_ALLOWED" ;
VAL_TABLE_ PM_vdcFaultReason 7 "PM_VDC_FAULT_EXCESSIVE_TSC_ACTIVITY" 6 "PM_VDC_FAULT_INVALID_REQUEST" 5 "PM_VDC_FAULT_INVALID_GEAR" 4 "PM_VDC_FAULT_EXCESSIVE_YAW_TORQUE" 3 "PM_VDC_FAULT_REVERSAL_YAW_TORQUE" 2 "PM_VDC_FAULT_DECEL_UNINTENDED" 1 "PM_VDC_FAULT_DECEL_INABILITY" 0 "PM_VDC_FAULT_NONE" ;
VAL_TABLE_ PM_vhldFaultReason 7 "PM_VHLD_FAULT_REQUESTED" 6 "PM_VHLD_FAULT_WHEEL_SPDS_INVAL" 5 "PM_VHLD_FAULT_EPB_MIA" 4 "PM_VHLD_FAULT_ESP_MIA" 3 "PM_VHLD_FAULT_ESP_FAULT" 2 "PM_VHLD_FAULT_BRAKE_INVALID" 1 "PM_VHLD_FAULT_EBR_FAULT" 0 "PM_VHLD_FAULT_NONE" ;
VAL_TABLE_ PM_vhldUnavailableReason 9 "PM_VHLD_UNAVAILABLE_EBR" 8 "PM_VHLD_UNAVAILABLE_AEB_ACTIVE" 7 "PM_VHLD_UNAVAILABLE_CRUISE_ACTIVE" 6 "PM_VHLD_UNAVAILABLE_SPEED" 5 "PM_VHLD_UNAVAILABLE_GEAR" 4 "PM_VHLD_UNAVAILABLE_SKID" 3 "PM_VHLD_UNAVAILABLE_DI_FAULT" 2 "PM_VHLD_UNAVAILABLE_EPB_FAULT" 1 "PM_VHLD_UNAVAILABLE_EPB" 0 "PM_VHLD_UNAVAILABLE_NONE" ;
VAL_TABLE_ PTC_ocpEvent 2 "OCP_EVENT_RIGHT_SIDE" 1 "OCP_EVENT_LEFT_SIDE" 0 "NO_OCP_EVENT" ;
VAL_TABLE_ PTC_powerDerating 3 "OVERTEMPERATURE_CORE" 2 "OVERTEMPERATURE_IGBT" 1 "OVERTEMPERATURE_PCB" 0 "NOT_DERATED" ;
VAL_TABLE_ PTC_rodStatus 3 "OVERTEMP" 2 "OPEN" 1 "ACTUAL" 0 "ESTIMATED" ;
VAL_TABLE_ PTC_tliSource 4 "HV_OVER_VOLTAGE" 3 "OCP" 2 "12_VOLTS" 1 "IGBT_DRIVER" 0 "NO_ERROR" ;
VAL_TABLE_ PlcForward_err 12 "PF_ERR_NUM" 11 "PF_ERR_PLC_TX_BUFF_FULL" 10 "PF_ERR_PLC_TX_FAILED" 9 "PF_ERR_PLC_RX_BUFF_FULL" 8 "PF_ERR_PLC_RX_FAILED" 7 "PF_ERR_CAN_TX_QUEUE_FULL" 6 "PF_ERR_INIT_TCP_SOCKET_CREATE" 5 "PF_ERR_INIT_TCP_CONNECT_FAILED" 4 "PF_ERR_GETSOCKOPT" 3 "PF_ERR_WOULD_BLOCK" 2 "PF_ERR_CONNECT_TIMEOUT" 1 "PF_ERR_ARG_INVALID" 0 "PF_ERR_OK" ;
VAL_TABLE_ PlcForward_state 3 "PLC_FORWARD_SHUTDOWN" 2 "PLC_FORWARD_FAULT" 1 "PLC_FORWARD_COMMS_ESTABLISHED" 0 "PLC_FORWARD_INIT" ;
VAL_TABLE_ RCM_airbagCutoffSwStatus 3 "SNA" 1 "RCM_PASSENGER_AIRBAG_DISABLED" 0 "RCM_PASSENGER_AIRBAG_ENABLED" ;
VAL_TABLE_ RCM_alrSwitchStatus 3 "SNA" 2 "RCM_ALR_FAULTED" 1 "RCM_ALR_ENGAGED" 0 "RCM_ALR_NOT_ENGAGED" ;
VAL_TABLE_ RCM_armStatus 3 "SNA" 2 "ARMED_WITH_NOFIRE_CAL" 1 "RCM_ARMED" 0 "RCM_UNARMED" ;
VAL_TABLE_ RCM_collisionEvent 3 "RCM_COLLISION_EVENT_SNA" 1 "RCM_COLLISION_EVENT_ACTIVE" 0 "RCM_COLLISION_EVENT_INACTIVE" ;
VAL_TABLE_ RCM_collisionSeverity 3 "RCM_COLLISION_SEVERITY_PEDPRO_EVENT" 2 "RCM_COLLISION_SEVERITY_SECOND_STAGE" 1 "RCM_COLLISION_SEVERITY_FIRST_STAGE" 0 "RCM_COLLISION_SEVERITY_PRETENSIONER" ;
VAL_TABLE_ RCM_crashAlgoWakeup 3 "RCM_CRASH_ALGO_WAKEUP_EVENT_SNA" 1 "RCM_CRASH_ALGO_WAKEUP_EVENT_ACTIVE" 0 "RCM_CRASH_ALGO_WAKEUP_EVENT_INACTIVE" ;
VAL_TABLE_ RCM_driverOrientationInitStatus 7 "SNA" 4 "RCM_DRIVER_ORIENTATION_MISMATCH_DEFAULT_RHD" 3 "RCM_DRIVER_ORIENTATION_MISMATCH_DEFAULT_LHD" 2 "RCM_DRIVER_ORIENTATION_MATCHED_RHD" 1 "RCM_DRIVER_ORIENTATION_MATCHED_LHD" 0 "RCM_DRIVER_ORIENTATION_INIT_NOT_COMPLETE" ;
VAL_TABLE_ RCM_edrState 3 "RCM_EDR_UNAVAILABLE" 2 "RCM_EDR_LOCKED" 1 "RCM_EDR_STORED" 0 "RCM_EDR_EMPTY" ;
VAL_TABLE_ RCM_imuOffsetLearnState 3 "IMU_OFFSETS_UNABLE_TO_LEARN" 2 "IMU_FAST_LEARNING_TIME" 1 "IMU_SLOW_LEARNING_DISTANCE" 0 "IMU_OFFSET_LEARNING_OFF" ;
VAL_TABLE_ RCM_keepPowerReason 8 "RCM_KEEP_POWER_REASON_SNA" 7 "RCM_INVALID_POWER_OFF_REQUEST" 6 "RCM_INITIALIZATION_PHASE" 5 "RCM_CANNOT_POWER_DOWN" 4 "RCM_EDR_UPLOADING" 3 "RCM_EDR_STORING_TO_EEPROM" 2 "RCM_CRASH_ALGO_ACTIVE" 1 "RCM_IN_IDLE_MODE" 0 "RCM_NO_KEEP_POWER_REQUEST" ;
VAL_TABLE_ RCM_mux 2 "THIRD_FRAME" 1 "SECOND_FRAME" 0 "FIRST_FRAME" ;
VAL_TABLE_ RCM_nearDeployEvent 3 "RCM_NEAR_DEPLOY_EVENT_SNA" 1 "RCM_NEAR_DEPLOY_EVENT_ACTIVE" 0 "RCM_NEAR_DEPLOY_EVENT_INACTIVE" ;
VAL_TABLE_ RCM_passAirbagIndicatorRequest 3 "SNA" 1 "RCM_PASSENGER_AIRBAG_INDICATOR_OFF" 0 "RCM_PASSENGER_AIRBAG_INDICATOR_ON" ;
VAL_TABLE_ RCM_seatTrackPosition 3 "SNA" 2 "RCM_SEAT_POSITION_FAULTED" 1 "RCM_SEAT_POSITION_FAR" 0 "RCM_SEAT_POSITION_NEAR" ;
VAL_TABLE_ RCM_vinLearnFlag 3 "SNA" 2 "RCM_VIN_STORED_MISMATCH" 1 "RCM_VIN_STORED" 0 "RCM_VIN_NOT_STORED" ;
VAL_TABLE_ RCM_warningIndicatorState 3 "SNA" 1 "RCM_WARNING_INDICATOR_ON" 0 "RCM_WARNING_INDICATOR_OFF" ;
VAL_TABLE_ SBRStatus 3 "SEAT_SNA" 2 "SEAT_FAULTED" 1 "SEAT_OCCUPIED" 0 "SEAT_UNOCCUPIED" ;
VAL_TABLE_ SCCM_AlertMatrixIndex 0 "SCCM_AlertMatrix0" ;
VAL_TABLE_ SCCM_alerts 29 "SCCM_a029_parkButtonMalfunction" 28 "SCCM_a028_parkButtonShortToGround" 27 "SCCM_a027_parkButtonOpenCircuit" 26 "SCCM_a026_parkButtonInvalidSignal" 25 "SCCM_a025_runTimeError" 24 "SCCM_a024_gearStalkGenErr" 23 "SCCM_a023_gearStalkShortCircuit" 22 "SCCM_a022_gearStalkOpenCircuit" 21 "SCCM_a021_gearStalkSignalInvalid" 20 "SCCM_a020_angleInternalError" 19 "SCCM_a019_angleSpeedAboveLimit" 18 "SCCM_a018_angleSpeedOutOfRange" 17 "SCCM_a017_memoryError" 16 "SCCM_a016_hardwareError" 15 "SCCM_a015_softwareError" 14 "SCCM_a014_voltageLow" 13 "SCCM_a013_voltageHigh" 12 "SCCM_a012_turnGenErr" 11 "SCCM_a011_turnIndHWErr" 10 "SCCM_a010_turnIndShortToGnd" 9 "SCCM_a009_turnIndOpen" 8 "SCCM_a008_turnIndInvalidTrans" 7 "SCCM_a007_turnIndComInfo" 6 "SCCM_a006_tipWipeShortToGND" 5 "SCCM_a005_tipWipeOpen" 4 "SCCM_a004_highBeamShortToGND" 3 "SCCM_a003_highBeamOpen" 2 "SCCM_a002_CANTOut" 1 "SCCM_a001_CANBusOff" 0 "SCCM_ALERT_DO_NOT_USE_ZERO" ;
VAL_TABLE_ SCCM_highBeamStalkStatus 3 "SNA" 2 "PUSH" 1 "PULL" 0 "IDLE" ;
VAL_TABLE_ SCCM_parkButtonStatus 3 "SNA" 2 "INIT" 1 "PRESSED" 0 "NOT_PRESSED" ;
VAL_TABLE_ SCCM_rightStalkStatus 6 "SNA" 5 "INIT" 4 "DOWN_2" 3 "DOWN_1" 2 "UP_2" 1 "UP_1" 0 "IDLE" ;
VAL_TABLE_ SCCM_steeringAngle 16383 "SNA" ;
VAL_TABLE_ SCCM_steeringAngleSensorStatus 3 "ERROR_INIT" 2 "ERROR" 1 "INIT" 0 "OK" ;
VAL_TABLE_ SCCM_steeringAngleValidity 3 "SNA" 2 "INIT" 1 "VALID" 0 "INVALID" ;
VAL_TABLE_ SCCM_turnIndicatorStalkStatus 9 "SNA" 8 "DOWN_2" 7 "DOWN_1_5" 6 "DOWN_1" 5 "DOWN_0_5" 4 "UP_2" 3 "UP_1_5" 2 "UP_1" 1 "UP_0_5" 0 "IDLE" ;
VAL_TABLE_ SCCM_washWipeButtonStatus 3 "SNA" 2 "2ND_DETENT" 1 "1ST_DETENT" 0 "NOT_PRESSED" ;
VAL_TABLE_ SCM_alerts 91 "SCM_a091_voltageRiseDetection" 78 "SCM_a078_voltageMatchTimeout" 76 "SCM_a076_bmsMIA" 74 "SCM_a074_isoVDiffHi" 44 "SCM_a044_proximityRationality" 27 "SCM_a027_externalIsolationLow" 0 "SCM_ALERT_DO_NOT_USE_ZERO" ;
VAL_TABLE_ SCS_alerts 128 "SCS_a128_unused128" 127 "SCS_a127_unused127" 126 "SCS_a126_unused126" 125 "SCS_a125_unused125" 124 "SCS_a124_unused124" 123 "SCS_a123_unused123" 122 "SCS_a122_unused122" 121 "SCS_a121_unused121" 120 "SCS_a120_unused120" 119 "SCS_a119_unused119" 118 "SCS_a118_unused118" 117 "SCS_a117_unused117" 116 "SCS_a116_unused116" 115 "SCS_a115_unused115" 114 "SCS_a114_unused114" 113 "SCS_a113_unused113" 112 "SCS_a112_unused112" 111 "SCS_a111_unused111" 110 "SCS_a110_unused110" 109 "SCS_a109_unused109" 108 "SCS_a108_unused108" 107 "SCS_a107_unused107" 106 "SCS_a106_unused106" 105 "SCS_a105_unused105" 104 "SCS_a104_unused104" 103 "SCS_a103_unused103" 102 "SCS_a102_unused102" 101 "SCS_a101_unused101" 100 "SCS_a100_unused100" 99 "SCS_a099_unused99" 98 "SCS_a098_unused98" 97 "SCS_a097_unused97" 96 "SCS_a096_unused96" 95 "SCS_a095_unused95" 94 "SCS_a094_unused94" 93 "SCS_a093_unused93" 92 "SCS_a092_cabEnableDeasserted" 91 "SCS_a091_voltageRiseDetection" 90 "SCS_a090_negCordOT" 89 "SCS_a089_posCordOT" 88 "SCS_a088_negCordTempRationality" 87 "SCS_a087_posCordTempRationality" 86 "SCS_a086_lccResetDetected" 85 "SCS_a085_unused85" 84 "SCS_a084_unused84" 83 "SCS_a083_chargeCurrentLimited" 82 "SCS_a082_VbatUV" 81 "SCS_a081_rmsInputVoltageHigh" 80 "SCS_a080_lccFaulted" 79 "SCS_a079_unexpectedVbat" 78 "SCS_a078_voltageMatchTimeout" 77 "SCS_a077_unexpectedVbatBehavior" 76 "SCS_a076_bmsMIA" 75 "SCS_a075_unused75" 74 "SCS_a074_isoVDiffHi" 73 "SCS_a073_lccMIA" 72 "SCS_a072_gtwMIA" 71 "SCS_a071_chargerMIA" 70 "SCS_a070_vStageRationalityV2" 69 "SCS_a069_vStageRationalityV1" 68 "SCS_a068_vBatRationalityStage4" 67 "SCS_a067_vBatRationalityStage3" 66 "SCS_a066_vBatRationalityStage2" 65 "SCS_a065_vBatRationalityStage1" 64 "SCS_a064_vehicleCommandTimeout" 63 "SCS_a063_canRationality" 62 "SCS_a062_unused" 61 "SCS_a061_postOutOfService" 60 "SCS_a060_swHVIL" 59 "SCS_a059_memoryError" 58 "SCS_a058_adcRef" 57 "SCS_a057_watchdogReset" 56 "SCS_a056_stateTransitionDenied" 55 "SCS_a055_coolantLevelLow" 54 "SCS_a054_pumpRegulation" 53 "SCS_a053_unexpectedThermalBehavi" 52 "SCS_a052_ambientTempRationality" 51 "SCS_a051_cordTempRationality" 50 "SCS_a050_coolantTempRationality" 49 "SCS_a049_pcbaTempRationality" 48 "SCS_a048_ambientOT" 47 "SCS_a047_cordOT" 46 "SCS_a046_coolantOT" 45 "SCS_a045_pcbaOT" 44 "SCS_a044_proximityRationality" 43 "SCS_a043_pilotRationality" 42 "SCS_a042_pilotOutOfRange" 41 "SCS_a041_minus12VOutOfRange" 40 "SCS_a040_plus12VOutOfRange" 39 "SCS_a039_ibatRegulation" 38 "SCS_a038_contactorFailedOpen" 37 "SCS_a037_outputContactorWelded" 36 "SCS_a036_internalContactorWelded" 35 "SCS_a035_unexpectedVbusBehavior" 34 "SCS_a034_IBatRationality" 33 "SCS_a033_VBusRationality" 32 "SCS_a032_VBatRationality" 31 "SCS_a031_IbatOC" 30 "SCS_a030_VbusOV" 29 "SCS_a029_VbatOV" 28 "SCS_a028_isolationRationality" 27 "SCS_a027_externalIsolationLow" 26 "SCS_a026_internalIsolationLow" 25 "SCS_a025_internalIsolationFault" 24 "SCS_a024_emergencyShutdown" 21 "SCS_a021_unusedHW21" 20 "SCS_a020_unusedHW20" 19 "SCS_a019_unusedHW19" 18 "SCS_a018_unusedHW18" 17 "SCS_a017_unusedHW17" 16 "SCS_a016_unusedHW16" 15 "SCS_a015_unusedHW15" 14 "SCS_a014_coolantTempHiFoldBk" 13 "SCS_a013_cordTempHiFoldBk" 12 "SCS_a012_hwIllegalCntrCmdV2" 11 "SCS_a011_hwIllegalCntrCmdInt" 10 "SCS_a010_hwIllegalCntrCmdV1" 9 "SCS_a009_hwOpen_V2" 8 "SCS_a008_hwOpen_V1" 7 "SCS_a007_hwWeld_V2" 6 "SCS_a006_hwWeld_V1" 5 "SCS_a005_hwHVIL" 4 "SCS_a004_hwVbusOV" 3 "SCS_a003_hwCordOT" 2 "SCS_a002_hwIbatOC" 1 "SCS_a001_hwDSPfault" 0 "SCS_ALERT_DO_NOT_USE_ZERO" ;
VAL_TABLE_ SDCR_AlertMatrixIndex 0 "SDCR_AlertMatrix0" ;
VAL_TABLE_ SDCR_alerts 25 "SDCR_a025_diSwitchingFdbkIrrational" 24 "SDCR_a024_gtwMIA" 23 "SDCR_a023_ecuLogAvailable" 22 "SDCR_a022_TaskInitError" 21 "SDCR_a021_busBarTempIrrational" 20 "SDCR_a020_eepromSPIError" 19 "SDCR_a019_historicalFaultCurrents" 18 "SDCR_a018_historicalPyroTrigger" 17 "SDCR_a017_adcSPIError" 16 "SDCR_a016_systemReset" 15 "SDCR_a015_phaseVIrrational" 14 "SDCR_a014_vBusIrrational" 13 "SDCR_a013_vBkupIrrational" 12 "SDCR_a012_vBoostSecIrrational" 11 "SDCR_a011_phaseCurrentOffset" 10 "SDCR_a010_vrefIrrational" 9 "SDCR_a009_uartVersionMismatch" 8 "SDCR_a008_hvlinkMIA" 7 "SDCR_a007_faultCurrentsDetected" 6 "SDCR_a006_pyroTriggered" 5 "SDCR_a005_motorSpeedIrrational" 4 "SDCR_a004_diRunningFdbkIrrational" 3 "SDCR_a003_diUartMIA" 2 "SDCR_a002_diPstSkipped" 1 "SDCR_a001_powerOnSelfTestFailed" 0 "SDCR_ALERT_DO_NOT_USE_ZERO" 26 "SDCR_a026_faultCurrentMonitoringDisabled" ;
VAL_TABLE_ SDC_busBarTemp 0 "SNA" ;
VAL_TABLE_ SDC_debugDataSelect 3 "SDC_DEBUG_3" 2 "SDC_DEBUG_2" 1 "SDC_DEBUG_1" 0 "SDC_DEBUG_0" ;
VAL_TABLE_ SDC_ecuLogState 2 "SDC_ECULOG_STATE_RESET" 1 "SDC_ECULOG_STATE_UPLOAD" 0 "SDC_ECULOG_STATE_IDLE" ;
VAL_TABLE_ SDC_eepromErrorCode 201 "SDC_EEPROM_FAILED_WRITE_SANITY_CHECK" 200 "SDC_EEPROM_FAILED_READ_SANITY_CHECK" 4 "SDC_EEPROM_GENERIC_SPI_ERROR" 3 "SDC_EEPROM_MUTEX_ERROR" 2 "SDC_EEPROM_PAGE_ROLLOVER" 1 "SDC_EEPROM_ADDRESS_OUT_OF_BOUNDS" ;
VAL_TABLE_ SDC_elcSpeed -32768 "SNA" ;
VAL_TABLE_ SDC_hvFaultMonitorState 4 "SDC_HVFM_STATE_READY" 3 "SDC_HVFM_STATE_CAPTURING" 2 "SDC_HVFM_STATE_TRANSIENT_3PS" 1 "SDC_HVFM_STATE_TRANSIENT_ALL_OFF" 0 "SDC_HVFM_STATE_IDLE" ;
VAL_TABLE_ SDC_pstState 7 "SDC_PST_STATE_SKIPPED" 6 "SDC_PST_STATE_FAILED" 5 "SDC_PST_STATE_PASSED" 4 "SDC_PST_STATE_TEST_PYRO_L_ON" 3 "SDC_PST_STATE_TEST_PYRO_BOTH_OFF2" 2 "SDC_PST_STATE_TEST_PYRO_H_ON" 1 "SDC_PST_STATE_TEST_PYRO_BOTH_OFF1" 0 "SDC_PST_STATE_PENDING" ;
VAL_TABLE_ SDC_pyroState 2 "SDC_PYRO_STATE_TRIGGERED" 1 "SDC_PYRO_STATE_ARMED" 0 "SDC_PYRO_STATE_UNAVAILABLE" ;
VAL_TABLE_ SDC_transientHandling 3 "SDC_TRANSIENTS_3PS_WAITED" 2 "SDC_TRANSIENTS_3PS_EARLY_EXIT" 1 "SDC_TRANSIENTS_SKIPPED_3PS" 0 "SDC_TRANSIENTS_ALL_SKIPPED" ;
VAL_TABLE_ SDP_err 4 "SDP_NUM_OF_ERRS" 3 "SDP_ERR_INVALID_DATA" 2 "SDP_ERR_NO_RX_DATA" 1 "SDP_ERR_INVALID_ARG" 0 "SDP_ERR_NONE" ;
VAL_TABLE_ SDP_type 3 "SDP_NUM_TYPES" 2 "SDP_TYPE_PLC_FORWARD" 1 "SDP_TYPE_TESLA_V2G" 0 "SDP_TYPE_SECC" ;
VAL_TABLE_ SEAT_easyEntryRearState 6 "EASY_ENTRY_SNA" 5 "EASY_ENTRY_TRACK_FORE_PITCH_UNLATCHED" 4 "EASY_ENTRY_TRACK_AFT_PITCH_UNLATCHED" 3 "EASY_ENTRY_PITCH_UNLATCHING" 2 "EASY_ENTRY_TRACK_FORE_PITCH_LATCHED" 1 "EASY_ENTRY_TRACK_UNLATCHING" 0 "EASY_ENTRY_TRACK_AFT_PITCH_LATCHED" ;
VAL_TABLE_ SEAT_heaterRequestLevel 3 "HEATER_REQUEST_LEVEL3" 2 "HEATER_REQUEST_LEVEL2" 1 "HEATER_REQUEST_LEVEL1" 0 "HEATER_REQUEST_OFF" ;
VAL_TABLE_ SEAT_seatState 5 "SEAT_STATE_UNDEFINED" 4 "SEAT_STATE_CALIBRATING" 3 "SEAT_STATE_RECALLING" 2 "SEAT_STATE_MOVING_DOWN" 1 "SEAT_STATE_MOVING_UP" 0 "SEAT_STATE_STOPPED" ;
VAL_TABLE_ SEAT_seatStatusIndex 5 "SEAT_STATUS_INDEX_POSITION" 4 "SEAT_STATUS_INDEX_LUMBAR" 3 "SEAT_STATUS_INDEX_TILT" 2 "SEAT_STATUS_INDEX_LIFT" 1 "SEAT_STATUS_INDEX_BACK" 0 "SEAT_STATUS_INDEX_TRACK" 6 "SEAT_STATUS_INDEX_OFFSETS" ;
VAL_TABLE_ SNA_0 0 "SNA" ;
VAL_TABLE_ SNA_RSSI 127 "SNA" ;
VAL_TABLE_ SNA_s11 -1023 "SNA" ;
VAL_TABLE_ SNA_s7 -64 "SNA" ;
VAL_TABLE_ SNA_s8 -128 "SNA" ;
VAL_TABLE_ SNA_u10 1023 "SNA" ;
VAL_TABLE_ SNA_u11 2047 "SNA" ;
VAL_TABLE_ SNA_u12 4095 "SNA" ;
VAL_TABLE_ SNA_u3 7 "SNA" ;
VAL_TABLE_ SNA_u4 15 "SNA" ;
VAL_TABLE_ SNA_u6 63 "SNA" ;
VAL_TABLE_ SNA_u7 127 "SNA" ;
VAL_TABLE_ SNA_u8 255 "SNA" ;
VAL_TABLE_ SNA_u9 511 "SNA" ;
VAL_TABLE_ SOPT_States 7 "SOPT_SNA" 6 "SOPT_TEST_FAILED" 5 "SOPT_TEST_SKIPPED" 4 "SOPT_TEST_PASSED" 3 "SOPT_CURRENT_TEST" 2 "SOPT_ASC_TEST" 1 "SOPT_PSTG_BRING_UP" 0 "SOPT_INIT" ;
VAL_TABLE_ SOPT_failReasons 7 "SOPT_FAIL_ASC_TEST" 6 "SOPT_FAIL_FAULT_PRESENT" 5 "SOPT_FAIL_GATE_DRIVE_ERROR" 4 "SOPT_FAIL_TIMEDOUT" 3 "SOPT_FAIL_DISAGREE" 2 "SOPT_FAIL_NEG_CURRENT" 1 "SOPT_FAIL_POS_CURRENT" 0 "SOPT_FAIL_CACHED" ;
VAL_TABLE_ SOPT_localStates 11 "SOPT_STATE_TEST_RESTART" 10 "SOPT_STATE_TEST_FAILED" 9 "SOPT_STATE_TEST_SKIPPED" 8 "SOPT_STATE_TEST_PASSED" 7 "SOPT_STATE_TEST_PRE_PASSED" 6 "SOPT_STATE_CURRENT_TEST_NEG" 5 "SOPT_STATE_CURRENT_TEST_POS" 4 "SOPT_STATE_PWM_ENABLE" 3 "SOPT_STATE_ASC_TEST_PASSED" 2 "SOPT_STATE_ASC_TEST" 1 "SOPT_STATE_PSTG_BRING_UP" 0 "SOPT_STATE_INIT" ;
VAL_TABLE_ ShuntCurrentComp 3 "COMPENSATION_TCR" 2 "COMPENSATION_DEFAULT_COEFF" 1 "COMPENSATION_INVALID" 0 "COMPENSATION_NONE" ;
VAL_TABLE_ ShuntSensorStatus 3 "DATA_STALE" 2 "DATA_VALID" 1 "DATA_INVALID" 0 "DATA_NOT_AVAILABLE" ;
VAL_TABLE_ TAS_NM_keepAwakeReason 15 "TAS_KEEPAWAKE_REASON_MULTIPLE" 1 "TAS_KEEPAWAKE_REASON_LEVELING_IN_PROGRESS" 0 "TAS_KEEPAWAKE_REASON_NONE_SNA" ;
VAL_TABLE_ TAS_NM_wakeUpReason 3 "TAS_WAKEUP_REASON_RESET" 2 "TAS_WAKEUP_REASON_SWITCH_INPUT" 1 "TAS_WAKEUP_REASON_ECU_SPECIFIC" 0 "TAS_WAKEUP_REASON_NONE" ;
VAL_TABLE_ TAS_filterMode 7 "MODE_STOPPING" 6 "MODE_DRIVE" 5 "MODE_LOADING" 4 "MODE_READY" 3 "MODE_TEST" 2 "MODE_CALIBRATE" 1 "MODE_INIT" 0 "MODE_NONE" ;
VAL_TABLE_ TAS_level 4 "TAS_VERY_LOW" 3 "TAS_LOW" 2 "TAS_STANDARD" 1 "TAS_HIGH" 0 "TAS_VERY_HIGH" ;
VAL_TABLE_ TAS_levelingItem 7 "TAS_LEVELING_ITEM_ALL" 6 "TAS_LEVELING_ITEM_REAR_AXLE" 5 "TAS_LEVELING_ITEM_FRONT_AXLE" 4 "TAS_LEVELING_ITEM_RR" 3 "TAS_LEVELING_ITEM_RL" 2 "TAS_LEVELING_ITEM_FR" 1 "TAS_LEVELING_ITEM_FL" 0 "TAS_LEVELING_ITEM_NONE" ;
